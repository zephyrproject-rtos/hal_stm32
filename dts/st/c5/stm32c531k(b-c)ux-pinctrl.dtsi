/*
 * NOTE: Autogenerated file using genpinctrl_hal2.py
 *
 * SPDX-License-Identifier: Apache-2.0
 */


#include <zephyr/dt-bindings/pinctrl/stm32-pinctrl.h>

&pinctrl {

	/* Analog */
	/omit-if-no-ref/ analog_pa0: analog_pa0 {
		pinmux = <STM32_PINMUX('A', 0, ANALOG)>;
	};

	/omit-if-no-ref/ analog_pa1: analog_pa1 {
		pinmux = <STM32_PINMUX('A', 1, ANALOG)>;
	};

	/omit-if-no-ref/ analog_pa2: analog_pa2 {
		pinmux = <STM32_PINMUX('A', 2, ANALOG)>;
	};

	/omit-if-no-ref/ analog_pa3: analog_pa3 {
		pinmux = <STM32_PINMUX('A', 3, ANALOG)>;
	};

	/omit-if-no-ref/ analog_pa4: analog_pa4 {
		pinmux = <STM32_PINMUX('A', 4, ANALOG)>;
	};

	/omit-if-no-ref/ analog_pa5: analog_pa5 {
		pinmux = <STM32_PINMUX('A', 5, ANALOG)>;
	};

	/omit-if-no-ref/ analog_pa6: analog_pa6 {
		pinmux = <STM32_PINMUX('A', 6, ANALOG)>;
	};

	/omit-if-no-ref/ analog_pa7: analog_pa7 {
		pinmux = <STM32_PINMUX('A', 7, ANALOG)>;
	};

	/omit-if-no-ref/ analog_pa8: analog_pa8 {
		pinmux = <STM32_PINMUX('A', 8, ANALOG)>;
	};

	/omit-if-no-ref/ analog_pa9: analog_pa9 {
		pinmux = <STM32_PINMUX('A', 9, ANALOG)>;
	};

	/omit-if-no-ref/ analog_pa11: analog_pa11 {
		pinmux = <STM32_PINMUX('A', 11, ANALOG)>;
	};

	/omit-if-no-ref/ analog_pa12: analog_pa12 {
		pinmux = <STM32_PINMUX('A', 12, ANALOG)>;
	};

	/omit-if-no-ref/ analog_pa13: analog_pa13 {
		pinmux = <STM32_PINMUX('A', 13, ANALOG)>;
	};

	/omit-if-no-ref/ analog_pa14: analog_pa14 {
		pinmux = <STM32_PINMUX('A', 14, ANALOG)>;
	};

	/omit-if-no-ref/ analog_pa15: analog_pa15 {
		pinmux = <STM32_PINMUX('A', 15, ANALOG)>;
	};

	/omit-if-no-ref/ analog_pb0: analog_pb0 {
		pinmux = <STM32_PINMUX('B', 0, ANALOG)>;
	};

	/omit-if-no-ref/ analog_pb1: analog_pb1 {
		pinmux = <STM32_PINMUX('B', 1, ANALOG)>;
	};

	/omit-if-no-ref/ analog_pb3: analog_pb3 {
		pinmux = <STM32_PINMUX('B', 3, ANALOG)>;
	};

	/omit-if-no-ref/ analog_pb4: analog_pb4 {
		pinmux = <STM32_PINMUX('B', 4, ANALOG)>;
	};

	/omit-if-no-ref/ analog_pb5: analog_pb5 {
		pinmux = <STM32_PINMUX('B', 5, ANALOG)>;
	};

	/omit-if-no-ref/ analog_pb6: analog_pb6 {
		pinmux = <STM32_PINMUX('B', 6, ANALOG)>;
	};

	/omit-if-no-ref/ analog_pb7: analog_pb7 {
		pinmux = <STM32_PINMUX('B', 7, ANALOG)>;
	};

	/omit-if-no-ref/ analog_pb8: analog_pb8 {
		pinmux = <STM32_PINMUX('B', 8, ANALOG)>;
	};

	/omit-if-no-ref/ analog_pb15: analog_pb15 {
		pinmux = <STM32_PINMUX('B', 15, ANALOG)>;
	};

	/omit-if-no-ref/ analog_pc14: analog_pc14 {
		pinmux = <STM32_PINMUX('C', 14, ANALOG)>;
	};

	/omit-if-no-ref/ analog_ph0: analog_ph0 {
		pinmux = <STM32_PINMUX('H', 0, ANALOG)>;
	};

	/omit-if-no-ref/ analog_ph1: analog_ph1 {
		pinmux = <STM32_PINMUX('H', 1, ANALOG)>;
	};

	/omit-if-no-ref/ analog_ph2: analog_ph2 {
		pinmux = <STM32_PINMUX('H', 2, ANALOG)>;
	};

	/* ADC_IN / ADC_INN / ADC_INP */
	/omit-if-no-ref/ adc1_in0_pa0: adc1_in0_pa0 {
		pinmux = <STM32_PINMUX('A', 0, ANALOG)>;
	};

	/omit-if-no-ref/ adc1_in1_pa1: adc1_in1_pa1 {
		pinmux = <STM32_PINMUX('A', 1, ANALOG)>;
	};

	/omit-if-no-ref/ adc1_in2_pa2: adc1_in2_pa2 {
		pinmux = <STM32_PINMUX('A', 2, ANALOG)>;
	};

	/omit-if-no-ref/ adc1_in3_pa3: adc1_in3_pa3 {
		pinmux = <STM32_PINMUX('A', 3, ANALOG)>;
	};

	/omit-if-no-ref/ adc1_in4_pa4: adc1_in4_pa4 {
		pinmux = <STM32_PINMUX('A', 4, ANALOG)>;
	};

	/omit-if-no-ref/ adc1_in5_pa5: adc1_in5_pa5 {
		pinmux = <STM32_PINMUX('A', 5, ANALOG)>;
	};

	/omit-if-no-ref/ adc1_in6_pa6: adc1_in6_pa6 {
		pinmux = <STM32_PINMUX('A', 6, ANALOG)>;
	};

	/omit-if-no-ref/ adc1_in6_pb0: adc1_in6_pb0 {
		pinmux = <STM32_PINMUX('B', 0, ANALOG)>;
	};

	/omit-if-no-ref/ adc1_in7_pa7: adc1_in7_pa7 {
		pinmux = <STM32_PINMUX('A', 7, ANALOG)>;
	};

	/omit-if-no-ref/ adc1_in7_pb1: adc1_in7_pb1 {
		pinmux = <STM32_PINMUX('B', 1, ANALOG)>;
	};

	/* COMP_OUT */
	/omit-if-no-ref/ comp1_out_pa13: comp1_out_pa13 {
		pinmux = <STM32_PINMUX('A', 13, AF14)>;
	};

	/omit-if-no-ref/ comp1_out_pa3: comp1_out_pa3 {
		pinmux = <STM32_PINMUX('A', 3, AF14)>;
	};

	/omit-if-no-ref/ comp1_out_pb1: comp1_out_pb1 {
		pinmux = <STM32_PINMUX('B', 1, AF14)>;
	};

	/omit-if-no-ref/ comp2_out_pa12: comp2_out_pa12 {
		pinmux = <STM32_PINMUX('A', 12, AF14)>;
	};

	/omit-if-no-ref/ comp2_out_pa2: comp2_out_pa2 {
		pinmux = <STM32_PINMUX('A', 2, AF14)>;
	};

	/omit-if-no-ref/ comp2_out_pa7: comp2_out_pa7 {
		pinmux = <STM32_PINMUX('A', 7, AF14)>;
	};

	/* DAC_OUT */
	/omit-if-no-ref/ dac1_out1_pa4: dac1_out1_pa4 {
		pinmux = <STM32_PINMUX('A', 4, ANALOG)>;
	};

	/omit-if-no-ref/ dac1_out2_pa5: dac1_out2_pa5 {
		pinmux = <STM32_PINMUX('A', 5, ANALOG)>;
	};

	/* I2C_SCL */
	/omit-if-no-ref/ i2c1_scl_pa11: i2c1_scl_pa11 {
		pinmux = <STM32_PINMUX('A', 11, AF8)>;
		bias-pull-up;
		drive-open-drain;
	};

	/omit-if-no-ref/ i2c1_scl_pa8: i2c1_scl_pa8 {
		pinmux = <STM32_PINMUX('A', 8, AF9)>;
		bias-pull-up;
		drive-open-drain;
	};

	/omit-if-no-ref/ i2c1_scl_pb3: i2c1_scl_pb3 {
		pinmux = <STM32_PINMUX('B', 3, AF9)>;
		bias-pull-up;
		drive-open-drain;
	};

	/omit-if-no-ref/ i2c1_scl_pb6: i2c1_scl_pb6 {
		pinmux = <STM32_PINMUX('B', 6, AF4)>;
		bias-pull-up;
		drive-open-drain;
	};

	/omit-if-no-ref/ i2c1_scl_pb8: i2c1_scl_pb8 {
		pinmux = <STM32_PINMUX('B', 8, AF4)>;
		bias-pull-up;
		drive-open-drain;
	};

	/omit-if-no-ref/ i2c1_scl_ph1: i2c1_scl_ph1 {
		pinmux = <STM32_PINMUX('H', 1, AF4)>;
		bias-pull-up;
		drive-open-drain;
	};

	/* I2C_SDA */
	/omit-if-no-ref/ i2c1_sda_pa12: i2c1_sda_pa12 {
		pinmux = <STM32_PINMUX('A', 12, AF8)>;
		bias-pull-up;
		drive-open-drain;
	};

	/omit-if-no-ref/ i2c1_sda_pb3: i2c1_sda_pb3 {
		pinmux = <STM32_PINMUX('B', 3, AF4)>;
		bias-pull-up;
		drive-open-drain;
	};

	/omit-if-no-ref/ i2c1_sda_pb4: i2c1_sda_pb4 {
		pinmux = <STM32_PINMUX('B', 4, AF9)>;
		bias-pull-up;
		drive-open-drain;
	};

	/omit-if-no-ref/ i2c1_sda_pb7: i2c1_sda_pb7 {
		pinmux = <STM32_PINMUX('B', 7, AF4)>;
		bias-pull-up;
		drive-open-drain;
	};

	/omit-if-no-ref/ i2c1_sda_ph0: i2c1_sda_ph0 {
		pinmux = <STM32_PINMUX('H', 0, AF4)>;
		bias-pull-up;
		drive-open-drain;
	};

	/* I2C_SMBA */
	/omit-if-no-ref/ i2c1_smba_pa15: i2c1_smba_pa15 {
		pinmux = <STM32_PINMUX('A', 15, AF4)>;
		bias-pull-up;
	};

	/omit-if-no-ref/ i2c1_smba_pa9: i2c1_smba_pa9 {
		pinmux = <STM32_PINMUX('A', 9, AF9)>;
		bias-pull-up;
	};

	/omit-if-no-ref/ i2c1_smba_pb5: i2c1_smba_pb5 {
		pinmux = <STM32_PINMUX('B', 5, AF4)>;
		bias-pull-up;
	};

	/* I2S_CK */
	/omit-if-no-ref/ i2s1_ck_pa5: i2s1_ck_pa5 {
		pinmux = <STM32_PINMUX('A', 5, AF5)>;
		slew-rate = "very-high-speed";
	};

	/omit-if-no-ref/ i2s1_ck_pb3: i2s1_ck_pb3 {
		pinmux = <STM32_PINMUX('B', 3, AF5)>;
		slew-rate = "very-high-speed";
	};

	/omit-if-no-ref/ i2s1_ck_pb7: i2s1_ck_pb7 {
		pinmux = <STM32_PINMUX('B', 7, AF6)>;
		slew-rate = "very-high-speed";
	};

	/omit-if-no-ref/ i2s2_ck_pa12: i2s2_ck_pa12 {
		pinmux = <STM32_PINMUX('A', 12, AF5)>;
		slew-rate = "very-high-speed";
	};

	/omit-if-no-ref/ i2s2_ck_pa5: i2s2_ck_pa5 {
		pinmux = <STM32_PINMUX('A', 5, AF6)>;
		slew-rate = "very-high-speed";
	};

	/omit-if-no-ref/ i2s2_ck_pa9: i2s2_ck_pa9 {
		pinmux = <STM32_PINMUX('A', 9, AF5)>;
		slew-rate = "very-high-speed";
	};

	/* I2S_WS */
	/omit-if-no-ref/ i2s1_ws_pa15: i2s1_ws_pa15 {
		pinmux = <STM32_PINMUX('A', 15, AF5)>;
	};

	/omit-if-no-ref/ i2s1_ws_pa4: i2s1_ws_pa4 {
		pinmux = <STM32_PINMUX('A', 4, AF5)>;
	};

	/omit-if-no-ref/ i2s1_ws_pb8: i2s1_ws_pb8 {
		pinmux = <STM32_PINMUX('B', 8, AF6)>;
	};

	/omit-if-no-ref/ i2s2_ws_pa0: i2s2_ws_pa0 {
		pinmux = <STM32_PINMUX('A', 0, AF9)>;
	};

	/omit-if-no-ref/ i2s2_ws_pa11: i2s2_ws_pa11 {
		pinmux = <STM32_PINMUX('A', 11, AF5)>;
	};

	/omit-if-no-ref/ i2s2_ws_pa15: i2s2_ws_pa15 {
		pinmux = <STM32_PINMUX('A', 15, AF6)>;
	};

	/omit-if-no-ref/ i2s2_ws_pa3: i2s2_ws_pa3 {
		pinmux = <STM32_PINMUX('A', 3, AF5)>;
	};

	/omit-if-no-ref/ i2s2_ws_pa4: i2s2_ws_pa4 {
		pinmux = <STM32_PINMUX('A', 4, AF6)>;
	};

	/omit-if-no-ref/ i2s2_ws_pb1: i2s2_ws_pb1 {
		pinmux = <STM32_PINMUX('B', 1, AF5)>;
	};

	/omit-if-no-ref/ i2s2_ws_pb4: i2s2_ws_pb4 {
		pinmux = <STM32_PINMUX('B', 4, AF7)>;
	};

	/* I2S_SDI */
	/omit-if-no-ref/ i2s1_sdi_pa6: i2s1_sdi_pa6 {
		pinmux = <STM32_PINMUX('A', 6, AF5)>;
	};

	/omit-if-no-ref/ i2s1_sdi_pb0: i2s1_sdi_pb0 {
		pinmux = <STM32_PINMUX('B', 0, AF5)>;
	};

	/omit-if-no-ref/ i2s1_sdi_pb4: i2s1_sdi_pb4 {
		pinmux = <STM32_PINMUX('B', 4, AF5)>;
	};

	/omit-if-no-ref/ i2s1_sdi_pb6: i2s1_sdi_pb6 {
		pinmux = <STM32_PINMUX('B', 6, AF6)>;
	};

	/omit-if-no-ref/ i2s2_sdi_pa7: i2s2_sdi_pa7 {
		pinmux = <STM32_PINMUX('A', 7, AF6)>;
	};

	/* I2S_SDO */
	/omit-if-no-ref/ i2s1_sdo_pa4: i2s1_sdo_pa4 {
		pinmux = <STM32_PINMUX('A', 4, AF4)>;
	};

	/omit-if-no-ref/ i2s1_sdo_pa7: i2s1_sdo_pa7 {
		pinmux = <STM32_PINMUX('A', 7, AF5)>;
	};

	/omit-if-no-ref/ i2s1_sdo_pb15: i2s1_sdo_pb15 {
		pinmux = <STM32_PINMUX('B', 15, AF6)>;
	};

	/omit-if-no-ref/ i2s1_sdo_pb5: i2s1_sdo_pb5 {
		pinmux = <STM32_PINMUX('B', 5, AF5)>;
	};

	/omit-if-no-ref/ i2s2_sdo_pa3: i2s2_sdo_pa3 {
		pinmux = <STM32_PINMUX('A', 3, AF6)>;
	};

	/omit-if-no-ref/ i2s2_sdo_pa8: i2s2_sdo_pa8 {
		pinmux = <STM32_PINMUX('A', 8, AF6)>;
	};

	/omit-if-no-ref/ i2s2_sdo_pb15: i2s2_sdo_pb15 {
		pinmux = <STM32_PINMUX('B', 15, AF5)>;
	};

	/* I3C_SCL */
	/omit-if-no-ref/ i3c1_scl_pa9: i3c1_scl_pa9 {
		pinmux = <STM32_PINMUX('A', 9, AF2)>;
		slew-rate = "very-high-speed";
	};

	/omit-if-no-ref/ i3c1_scl_pb4: i3c1_scl_pb4 {
		pinmux = <STM32_PINMUX('B', 4, AF3)>;
		slew-rate = "very-high-speed";
	};

	/omit-if-no-ref/ i3c1_scl_pb6: i3c1_scl_pb6 {
		pinmux = <STM32_PINMUX('B', 6, AF3)>;
		slew-rate = "very-high-speed";
	};

	/omit-if-no-ref/ i3c1_scl_pb8: i3c1_scl_pb8 {
		pinmux = <STM32_PINMUX('B', 8, AF3)>;
		slew-rate = "very-high-speed";
	};

	/* I3C_SDA */
	/omit-if-no-ref/ i3c1_sda_pa8: i3c1_sda_pa8 {
		pinmux = <STM32_PINMUX('A', 8, AF2)>;
		slew-rate = "very-high-speed";
	};

	/omit-if-no-ref/ i3c1_sda_pb3: i3c1_sda_pb3 {
		pinmux = <STM32_PINMUX('B', 3, AF3)>;
		slew-rate = "very-high-speed";
	};

	/omit-if-no-ref/ i3c1_sda_pb5: i3c1_sda_pb5 {
		pinmux = <STM32_PINMUX('B', 5, AF3)>;
		slew-rate = "very-high-speed";
	};

	/omit-if-no-ref/ i3c1_sda_pb7: i3c1_sda_pb7 {
		pinmux = <STM32_PINMUX('B', 7, AF3)>;
		slew-rate = "very-high-speed";
	};

	/* JTAG PORT */
	/omit-if-no-ref/ debug_jtdi_pa15: debug_jtdi_pa15 {
		pinmux = <STM32_PINMUX('A', 15, AF0)>;
	};

	/omit-if-no-ref/ debug_jtdo_pb3: debug_jtdo_pb3 {
		pinmux = <STM32_PINMUX('B', 3, AF0)>;
	};

	/omit-if-no-ref/ debug_njtrst_pb4: debug_njtrst_pb4 {
		pinmux = <STM32_PINMUX('B', 4, AF0)>;
	};

	/omit-if-no-ref/ debug_swclk_pa14: debug_swclk_pa14 {
		pinmux = <STM32_PINMUX('A', 14, AF0)>;
	};

	/omit-if-no-ref/ debug_swdio_pa13: debug_swdio_pa13 {
		pinmux = <STM32_PINMUX('A', 13, AF0)>;
	};

	/omit-if-no-ref/ debug_traceswo_pb3: debug_traceswo_pb3 {
		pinmux = <STM32_PINMUX('B', 3, AF0)>;
	};

	/* OPAMP */
	/omit-if-no-ref/ opamp1_vout_pa6: opamp1_vout_pa6 {
		pinmux = <STM32_PINMUX('A', 6, ANALOG)>;
	};

	/* RCC_MCO */
	/omit-if-no-ref/ rcc_mco1_pa8: rcc_mco1_pa8 {
		pinmux = <STM32_PINMUX('A', 8, AF0)>;
		slew-rate = "very-high-speed";
	};

	/omit-if-no-ref/ rcc_mco1_ph2: rcc_mco1_ph2 {
		pinmux = <STM32_PINMUX('H', 2, AF0)>;
		slew-rate = "very-high-speed";
	};

	/omit-if-no-ref/ rcc_mco2_pa9: rcc_mco2_pa9 {
		pinmux = <STM32_PINMUX('A', 9, AF0)>;
		slew-rate = "very-high-speed";
	};

	/* SPI_MISO */
	/omit-if-no-ref/ spi1_miso_pa6: spi1_miso_pa6 {
		pinmux = <STM32_PINMUX('A', 6, AF5)>;
		bias-pull-down;
	};

	/omit-if-no-ref/ spi1_miso_pb0: spi1_miso_pb0 {
		pinmux = <STM32_PINMUX('B', 0, AF5)>;
		bias-pull-down;
	};

	/omit-if-no-ref/ spi1_miso_pb4: spi1_miso_pb4 {
		pinmux = <STM32_PINMUX('B', 4, AF5)>;
		bias-pull-down;
	};

	/omit-if-no-ref/ spi1_miso_pb6: spi1_miso_pb6 {
		pinmux = <STM32_PINMUX('B', 6, AF6)>;
		bias-pull-down;
	};

	/omit-if-no-ref/ spi2_miso_pa7: spi2_miso_pa7 {
		pinmux = <STM32_PINMUX('A', 7, AF6)>;
		bias-pull-down;
	};

	/* SPI_MOSI */
	/omit-if-no-ref/ spi1_mosi_pa4: spi1_mosi_pa4 {
		pinmux = <STM32_PINMUX('A', 4, AF4)>;
		bias-pull-down;
	};

	/omit-if-no-ref/ spi1_mosi_pa7: spi1_mosi_pa7 {
		pinmux = <STM32_PINMUX('A', 7, AF5)>;
		bias-pull-down;
	};

	/omit-if-no-ref/ spi1_mosi_pb15: spi1_mosi_pb15 {
		pinmux = <STM32_PINMUX('B', 15, AF6)>;
		bias-pull-down;
	};

	/omit-if-no-ref/ spi1_mosi_pb5: spi1_mosi_pb5 {
		pinmux = <STM32_PINMUX('B', 5, AF5)>;
		bias-pull-down;
	};

	/omit-if-no-ref/ spi2_mosi_pa3: spi2_mosi_pa3 {
		pinmux = <STM32_PINMUX('A', 3, AF6)>;
		bias-pull-down;
	};

	/omit-if-no-ref/ spi2_mosi_pa8: spi2_mosi_pa8 {
		pinmux = <STM32_PINMUX('A', 8, AF6)>;
		bias-pull-down;
	};

	/omit-if-no-ref/ spi2_mosi_pb15: spi2_mosi_pb15 {
		pinmux = <STM32_PINMUX('B', 15, AF5)>;
		bias-pull-down;
	};

	/* SPI_SCK */
	/omit-if-no-ref/ spi1_sck_pa5: spi1_sck_pa5 {
		pinmux = <STM32_PINMUX('A', 5, AF5)>;
		bias-pull-down;
		slew-rate = "very-high-speed";
	};

	/omit-if-no-ref/ spi1_sck_pb3: spi1_sck_pb3 {
		pinmux = <STM32_PINMUX('B', 3, AF5)>;
		bias-pull-down;
		slew-rate = "very-high-speed";
	};

	/omit-if-no-ref/ spi1_sck_pb7: spi1_sck_pb7 {
		pinmux = <STM32_PINMUX('B', 7, AF6)>;
		bias-pull-down;
		slew-rate = "very-high-speed";
	};

	/omit-if-no-ref/ spi2_sck_pa12: spi2_sck_pa12 {
		pinmux = <STM32_PINMUX('A', 12, AF5)>;
		bias-pull-down;
		slew-rate = "very-high-speed";
	};

	/omit-if-no-ref/ spi2_sck_pa5: spi2_sck_pa5 {
		pinmux = <STM32_PINMUX('A', 5, AF6)>;
		bias-pull-down;
		slew-rate = "very-high-speed";
	};

	/omit-if-no-ref/ spi2_sck_pa9: spi2_sck_pa9 {
		pinmux = <STM32_PINMUX('A', 9, AF5)>;
		bias-pull-down;
		slew-rate = "very-high-speed";
	};

	/* SPI_NSS */
	/omit-if-no-ref/ spi1_nss_pa15: spi1_nss_pa15 {
		pinmux = <STM32_PINMUX('A', 15, AF5)>;
		bias-pull-up;
	};

	/omit-if-no-ref/ spi1_nss_pa4: spi1_nss_pa4 {
		pinmux = <STM32_PINMUX('A', 4, AF5)>;
		bias-pull-up;
	};

	/omit-if-no-ref/ spi1_nss_pb8: spi1_nss_pb8 {
		pinmux = <STM32_PINMUX('B', 8, AF6)>;
		bias-pull-up;
	};

	/omit-if-no-ref/ spi2_nss_pa0: spi2_nss_pa0 {
		pinmux = <STM32_PINMUX('A', 0, AF9)>;
		bias-pull-up;
	};

	/omit-if-no-ref/ spi2_nss_pa11: spi2_nss_pa11 {
		pinmux = <STM32_PINMUX('A', 11, AF5)>;
		bias-pull-up;
	};

	/omit-if-no-ref/ spi2_nss_pa15: spi2_nss_pa15 {
		pinmux = <STM32_PINMUX('A', 15, AF6)>;
		bias-pull-up;
	};

	/omit-if-no-ref/ spi2_nss_pa3: spi2_nss_pa3 {
		pinmux = <STM32_PINMUX('A', 3, AF5)>;
		bias-pull-up;
	};

	/omit-if-no-ref/ spi2_nss_pa4: spi2_nss_pa4 {
		pinmux = <STM32_PINMUX('A', 4, AF6)>;
		bias-pull-up;
	};

	/omit-if-no-ref/ spi2_nss_pb1: spi2_nss_pb1 {
		pinmux = <STM32_PINMUX('B', 1, AF5)>;
		bias-pull-up;
	};

	/omit-if-no-ref/ spi2_nss_pb4: spi2_nss_pb4 {
		pinmux = <STM32_PINMUX('B', 4, AF7)>;
		bias-pull-up;
	};

	/* TIM_BKIN */
	/omit-if-no-ref/ tim15_bkin_pa0: tim15_bkin_pa0 {
		pinmux = <STM32_PINMUX('A', 0, AF4)>;
	};

	/omit-if-no-ref/ tim1_bkin_pa6: tim1_bkin_pa6 {
		pinmux = <STM32_PINMUX('A', 6, AF1)>;
	};

	/omit-if-no-ref/ tim1_bkin2_pa4: tim1_bkin2_pa4 {
		pinmux = <STM32_PINMUX('A', 4, AF1)>;
	};

	/omit-if-no-ref/ tim8_bkin_pa1: tim8_bkin_pa1 {
		pinmux = <STM32_PINMUX('A', 1, AF3)>;
	};

	/omit-if-no-ref/ tim8_bkin_pa6: tim8_bkin_pa6 {
		pinmux = <STM32_PINMUX('A', 6, AF3)>;
	};

	/omit-if-no-ref/ tim8_bkin2_pa8: tim8_bkin2_pa8 {
		pinmux = <STM32_PINMUX('A', 8, AF3)>;
	};

	/* TIM_CH / TIM_CHN */
	/omit-if-no-ref/ tim12_ch1_pc14: tim12_ch1_pc14 {
		pinmux = <STM32_PINMUX('C', 14, AF2)>;
	};

	/omit-if-no-ref/ tim12_ch2_pb15: tim12_ch2_pb15 {
		pinmux = <STM32_PINMUX('B', 15, AF2)>;
	};

	/omit-if-no-ref/ tim15_ch1_pa2: tim15_ch1_pa2 {
		pinmux = <STM32_PINMUX('A', 2, AF4)>;
	};

	/omit-if-no-ref/ tim15_ch1_pa7: tim15_ch1_pa7 {
		pinmux = <STM32_PINMUX('A', 7, AF4)>;
	};

	/omit-if-no-ref/ tim15_ch1_pb4: tim15_ch1_pb4 {
		pinmux = <STM32_PINMUX('B', 4, AF2)>;
	};

	/omit-if-no-ref/ tim15_ch1n_pa1: tim15_ch1n_pa1 {
		pinmux = <STM32_PINMUX('A', 1, AF4)>;
	};

	/omit-if-no-ref/ tim15_ch1n_pa9: tim15_ch1n_pa9 {
		pinmux = <STM32_PINMUX('A', 9, AF4)>;
	};

	/omit-if-no-ref/ tim15_ch2_pa3: tim15_ch2_pa3 {
		pinmux = <STM32_PINMUX('A', 3, AF4)>;
	};

	/omit-if-no-ref/ tim15_ch2_pa8: tim15_ch2_pa8 {
		pinmux = <STM32_PINMUX('A', 8, AF4)>;
	};

	/omit-if-no-ref/ tim1_ch1_pa8: tim1_ch1_pa8 {
		pinmux = <STM32_PINMUX('A', 8, AF1)>;
	};

	/omit-if-no-ref/ tim1_ch1_pb8: tim1_ch1_pb8 {
		pinmux = <STM32_PINMUX('B', 8, AF1)>;
	};

	/omit-if-no-ref/ tim1_ch1n_pa7: tim1_ch1n_pa7 {
		pinmux = <STM32_PINMUX('A', 7, AF1)>;
	};

	/omit-if-no-ref/ tim1_ch2_pa9: tim1_ch2_pa9 {
		pinmux = <STM32_PINMUX('A', 9, AF1)>;
	};

	/omit-if-no-ref/ tim1_ch2n_pa15: tim1_ch2n_pa15 {
		pinmux = <STM32_PINMUX('A', 15, AF2)>;
	};

	/omit-if-no-ref/ tim1_ch2n_pb0: tim1_ch2n_pb0 {
		pinmux = <STM32_PINMUX('B', 0, AF1)>;
	};

	/omit-if-no-ref/ tim1_ch3_pa5: tim1_ch3_pa5 {
		pinmux = <STM32_PINMUX('A', 5, AF2)>;
	};

	/omit-if-no-ref/ tim1_ch3n_pb1: tim1_ch3n_pb1 {
		pinmux = <STM32_PINMUX('B', 1, AF1)>;
	};

	/omit-if-no-ref/ tim1_ch3n_pb15: tim1_ch3n_pb15 {
		pinmux = <STM32_PINMUX('B', 15, AF1)>;
	};

	/omit-if-no-ref/ tim1_ch4_pa11: tim1_ch4_pa11 {
		pinmux = <STM32_PINMUX('A', 11, AF1)>;
	};

	/omit-if-no-ref/ tim2_ch1_pa0: tim2_ch1_pa0 {
		pinmux = <STM32_PINMUX('A', 0, AF1)>;
	};

	/omit-if-no-ref/ tim2_ch1_pa15: tim2_ch1_pa15 {
		pinmux = <STM32_PINMUX('A', 15, AF1)>;
	};

	/omit-if-no-ref/ tim2_ch1_pa5: tim2_ch1_pa5 {
		pinmux = <STM32_PINMUX('A', 5, AF1)>;
	};

	/omit-if-no-ref/ tim2_ch2_pa1: tim2_ch2_pa1 {
		pinmux = <STM32_PINMUX('A', 1, AF1)>;
	};

	/omit-if-no-ref/ tim2_ch2_pb3: tim2_ch2_pb3 {
		pinmux = <STM32_PINMUX('B', 3, AF1)>;
	};

	/omit-if-no-ref/ tim2_ch3_pa2: tim2_ch3_pa2 {
		pinmux = <STM32_PINMUX('A', 2, AF1)>;
	};

	/omit-if-no-ref/ tim2_ch4_pa3: tim2_ch4_pa3 {
		pinmux = <STM32_PINMUX('A', 3, AF1)>;
	};

	/omit-if-no-ref/ tim2_ch4_pa8: tim2_ch4_pa8 {
		pinmux = <STM32_PINMUX('A', 8, AF14)>;
	};

	/omit-if-no-ref/ tim8_ch1_pb3: tim8_ch1_pb3 {
		pinmux = <STM32_PINMUX('B', 3, AF13)>;
	};

	/omit-if-no-ref/ tim8_ch1n_pa5: tim8_ch1n_pa5 {
		pinmux = <STM32_PINMUX('A', 5, AF3)>;
	};

	/omit-if-no-ref/ tim8_ch1n_pa7: tim8_ch1n_pa7 {
		pinmux = <STM32_PINMUX('A', 7, AF3)>;
	};

	/omit-if-no-ref/ tim8_ch2_pb4: tim8_ch2_pb4 {
		pinmux = <STM32_PINMUX('B', 4, AF13)>;
	};

	/omit-if-no-ref/ tim8_ch2n_pa9: tim8_ch2n_pa9 {
		pinmux = <STM32_PINMUX('A', 9, AF13)>;
	};

	/omit-if-no-ref/ tim8_ch2n_pb0: tim8_ch2n_pb0 {
		pinmux = <STM32_PINMUX('B', 0, AF3)>;
	};

	/omit-if-no-ref/ tim8_ch3_pb5: tim8_ch3_pb5 {
		pinmux = <STM32_PINMUX('B', 5, AF13)>;
	};

	/omit-if-no-ref/ tim8_ch3n_pb1: tim8_ch3n_pb1 {
		pinmux = <STM32_PINMUX('B', 1, AF3)>;
	};

	/omit-if-no-ref/ tim8_ch3n_pb15: tim8_ch3n_pb15 {
		pinmux = <STM32_PINMUX('B', 15, AF3)>;
	};

	/omit-if-no-ref/ tim8_ch4_pb6: tim8_ch4_pb6 {
		pinmux = <STM32_PINMUX('B', 6, AF13)>;
	};

	/omit-if-no-ref/ tim8_ch4n_pa15: tim8_ch4n_pa15 {
		pinmux = <STM32_PINMUX('A', 15, AF13)>;
	};

	/* UART_CTS / USART_CTS / LPUART_CTS */
	/omit-if-no-ref/ lpuart1_cts_pa11: lpuart1_cts_pa11 {
		pinmux = <STM32_PINMUX('A', 11, AF3)>;
		bias-pull-up;
	};

	/omit-if-no-ref/ lpuart1_cts_pa7: lpuart1_cts_pa7 {
		pinmux = <STM32_PINMUX('A', 7, AF8)>;
		bias-pull-up;
	};

	/omit-if-no-ref/ lpuart1_cts_pb4: lpuart1_cts_pb4 {
		pinmux = <STM32_PINMUX('B', 4, AF8)>;
		bias-pull-up;
	};

	/omit-if-no-ref/ uart4_cts_pb0: uart4_cts_pb0 {
		pinmux = <STM32_PINMUX('B', 0, AF8)>;
		bias-pull-up;
	};

	/omit-if-no-ref/ uart4_cts_pb15: uart4_cts_pb15 {
		pinmux = <STM32_PINMUX('B', 15, AF8)>;
		bias-pull-up;
	};

	/omit-if-no-ref/ uart5_cts_pb4: uart5_cts_pb4 {
		pinmux = <STM32_PINMUX('B', 4, AF14)>;
		bias-pull-up;
	};

	/omit-if-no-ref/ usart1_cts_pa11: usart1_cts_pa11 {
		pinmux = <STM32_PINMUX('A', 11, AF7)>;
		bias-pull-up;
	};

	/omit-if-no-ref/ usart1_cts_pa5: usart1_cts_pa5 {
		pinmux = <STM32_PINMUX('A', 5, AF7)>;
		bias-pull-up;
	};

	/omit-if-no-ref/ usart1_cts_pb6: usart1_cts_pb6 {
		pinmux = <STM32_PINMUX('B', 6, AF11)>;
		bias-pull-up;
	};

	/omit-if-no-ref/ usart2_cts_pa0: usart2_cts_pa0 {
		pinmux = <STM32_PINMUX('A', 0, AF7)>;
		bias-pull-up;
	};

	/* UART_RTS / USART_RTS / LPUART_RTS */
	/omit-if-no-ref/ lpuart1_rts_pa12: lpuart1_rts_pa12 {
		pinmux = <STM32_PINMUX('A', 12, AF3)>;
		drive-push-pull;
	};

	/omit-if-no-ref/ lpuart1_rts_pa6: lpuart1_rts_pa6 {
		pinmux = <STM32_PINMUX('A', 6, AF8)>;
		drive-push-pull;
	};

	/omit-if-no-ref/ lpuart1_rts_pb5: lpuart1_rts_pb5 {
		pinmux = <STM32_PINMUX('B', 5, AF8)>;
		drive-push-pull;
	};

	/omit-if-no-ref/ uart4_rts_pa15: uart4_rts_pa15 {
		pinmux = <STM32_PINMUX('A', 15, AF8)>;
		drive-push-pull;
	};

	/omit-if-no-ref/ uart5_rts_pb3: uart5_rts_pb3 {
		pinmux = <STM32_PINMUX('B', 3, AF14)>;
		drive-push-pull;
	};

	/omit-if-no-ref/ usart1_rts_pa12: usart1_rts_pa12 {
		pinmux = <STM32_PINMUX('A', 12, AF7)>;
		drive-push-pull;
	};

	/omit-if-no-ref/ usart1_rts_pb7: usart1_rts_pb7 {
		pinmux = <STM32_PINMUX('B', 7, AF11)>;
		drive-push-pull;
	};

	/omit-if-no-ref/ usart2_rts_pa1: usart2_rts_pa1 {
		pinmux = <STM32_PINMUX('A', 1, AF7)>;
		drive-push-pull;
	};

	/* UART_TX / USART_TX / LPUART_TX */
	/omit-if-no-ref/ lpuart1_tx_pa3: lpuart1_tx_pa3 {
		pinmux = <STM32_PINMUX('A', 3, AF3)>;
		bias-pull-up;
	};

	/omit-if-no-ref/ lpuart1_tx_pa9: lpuart1_tx_pa9 {
		pinmux = <STM32_PINMUX('A', 9, AF3)>;
		bias-pull-up;
	};

	/omit-if-no-ref/ lpuart1_tx_pb3: lpuart1_tx_pb3 {
		pinmux = <STM32_PINMUX('B', 3, AF8)>;
		bias-pull-up;
	};

	/omit-if-no-ref/ lpuart1_tx_pb6: lpuart1_tx_pb6 {
		pinmux = <STM32_PINMUX('B', 6, AF8)>;
		bias-pull-up;
	};

	/omit-if-no-ref/ uart4_tx_pa0: uart4_tx_pa0 {
		pinmux = <STM32_PINMUX('A', 0, AF8)>;
		bias-pull-up;
	};

	/omit-if-no-ref/ uart4_tx_pa12: uart4_tx_pa12 {
		pinmux = <STM32_PINMUX('A', 12, AF6)>;
		bias-pull-up;
	};

	/omit-if-no-ref/ uart5_tx_pb6: uart5_tx_pb6 {
		pinmux = <STM32_PINMUX('B', 6, AF14)>;
		bias-pull-up;
	};

	/omit-if-no-ref/ usart1_tx_pa15: usart1_tx_pa15 {
		pinmux = <STM32_PINMUX('A', 15, AF11)>;
		bias-pull-up;
	};

	/omit-if-no-ref/ usart1_tx_pa6: usart1_tx_pa6 {
		pinmux = <STM32_PINMUX('A', 6, AF7)>;
		bias-pull-up;
	};

	/omit-if-no-ref/ usart1_tx_pa9: usart1_tx_pa9 {
		pinmux = <STM32_PINMUX('A', 9, AF7)>;
		bias-pull-up;
	};

	/omit-if-no-ref/ usart1_tx_pb3: usart1_tx_pb3 {
		pinmux = <STM32_PINMUX('B', 3, AF11)>;
		bias-pull-up;
	};

	/omit-if-no-ref/ usart1_tx_pb6: usart1_tx_pb6 {
		pinmux = <STM32_PINMUX('B', 6, AF7)>;
		bias-pull-up;
	};

	/omit-if-no-ref/ usart2_tx_pa11: usart2_tx_pa11 {
		pinmux = <STM32_PINMUX('A', 11, AF4)>;
		bias-pull-up;
	};

	/omit-if-no-ref/ usart2_tx_pa2: usart2_tx_pa2 {
		pinmux = <STM32_PINMUX('A', 2, AF7)>;
		bias-pull-up;
	};

	/omit-if-no-ref/ usart2_tx_pb0: usart2_tx_pb0 {
		pinmux = <STM32_PINMUX('B', 0, AF7)>;
		bias-pull-up;
	};

	/* UART_RX / USART_RX / LPUART_RX */
	/omit-if-no-ref/ lpuart1_rx_pa2: lpuart1_rx_pa2 {
		pinmux = <STM32_PINMUX('A', 2, AF3)>;
	};

	/omit-if-no-ref/ lpuart1_rx_pb7: lpuart1_rx_pb7 {
		pinmux = <STM32_PINMUX('B', 7, AF8)>;
	};

	/omit-if-no-ref/ uart4_rx_pa1: uart4_rx_pa1 {
		pinmux = <STM32_PINMUX('A', 1, AF8)>;
	};

	/omit-if-no-ref/ uart4_rx_pa11: uart4_rx_pa11 {
		pinmux = <STM32_PINMUX('A', 11, AF6)>;
	};

	/omit-if-no-ref/ uart4_rx_pb8: uart4_rx_pb8 {
		pinmux = <STM32_PINMUX('B', 8, AF8)>;
	};

	/omit-if-no-ref/ uart5_rx_pb15: uart5_rx_pb15 {
		pinmux = <STM32_PINMUX('B', 15, AF14)>;
	};

	/omit-if-no-ref/ uart5_rx_pb5: uart5_rx_pb5 {
		pinmux = <STM32_PINMUX('B', 5, AF14)>;
	};

	/omit-if-no-ref/ usart1_rx_pa7: usart1_rx_pa7 {
		pinmux = <STM32_PINMUX('A', 7, AF7)>;
	};

	/omit-if-no-ref/ usart1_rx_pb15: usart1_rx_pb15 {
		pinmux = <STM32_PINMUX('B', 15, AF4)>;
	};

	/omit-if-no-ref/ usart1_rx_pb4: usart1_rx_pb4 {
		pinmux = <STM32_PINMUX('B', 4, AF11)>;
	};

	/omit-if-no-ref/ usart1_rx_pb7: usart1_rx_pb7 {
		pinmux = <STM32_PINMUX('B', 7, AF7)>;
	};

	/omit-if-no-ref/ usart2_rx_pa12: usart2_rx_pa12 {
		pinmux = <STM32_PINMUX('A', 12, AF4)>;
	};

	/omit-if-no-ref/ usart2_rx_pa3: usart2_rx_pa3 {
		pinmux = <STM32_PINMUX('A', 3, AF7)>;
	};

	/omit-if-no-ref/ usart2_rx_pb1: usart2_rx_pb1 {
		pinmux = <STM32_PINMUX('B', 1, AF7)>;
	};

	/* USB */
	/omit-if-no-ref/ usb_dm_pa11: usb_dm_pa11 {
		pinmux = <STM32_PINMUX('A', 11, ANALOG)>;
	};

	/omit-if-no-ref/ usb_dp_pa12: usb_dp_pa12 {
		pinmux = <STM32_PINMUX('A', 12, ANALOG)>;
	};

	/omit-if-no-ref/ usb_sof_pa8: usb_sof_pa8 {
		pinmux = <STM32_PINMUX('A', 8, AF13)>;
	};

};