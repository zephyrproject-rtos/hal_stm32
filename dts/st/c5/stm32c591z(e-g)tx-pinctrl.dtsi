/*
 * NOTE: Autogenerated file using genpinctrl_hal2.py
 *
 * SPDX-License-Identifier: Apache-2.0
 */


#include <zephyr/dt-bindings/pinctrl/stm32-pinctrl.h>

&pinctrl {

	/* Analog */
	/omit-if-no-ref/ analog_pa0: analog_pa0 {
		pinmux = <STM32_PINMUX('A', 0, ANALOG)>;
	};

	/omit-if-no-ref/ analog_pa1: analog_pa1 {
		pinmux = <STM32_PINMUX('A', 1, ANALOG)>;
	};

	/omit-if-no-ref/ analog_pa2: analog_pa2 {
		pinmux = <STM32_PINMUX('A', 2, ANALOG)>;
	};

	/omit-if-no-ref/ analog_pa3: analog_pa3 {
		pinmux = <STM32_PINMUX('A', 3, ANALOG)>;
	};

	/omit-if-no-ref/ analog_pa4: analog_pa4 {
		pinmux = <STM32_PINMUX('A', 4, ANALOG)>;
	};

	/omit-if-no-ref/ analog_pa5: analog_pa5 {
		pinmux = <STM32_PINMUX('A', 5, ANALOG)>;
	};

	/omit-if-no-ref/ analog_pa6: analog_pa6 {
		pinmux = <STM32_PINMUX('A', 6, ANALOG)>;
	};

	/omit-if-no-ref/ analog_pa7: analog_pa7 {
		pinmux = <STM32_PINMUX('A', 7, ANALOG)>;
	};

	/omit-if-no-ref/ analog_pa8: analog_pa8 {
		pinmux = <STM32_PINMUX('A', 8, ANALOG)>;
	};

	/omit-if-no-ref/ analog_pa9: analog_pa9 {
		pinmux = <STM32_PINMUX('A', 9, ANALOG)>;
	};

	/omit-if-no-ref/ analog_pa10: analog_pa10 {
		pinmux = <STM32_PINMUX('A', 10, ANALOG)>;
	};

	/omit-if-no-ref/ analog_pa11: analog_pa11 {
		pinmux = <STM32_PINMUX('A', 11, ANALOG)>;
	};

	/omit-if-no-ref/ analog_pa12: analog_pa12 {
		pinmux = <STM32_PINMUX('A', 12, ANALOG)>;
	};

	/omit-if-no-ref/ analog_pa13: analog_pa13 {
		pinmux = <STM32_PINMUX('A', 13, ANALOG)>;
	};

	/omit-if-no-ref/ analog_pa14: analog_pa14 {
		pinmux = <STM32_PINMUX('A', 14, ANALOG)>;
	};

	/omit-if-no-ref/ analog_pa15: analog_pa15 {
		pinmux = <STM32_PINMUX('A', 15, ANALOG)>;
	};

	/omit-if-no-ref/ analog_pb0: analog_pb0 {
		pinmux = <STM32_PINMUX('B', 0, ANALOG)>;
	};

	/omit-if-no-ref/ analog_pb1: analog_pb1 {
		pinmux = <STM32_PINMUX('B', 1, ANALOG)>;
	};

	/omit-if-no-ref/ analog_pb2: analog_pb2 {
		pinmux = <STM32_PINMUX('B', 2, ANALOG)>;
	};

	/omit-if-no-ref/ analog_pb3: analog_pb3 {
		pinmux = <STM32_PINMUX('B', 3, ANALOG)>;
	};

	/omit-if-no-ref/ analog_pb4: analog_pb4 {
		pinmux = <STM32_PINMUX('B', 4, ANALOG)>;
	};

	/omit-if-no-ref/ analog_pb5: analog_pb5 {
		pinmux = <STM32_PINMUX('B', 5, ANALOG)>;
	};

	/omit-if-no-ref/ analog_pb6: analog_pb6 {
		pinmux = <STM32_PINMUX('B', 6, ANALOG)>;
	};

	/omit-if-no-ref/ analog_pb7: analog_pb7 {
		pinmux = <STM32_PINMUX('B', 7, ANALOG)>;
	};

	/omit-if-no-ref/ analog_pb8: analog_pb8 {
		pinmux = <STM32_PINMUX('B', 8, ANALOG)>;
	};

	/omit-if-no-ref/ analog_pb9: analog_pb9 {
		pinmux = <STM32_PINMUX('B', 9, ANALOG)>;
	};

	/omit-if-no-ref/ analog_pb10: analog_pb10 {
		pinmux = <STM32_PINMUX('B', 10, ANALOG)>;
	};

	/omit-if-no-ref/ analog_pb12: analog_pb12 {
		pinmux = <STM32_PINMUX('B', 12, ANALOG)>;
	};

	/omit-if-no-ref/ analog_pb13: analog_pb13 {
		pinmux = <STM32_PINMUX('B', 13, ANALOG)>;
	};

	/omit-if-no-ref/ analog_pb14: analog_pb14 {
		pinmux = <STM32_PINMUX('B', 14, ANALOG)>;
	};

	/omit-if-no-ref/ analog_pb15: analog_pb15 {
		pinmux = <STM32_PINMUX('B', 15, ANALOG)>;
	};

	/omit-if-no-ref/ analog_pc0: analog_pc0 {
		pinmux = <STM32_PINMUX('C', 0, ANALOG)>;
	};

	/omit-if-no-ref/ analog_pc1: analog_pc1 {
		pinmux = <STM32_PINMUX('C', 1, ANALOG)>;
	};

	/omit-if-no-ref/ analog_pc2: analog_pc2 {
		pinmux = <STM32_PINMUX('C', 2, ANALOG)>;
	};

	/omit-if-no-ref/ analog_pc3: analog_pc3 {
		pinmux = <STM32_PINMUX('C', 3, ANALOG)>;
	};

	/omit-if-no-ref/ analog_pc4: analog_pc4 {
		pinmux = <STM32_PINMUX('C', 4, ANALOG)>;
	};

	/omit-if-no-ref/ analog_pc5: analog_pc5 {
		pinmux = <STM32_PINMUX('C', 5, ANALOG)>;
	};

	/omit-if-no-ref/ analog_pc6: analog_pc6 {
		pinmux = <STM32_PINMUX('C', 6, ANALOG)>;
	};

	/omit-if-no-ref/ analog_pc7: analog_pc7 {
		pinmux = <STM32_PINMUX('C', 7, ANALOG)>;
	};

	/omit-if-no-ref/ analog_pc8: analog_pc8 {
		pinmux = <STM32_PINMUX('C', 8, ANALOG)>;
	};

	/omit-if-no-ref/ analog_pc9: analog_pc9 {
		pinmux = <STM32_PINMUX('C', 9, ANALOG)>;
	};

	/omit-if-no-ref/ analog_pc10: analog_pc10 {
		pinmux = <STM32_PINMUX('C', 10, ANALOG)>;
	};

	/omit-if-no-ref/ analog_pc11: analog_pc11 {
		pinmux = <STM32_PINMUX('C', 11, ANALOG)>;
	};

	/omit-if-no-ref/ analog_pc12: analog_pc12 {
		pinmux = <STM32_PINMUX('C', 12, ANALOG)>;
	};

	/omit-if-no-ref/ analog_pc13: analog_pc13 {
		pinmux = <STM32_PINMUX('C', 13, ANALOG)>;
	};

	/omit-if-no-ref/ analog_pc14: analog_pc14 {
		pinmux = <STM32_PINMUX('C', 14, ANALOG)>;
	};

	/omit-if-no-ref/ analog_pc15: analog_pc15 {
		pinmux = <STM32_PINMUX('C', 15, ANALOG)>;
	};

	/omit-if-no-ref/ analog_pd0: analog_pd0 {
		pinmux = <STM32_PINMUX('D', 0, ANALOG)>;
	};

	/omit-if-no-ref/ analog_pd1: analog_pd1 {
		pinmux = <STM32_PINMUX('D', 1, ANALOG)>;
	};

	/omit-if-no-ref/ analog_pd2: analog_pd2 {
		pinmux = <STM32_PINMUX('D', 2, ANALOG)>;
	};

	/omit-if-no-ref/ analog_pd3: analog_pd3 {
		pinmux = <STM32_PINMUX('D', 3, ANALOG)>;
	};

	/omit-if-no-ref/ analog_pd4: analog_pd4 {
		pinmux = <STM32_PINMUX('D', 4, ANALOG)>;
	};

	/omit-if-no-ref/ analog_pd5: analog_pd5 {
		pinmux = <STM32_PINMUX('D', 5, ANALOG)>;
	};

	/omit-if-no-ref/ analog_pd6: analog_pd6 {
		pinmux = <STM32_PINMUX('D', 6, ANALOG)>;
	};

	/omit-if-no-ref/ analog_pd7: analog_pd7 {
		pinmux = <STM32_PINMUX('D', 7, ANALOG)>;
	};

	/omit-if-no-ref/ analog_pd8: analog_pd8 {
		pinmux = <STM32_PINMUX('D', 8, ANALOG)>;
	};

	/omit-if-no-ref/ analog_pd9: analog_pd9 {
		pinmux = <STM32_PINMUX('D', 9, ANALOG)>;
	};

	/omit-if-no-ref/ analog_pd10: analog_pd10 {
		pinmux = <STM32_PINMUX('D', 10, ANALOG)>;
	};

	/omit-if-no-ref/ analog_pd11: analog_pd11 {
		pinmux = <STM32_PINMUX('D', 11, ANALOG)>;
	};

	/omit-if-no-ref/ analog_pd12: analog_pd12 {
		pinmux = <STM32_PINMUX('D', 12, ANALOG)>;
	};

	/omit-if-no-ref/ analog_pd13: analog_pd13 {
		pinmux = <STM32_PINMUX('D', 13, ANALOG)>;
	};

	/omit-if-no-ref/ analog_pd14: analog_pd14 {
		pinmux = <STM32_PINMUX('D', 14, ANALOG)>;
	};

	/omit-if-no-ref/ analog_pd15: analog_pd15 {
		pinmux = <STM32_PINMUX('D', 15, ANALOG)>;
	};

	/omit-if-no-ref/ analog_pe0: analog_pe0 {
		pinmux = <STM32_PINMUX('E', 0, ANALOG)>;
	};

	/omit-if-no-ref/ analog_pe1: analog_pe1 {
		pinmux = <STM32_PINMUX('E', 1, ANALOG)>;
	};

	/omit-if-no-ref/ analog_pe2: analog_pe2 {
		pinmux = <STM32_PINMUX('E', 2, ANALOG)>;
	};

	/omit-if-no-ref/ analog_pe3: analog_pe3 {
		pinmux = <STM32_PINMUX('E', 3, ANALOG)>;
	};

	/omit-if-no-ref/ analog_pe4: analog_pe4 {
		pinmux = <STM32_PINMUX('E', 4, ANALOG)>;
	};

	/omit-if-no-ref/ analog_pe5: analog_pe5 {
		pinmux = <STM32_PINMUX('E', 5, ANALOG)>;
	};

	/omit-if-no-ref/ analog_pe6: analog_pe6 {
		pinmux = <STM32_PINMUX('E', 6, ANALOG)>;
	};

	/omit-if-no-ref/ analog_pe7: analog_pe7 {
		pinmux = <STM32_PINMUX('E', 7, ANALOG)>;
	};

	/omit-if-no-ref/ analog_pe8: analog_pe8 {
		pinmux = <STM32_PINMUX('E', 8, ANALOG)>;
	};

	/omit-if-no-ref/ analog_pe9: analog_pe9 {
		pinmux = <STM32_PINMUX('E', 9, ANALOG)>;
	};

	/omit-if-no-ref/ analog_pe10: analog_pe10 {
		pinmux = <STM32_PINMUX('E', 10, ANALOG)>;
	};

	/omit-if-no-ref/ analog_pe11: analog_pe11 {
		pinmux = <STM32_PINMUX('E', 11, ANALOG)>;
	};

	/omit-if-no-ref/ analog_pe12: analog_pe12 {
		pinmux = <STM32_PINMUX('E', 12, ANALOG)>;
	};

	/omit-if-no-ref/ analog_pe13: analog_pe13 {
		pinmux = <STM32_PINMUX('E', 13, ANALOG)>;
	};

	/omit-if-no-ref/ analog_pe14: analog_pe14 {
		pinmux = <STM32_PINMUX('E', 14, ANALOG)>;
	};

	/omit-if-no-ref/ analog_pe15: analog_pe15 {
		pinmux = <STM32_PINMUX('E', 15, ANALOG)>;
	};

	/omit-if-no-ref/ analog_pf0: analog_pf0 {
		pinmux = <STM32_PINMUX('F', 0, ANALOG)>;
	};

	/omit-if-no-ref/ analog_pf1: analog_pf1 {
		pinmux = <STM32_PINMUX('F', 1, ANALOG)>;
	};

	/omit-if-no-ref/ analog_pf2: analog_pf2 {
		pinmux = <STM32_PINMUX('F', 2, ANALOG)>;
	};

	/omit-if-no-ref/ analog_pf3: analog_pf3 {
		pinmux = <STM32_PINMUX('F', 3, ANALOG)>;
	};

	/omit-if-no-ref/ analog_pf4: analog_pf4 {
		pinmux = <STM32_PINMUX('F', 4, ANALOG)>;
	};

	/omit-if-no-ref/ analog_pf5: analog_pf5 {
		pinmux = <STM32_PINMUX('F', 5, ANALOG)>;
	};

	/omit-if-no-ref/ analog_pf6: analog_pf6 {
		pinmux = <STM32_PINMUX('F', 6, ANALOG)>;
	};

	/omit-if-no-ref/ analog_pf7: analog_pf7 {
		pinmux = <STM32_PINMUX('F', 7, ANALOG)>;
	};

	/omit-if-no-ref/ analog_pf8: analog_pf8 {
		pinmux = <STM32_PINMUX('F', 8, ANALOG)>;
	};

	/omit-if-no-ref/ analog_pf9: analog_pf9 {
		pinmux = <STM32_PINMUX('F', 9, ANALOG)>;
	};

	/omit-if-no-ref/ analog_pf10: analog_pf10 {
		pinmux = <STM32_PINMUX('F', 10, ANALOG)>;
	};

	/omit-if-no-ref/ analog_pf11: analog_pf11 {
		pinmux = <STM32_PINMUX('F', 11, ANALOG)>;
	};

	/omit-if-no-ref/ analog_pf12: analog_pf12 {
		pinmux = <STM32_PINMUX('F', 12, ANALOG)>;
	};

	/omit-if-no-ref/ analog_pf13: analog_pf13 {
		pinmux = <STM32_PINMUX('F', 13, ANALOG)>;
	};

	/omit-if-no-ref/ analog_pf14: analog_pf14 {
		pinmux = <STM32_PINMUX('F', 14, ANALOG)>;
	};

	/omit-if-no-ref/ analog_pf15: analog_pf15 {
		pinmux = <STM32_PINMUX('F', 15, ANALOG)>;
	};

	/omit-if-no-ref/ analog_pg0: analog_pg0 {
		pinmux = <STM32_PINMUX('G', 0, ANALOG)>;
	};

	/omit-if-no-ref/ analog_pg1: analog_pg1 {
		pinmux = <STM32_PINMUX('G', 1, ANALOG)>;
	};

	/omit-if-no-ref/ analog_pg2: analog_pg2 {
		pinmux = <STM32_PINMUX('G', 2, ANALOG)>;
	};

	/omit-if-no-ref/ analog_pg3: analog_pg3 {
		pinmux = <STM32_PINMUX('G', 3, ANALOG)>;
	};

	/omit-if-no-ref/ analog_pg4: analog_pg4 {
		pinmux = <STM32_PINMUX('G', 4, ANALOG)>;
	};

	/omit-if-no-ref/ analog_pg5: analog_pg5 {
		pinmux = <STM32_PINMUX('G', 5, ANALOG)>;
	};

	/omit-if-no-ref/ analog_pg6: analog_pg6 {
		pinmux = <STM32_PINMUX('G', 6, ANALOG)>;
	};

	/omit-if-no-ref/ analog_pg7: analog_pg7 {
		pinmux = <STM32_PINMUX('G', 7, ANALOG)>;
	};

	/omit-if-no-ref/ analog_pg8: analog_pg8 {
		pinmux = <STM32_PINMUX('G', 8, ANALOG)>;
	};

	/omit-if-no-ref/ analog_pg9: analog_pg9 {
		pinmux = <STM32_PINMUX('G', 9, ANALOG)>;
	};

	/omit-if-no-ref/ analog_pg10: analog_pg10 {
		pinmux = <STM32_PINMUX('G', 10, ANALOG)>;
	};

	/omit-if-no-ref/ analog_pg11: analog_pg11 {
		pinmux = <STM32_PINMUX('G', 11, ANALOG)>;
	};

	/omit-if-no-ref/ analog_pg12: analog_pg12 {
		pinmux = <STM32_PINMUX('G', 12, ANALOG)>;
	};

	/omit-if-no-ref/ analog_pg13: analog_pg13 {
		pinmux = <STM32_PINMUX('G', 13, ANALOG)>;
	};

	/omit-if-no-ref/ analog_pg14: analog_pg14 {
		pinmux = <STM32_PINMUX('G', 14, ANALOG)>;
	};

	/omit-if-no-ref/ analog_pg15: analog_pg15 {
		pinmux = <STM32_PINMUX('G', 15, ANALOG)>;
	};

	/omit-if-no-ref/ analog_ph0: analog_ph0 {
		pinmux = <STM32_PINMUX('H', 0, ANALOG)>;
	};

	/omit-if-no-ref/ analog_ph1: analog_ph1 {
		pinmux = <STM32_PINMUX('H', 1, ANALOG)>;
	};

	/omit-if-no-ref/ analog_ph2: analog_ph2 {
		pinmux = <STM32_PINMUX('H', 2, ANALOG)>;
	};

	/omit-if-no-ref/ analog_ph3: analog_ph3 {
		pinmux = <STM32_PINMUX('H', 3, ANALOG)>;
	};

	/omit-if-no-ref/ analog_ph4: analog_ph4 {
		pinmux = <STM32_PINMUX('H', 4, ANALOG)>;
	};

	/omit-if-no-ref/ analog_ph5: analog_ph5 {
		pinmux = <STM32_PINMUX('H', 5, ANALOG)>;
	};

	/omit-if-no-ref/ analog_ph15: analog_ph15 {
		pinmux = <STM32_PINMUX('H', 15, ANALOG)>;
	};

	/* ADC_IN / ADC_INN / ADC_INP */
	/omit-if-no-ref/ adc1_in0_pa0: adc1_in0_pa0 {
		pinmux = <STM32_PINMUX('A', 0, ANALOG)>;
	};

	/omit-if-no-ref/ adc1_in1_pa1: adc1_in1_pa1 {
		pinmux = <STM32_PINMUX('A', 1, ANALOG)>;
	};

	/omit-if-no-ref/ adc1_in10_pc2: adc1_in10_pc2 {
		pinmux = <STM32_PINMUX('C', 2, ANALOG)>;
	};

	/omit-if-no-ref/ adc1_in11_pc3: adc1_in11_pc3 {
		pinmux = <STM32_PINMUX('C', 3, ANALOG)>;
	};

	/omit-if-no-ref/ adc1_in2_pa2: adc1_in2_pa2 {
		pinmux = <STM32_PINMUX('A', 2, ANALOG)>;
	};

	/omit-if-no-ref/ adc1_in3_pa3: adc1_in3_pa3 {
		pinmux = <STM32_PINMUX('A', 3, ANALOG)>;
	};

	/omit-if-no-ref/ adc1_in4_pa4: adc1_in4_pa4 {
		pinmux = <STM32_PINMUX('A', 4, ANALOG)>;
	};

	/omit-if-no-ref/ adc1_in5_pa5: adc1_in5_pa5 {
		pinmux = <STM32_PINMUX('A', 5, ANALOG)>;
	};

	/omit-if-no-ref/ adc1_in6_pa6: adc1_in6_pa6 {
		pinmux = <STM32_PINMUX('A', 6, ANALOG)>;
	};

	/omit-if-no-ref/ adc1_in7_pa7: adc1_in7_pa7 {
		pinmux = <STM32_PINMUX('A', 7, ANALOG)>;
	};

	/omit-if-no-ref/ adc1_in8_pc0: adc1_in8_pc0 {
		pinmux = <STM32_PINMUX('C', 0, ANALOG)>;
	};

	/omit-if-no-ref/ adc1_in9_pc1: adc1_in9_pc1 {
		pinmux = <STM32_PINMUX('C', 1, ANALOG)>;
	};

	/omit-if-no-ref/ adc2_in0_pa0: adc2_in0_pa0 {
		pinmux = <STM32_PINMUX('A', 0, ANALOG)>;
	};

	/omit-if-no-ref/ adc2_in1_pa1: adc2_in1_pa1 {
		pinmux = <STM32_PINMUX('A', 1, ANALOG)>;
	};

	/omit-if-no-ref/ adc2_in10_pc2: adc2_in10_pc2 {
		pinmux = <STM32_PINMUX('C', 2, ANALOG)>;
	};

	/omit-if-no-ref/ adc2_in11_pc3: adc2_in11_pc3 {
		pinmux = <STM32_PINMUX('C', 3, ANALOG)>;
	};

	/omit-if-no-ref/ adc2_in12_ph4: adc2_in12_ph4 {
		pinmux = <STM32_PINMUX('H', 4, ANALOG)>;
	};

	/omit-if-no-ref/ adc2_in13_ph5: adc2_in13_ph5 {
		pinmux = <STM32_PINMUX('H', 5, ANALOG)>;
	};

	/omit-if-no-ref/ adc2_in2_pa2: adc2_in2_pa2 {
		pinmux = <STM32_PINMUX('A', 2, ANALOG)>;
	};

	/omit-if-no-ref/ adc2_in3_pa3: adc2_in3_pa3 {
		pinmux = <STM32_PINMUX('A', 3, ANALOG)>;
	};

	/omit-if-no-ref/ adc2_in4_pc4: adc2_in4_pc4 {
		pinmux = <STM32_PINMUX('C', 4, ANALOG)>;
	};

	/omit-if-no-ref/ adc2_in5_pc5: adc2_in5_pc5 {
		pinmux = <STM32_PINMUX('C', 5, ANALOG)>;
	};

	/omit-if-no-ref/ adc2_in6_pb0: adc2_in6_pb0 {
		pinmux = <STM32_PINMUX('B', 0, ANALOG)>;
	};

	/omit-if-no-ref/ adc2_in7_pb1: adc2_in7_pb1 {
		pinmux = <STM32_PINMUX('B', 1, ANALOG)>;
	};

	/omit-if-no-ref/ adc2_in8_pb2: adc2_in8_pb2 {
		pinmux = <STM32_PINMUX('B', 2, ANALOG)>;
	};

	/omit-if-no-ref/ adc2_in9_pc1: adc2_in9_pc1 {
		pinmux = <STM32_PINMUX('C', 1, ANALOG)>;
	};

	/omit-if-no-ref/ adc3_in0_pb0: adc3_in0_pb0 {
		pinmux = <STM32_PINMUX('B', 0, ANALOG)>;
	};

	/omit-if-no-ref/ adc3_in1_pb1: adc3_in1_pb1 {
		pinmux = <STM32_PINMUX('B', 1, ANALOG)>;
	};

	/omit-if-no-ref/ adc3_in10_pe14: adc3_in10_pe14 {
		pinmux = <STM32_PINMUX('E', 14, ANALOG)>;
	};

	/omit-if-no-ref/ adc3_in11_pe15: adc3_in11_pe15 {
		pinmux = <STM32_PINMUX('E', 15, ANALOG)>;
	};

	/omit-if-no-ref/ adc3_in12_ph4: adc3_in12_ph4 {
		pinmux = <STM32_PINMUX('H', 4, ANALOG)>;
	};

	/omit-if-no-ref/ adc3_in13_ph5: adc3_in13_ph5 {
		pinmux = <STM32_PINMUX('H', 5, ANALOG)>;
	};

	/omit-if-no-ref/ adc3_in2_pb2: adc3_in2_pb2 {
		pinmux = <STM32_PINMUX('B', 2, ANALOG)>;
	};

	/omit-if-no-ref/ adc3_in3_pe7: adc3_in3_pe7 {
		pinmux = <STM32_PINMUX('E', 7, ANALOG)>;
	};

	/omit-if-no-ref/ adc3_in4_pe8: adc3_in4_pe8 {
		pinmux = <STM32_PINMUX('E', 8, ANALOG)>;
	};

	/omit-if-no-ref/ adc3_in5_pe9: adc3_in5_pe9 {
		pinmux = <STM32_PINMUX('E', 9, ANALOG)>;
	};

	/omit-if-no-ref/ adc3_in6_pe10: adc3_in6_pe10 {
		pinmux = <STM32_PINMUX('E', 10, ANALOG)>;
	};

	/omit-if-no-ref/ adc3_in7_pe11: adc3_in7_pe11 {
		pinmux = <STM32_PINMUX('E', 11, ANALOG)>;
	};

	/omit-if-no-ref/ adc3_in8_pe12: adc3_in8_pe12 {
		pinmux = <STM32_PINMUX('E', 12, ANALOG)>;
	};

	/omit-if-no-ref/ adc3_in9_pe13: adc3_in9_pe13 {
		pinmux = <STM32_PINMUX('E', 13, ANALOG)>;
	};

	/* COMP_OUT */
	/omit-if-no-ref/ comp1_out_pa13: comp1_out_pa13 {
		pinmux = <STM32_PINMUX('A', 13, AF14)>;
	};

	/omit-if-no-ref/ comp1_out_pa3: comp1_out_pa3 {
		pinmux = <STM32_PINMUX('A', 3, AF14)>;
	};

	/omit-if-no-ref/ comp1_out_pb1: comp1_out_pb1 {
		pinmux = <STM32_PINMUX('B', 1, AF14)>;
	};

	/omit-if-no-ref/ comp1_out_pc5: comp1_out_pc5 {
		pinmux = <STM32_PINMUX('C', 5, AF14)>;
	};

	/omit-if-no-ref/ comp1_out_pe12: comp1_out_pe12 {
		pinmux = <STM32_PINMUX('E', 12, AF14)>;
	};

	/* DAC_OUT */
	/omit-if-no-ref/ dac1_out1_pa4: dac1_out1_pa4 {
		pinmux = <STM32_PINMUX('A', 4, ANALOG)>;
	};

	/* I2C_SCL */
	/omit-if-no-ref/ i2c1_scl_pa8: i2c1_scl_pa8 {
		pinmux = <STM32_PINMUX('A', 8, AF9)>;
		bias-pull-up;
		drive-open-drain;
	};

	/omit-if-no-ref/ i2c1_scl_pb6: i2c1_scl_pb6 {
		pinmux = <STM32_PINMUX('B', 6, AF4)>;
		bias-pull-up;
		drive-open-drain;
	};

	/omit-if-no-ref/ i2c1_scl_pb8: i2c1_scl_pb8 {
		pinmux = <STM32_PINMUX('B', 8, AF4)>;
		bias-pull-up;
		drive-open-drain;
	};

	/omit-if-no-ref/ i2c1_scl_ph1: i2c1_scl_ph1 {
		pinmux = <STM32_PINMUX('H', 1, AF4)>;
		bias-pull-up;
		drive-open-drain;
	};

	/omit-if-no-ref/ i2c2_scl_pa11: i2c2_scl_pa11 {
		pinmux = <STM32_PINMUX('A', 11, AF8)>;
		bias-pull-up;
		drive-open-drain;
	};

	/omit-if-no-ref/ i2c2_scl_pb10: i2c2_scl_pb10 {
		pinmux = <STM32_PINMUX('B', 10, AF4)>;
		bias-pull-up;
		drive-open-drain;
	};

	/omit-if-no-ref/ i2c2_scl_pb3: i2c2_scl_pb3 {
		pinmux = <STM32_PINMUX('B', 3, AF9)>;
		bias-pull-up;
		drive-open-drain;
	};

	/omit-if-no-ref/ i2c2_scl_pf1: i2c2_scl_pf1 {
		pinmux = <STM32_PINMUX('F', 1, AF4)>;
		bias-pull-up;
		drive-open-drain;
	};

	/* I2C_SDA */
	/omit-if-no-ref/ i2c1_sda_pb7: i2c1_sda_pb7 {
		pinmux = <STM32_PINMUX('B', 7, AF4)>;
		bias-pull-up;
		drive-open-drain;
	};

	/omit-if-no-ref/ i2c1_sda_pb9: i2c1_sda_pb9 {
		pinmux = <STM32_PINMUX('B', 9, AF4)>;
		bias-pull-up;
		drive-open-drain;
	};

	/omit-if-no-ref/ i2c1_sda_pc9: i2c1_sda_pc9 {
		pinmux = <STM32_PINMUX('C', 9, AF9)>;
		bias-pull-up;
		drive-open-drain;
	};

	/omit-if-no-ref/ i2c1_sda_ph0: i2c1_sda_ph0 {
		pinmux = <STM32_PINMUX('H', 0, AF4)>;
		bias-pull-up;
		drive-open-drain;
	};

	/omit-if-no-ref/ i2c2_sda_pa12: i2c2_sda_pa12 {
		pinmux = <STM32_PINMUX('A', 12, AF8)>;
		bias-pull-up;
		drive-open-drain;
	};

	/omit-if-no-ref/ i2c2_sda_pb12: i2c2_sda_pb12 {
		pinmux = <STM32_PINMUX('B', 12, AF4)>;
		bias-pull-up;
		drive-open-drain;
	};

	/omit-if-no-ref/ i2c2_sda_pb3: i2c2_sda_pb3 {
		pinmux = <STM32_PINMUX('B', 3, AF4)>;
		bias-pull-up;
		drive-open-drain;
	};

	/omit-if-no-ref/ i2c2_sda_pb4: i2c2_sda_pb4 {
		pinmux = <STM32_PINMUX('B', 4, AF9)>;
		bias-pull-up;
		drive-open-drain;
	};

	/omit-if-no-ref/ i2c2_sda_pf0: i2c2_sda_pf0 {
		pinmux = <STM32_PINMUX('F', 0, AF4)>;
		bias-pull-up;
		drive-open-drain;
	};

	/* I2C_SMBA */
	/omit-if-no-ref/ i2c1_smba_pa9: i2c1_smba_pa9 {
		pinmux = <STM32_PINMUX('A', 9, AF9)>;
		bias-pull-up;
	};

	/omit-if-no-ref/ i2c1_smba_pb5: i2c1_smba_pb5 {
		pinmux = <STM32_PINMUX('B', 5, AF4)>;
		bias-pull-up;
	};

	/omit-if-no-ref/ i2c2_smba_pa15: i2c2_smba_pa15 {
		pinmux = <STM32_PINMUX('A', 15, AF4)>;
		bias-pull-up;
	};

	/omit-if-no-ref/ i2c2_smba_pb13: i2c2_smba_pb13 {
		pinmux = <STM32_PINMUX('B', 13, AF4)>;
		bias-pull-up;
	};

	/omit-if-no-ref/ i2c2_smba_pf2: i2c2_smba_pf2 {
		pinmux = <STM32_PINMUX('F', 2, AF4)>;
		bias-pull-up;
	};

	/* I2S_MCK */
	/omit-if-no-ref/ i2s1_mck_pc4: i2s1_mck_pc4 {
		pinmux = <STM32_PINMUX('C', 4, AF5)>;
		slew-rate = "very-high-speed";
	};

	/omit-if-no-ref/ i2s2_mck_pc6: i2s2_mck_pc6 {
		pinmux = <STM32_PINMUX('C', 6, AF5)>;
		slew-rate = "very-high-speed";
	};

	/omit-if-no-ref/ i2s3_mck_pc7: i2s3_mck_pc7 {
		pinmux = <STM32_PINMUX('C', 7, AF6)>;
		slew-rate = "very-high-speed";
	};

	/* I2S_CK */
	/omit-if-no-ref/ i2s1_ck_pa5: i2s1_ck_pa5 {
		pinmux = <STM32_PINMUX('A', 5, AF5)>;
		slew-rate = "very-high-speed";
	};

	/omit-if-no-ref/ i2s1_ck_pb3: i2s1_ck_pb3 {
		pinmux = <STM32_PINMUX('B', 3, AF5)>;
		slew-rate = "very-high-speed";
	};

	/omit-if-no-ref/ i2s1_ck_pg11: i2s1_ck_pg11 {
		pinmux = <STM32_PINMUX('G', 11, AF5)>;
		slew-rate = "very-high-speed";
	};

	/omit-if-no-ref/ i2s2_ck_pa12: i2s2_ck_pa12 {
		pinmux = <STM32_PINMUX('A', 12, AF5)>;
		slew-rate = "very-high-speed";
	};

	/omit-if-no-ref/ i2s2_ck_pa5: i2s2_ck_pa5 {
		pinmux = <STM32_PINMUX('A', 5, AF6)>;
		slew-rate = "very-high-speed";
	};

	/omit-if-no-ref/ i2s2_ck_pa9: i2s2_ck_pa9 {
		pinmux = <STM32_PINMUX('A', 9, AF5)>;
		slew-rate = "very-high-speed";
	};

	/omit-if-no-ref/ i2s2_ck_pb10: i2s2_ck_pb10 {
		pinmux = <STM32_PINMUX('B', 10, AF5)>;
		slew-rate = "very-high-speed";
	};

	/omit-if-no-ref/ i2s2_ck_pb13: i2s2_ck_pb13 {
		pinmux = <STM32_PINMUX('B', 13, AF5)>;
		slew-rate = "very-high-speed";
	};

	/omit-if-no-ref/ i2s2_ck_pb2: i2s2_ck_pb2 {
		pinmux = <STM32_PINMUX('B', 2, AF6)>;
		slew-rate = "very-high-speed";
	};

	/omit-if-no-ref/ i2s2_ck_pd3: i2s2_ck_pd3 {
		pinmux = <STM32_PINMUX('D', 3, AF5)>;
		slew-rate = "very-high-speed";
	};

	/omit-if-no-ref/ i2s3_ck_pb1: i2s3_ck_pb1 {
		pinmux = <STM32_PINMUX('B', 1, AF4)>;
		slew-rate = "very-high-speed";
	};

	/omit-if-no-ref/ i2s3_ck_pb3: i2s3_ck_pb3 {
		pinmux = <STM32_PINMUX('B', 3, AF6)>;
		slew-rate = "very-high-speed";
	};

	/omit-if-no-ref/ i2s3_ck_pb7: i2s3_ck_pb7 {
		pinmux = <STM32_PINMUX('B', 7, AF6)>;
		slew-rate = "very-high-speed";
	};

	/omit-if-no-ref/ i2s3_ck_pb9: i2s3_ck_pb9 {
		pinmux = <STM32_PINMUX('B', 9, AF6)>;
		slew-rate = "very-high-speed";
	};

	/omit-if-no-ref/ i2s3_ck_pc10: i2s3_ck_pc10 {
		pinmux = <STM32_PINMUX('C', 10, AF6)>;
		slew-rate = "very-high-speed";
	};

	/omit-if-no-ref/ i2s3_ck_pe2: i2s3_ck_pe2 {
		pinmux = <STM32_PINMUX('E', 2, AF5)>;
		slew-rate = "very-high-speed";
	};

	/* I2S_WS */
	/omit-if-no-ref/ i2s1_ws_pa15: i2s1_ws_pa15 {
		pinmux = <STM32_PINMUX('A', 15, AF5)>;
	};

	/omit-if-no-ref/ i2s1_ws_pa4: i2s1_ws_pa4 {
		pinmux = <STM32_PINMUX('A', 4, AF5)>;
	};

	/omit-if-no-ref/ i2s1_ws_pg10: i2s1_ws_pg10 {
		pinmux = <STM32_PINMUX('G', 10, AF5)>;
	};

	/omit-if-no-ref/ i2s2_ws_pa0: i2s2_ws_pa0 {
		pinmux = <STM32_PINMUX('A', 0, AF9)>;
	};

	/omit-if-no-ref/ i2s2_ws_pa11: i2s2_ws_pa11 {
		pinmux = <STM32_PINMUX('A', 11, AF5)>;
	};

	/omit-if-no-ref/ i2s2_ws_pa3: i2s2_ws_pa3 {
		pinmux = <STM32_PINMUX('A', 3, AF5)>;
	};

	/omit-if-no-ref/ i2s2_ws_pb1: i2s2_ws_pb1 {
		pinmux = <STM32_PINMUX('B', 1, AF5)>;
	};

	/omit-if-no-ref/ i2s2_ws_pb12: i2s2_ws_pb12 {
		pinmux = <STM32_PINMUX('B', 12, AF5)>;
	};

	/omit-if-no-ref/ i2s2_ws_pb4: i2s2_ws_pb4 {
		pinmux = <STM32_PINMUX('B', 4, AF7)>;
	};

	/omit-if-no-ref/ i2s2_ws_pb9: i2s2_ws_pb9 {
		pinmux = <STM32_PINMUX('B', 9, AF5)>;
	};

	/omit-if-no-ref/ i2s3_ws_pa15: i2s3_ws_pa15 {
		pinmux = <STM32_PINMUX('A', 15, AF6)>;
	};

	/omit-if-no-ref/ i2s3_ws_pa4: i2s3_ws_pa4 {
		pinmux = <STM32_PINMUX('A', 4, AF6)>;
	};

	/omit-if-no-ref/ i2s3_ws_pb8: i2s3_ws_pb8 {
		pinmux = <STM32_PINMUX('B', 8, AF6)>;
	};

	/omit-if-no-ref/ i2s3_ws_pe4: i2s3_ws_pe4 {
		pinmux = <STM32_PINMUX('E', 4, AF5)>;
	};

	/* I2S_SDI */
	/omit-if-no-ref/ i2s1_sdi_pa6: i2s1_sdi_pa6 {
		pinmux = <STM32_PINMUX('A', 6, AF5)>;
	};

	/omit-if-no-ref/ i2s1_sdi_pb4: i2s1_sdi_pb4 {
		pinmux = <STM32_PINMUX('B', 4, AF5)>;
	};

	/omit-if-no-ref/ i2s1_sdi_pg9: i2s1_sdi_pg9 {
		pinmux = <STM32_PINMUX('G', 9, AF5)>;
	};

	/omit-if-no-ref/ i2s2_sdi_pa7: i2s2_sdi_pa7 {
		pinmux = <STM32_PINMUX('A', 7, AF6)>;
	};

	/omit-if-no-ref/ i2s2_sdi_pb14: i2s2_sdi_pb14 {
		pinmux = <STM32_PINMUX('B', 14, AF5)>;
	};

	/omit-if-no-ref/ i2s2_sdi_pc2: i2s2_sdi_pc2 {
		pinmux = <STM32_PINMUX('C', 2, AF5)>;
	};

	/omit-if-no-ref/ i2s3_sdi_pb0: i2s3_sdi_pb0 {
		pinmux = <STM32_PINMUX('B', 0, AF5)>;
	};

	/omit-if-no-ref/ i2s3_sdi_pb4: i2s3_sdi_pb4 {
		pinmux = <STM32_PINMUX('B', 4, AF6)>;
	};

	/omit-if-no-ref/ i2s3_sdi_pb6: i2s3_sdi_pb6 {
		pinmux = <STM32_PINMUX('B', 6, AF6)>;
	};

	/omit-if-no-ref/ i2s3_sdi_pc11: i2s3_sdi_pc11 {
		pinmux = <STM32_PINMUX('C', 11, AF6)>;
	};

	/omit-if-no-ref/ i2s3_sdi_pd7: i2s3_sdi_pd7 {
		pinmux = <STM32_PINMUX('D', 7, AF6)>;
	};

	/omit-if-no-ref/ i2s3_sdi_pe5: i2s3_sdi_pe5 {
		pinmux = <STM32_PINMUX('E', 5, AF5)>;
	};

	/* I2S_SDO */
	/omit-if-no-ref/ i2s1_sdo_pa7: i2s1_sdo_pa7 {
		pinmux = <STM32_PINMUX('A', 7, AF5)>;
	};

	/omit-if-no-ref/ i2s1_sdo_pb15: i2s1_sdo_pb15 {
		pinmux = <STM32_PINMUX('B', 15, AF6)>;
	};

	/omit-if-no-ref/ i2s1_sdo_pb5: i2s1_sdo_pb5 {
		pinmux = <STM32_PINMUX('B', 5, AF5)>;
	};

	/omit-if-no-ref/ i2s1_sdo_pd7: i2s1_sdo_pd7 {
		pinmux = <STM32_PINMUX('D', 7, AF5)>;
	};

	/omit-if-no-ref/ i2s2_sdo_pa8: i2s2_sdo_pa8 {
		pinmux = <STM32_PINMUX('A', 8, AF6)>;
	};

	/omit-if-no-ref/ i2s2_sdo_pb15: i2s2_sdo_pb15 {
		pinmux = <STM32_PINMUX('B', 15, AF5)>;
	};

	/omit-if-no-ref/ i2s2_sdo_pc1: i2s2_sdo_pc1 {
		pinmux = <STM32_PINMUX('C', 1, AF5)>;
	};

	/omit-if-no-ref/ i2s2_sdo_pc3: i2s2_sdo_pc3 {
		pinmux = <STM32_PINMUX('C', 3, AF5)>;
	};

	/omit-if-no-ref/ i2s2_sdo_pg1: i2s2_sdo_pg1 {
		pinmux = <STM32_PINMUX('G', 1, AF7)>;
	};

	/omit-if-no-ref/ i2s3_sdo_pa3: i2s3_sdo_pa3 {
		pinmux = <STM32_PINMUX('A', 3, AF6)>;
	};

	/omit-if-no-ref/ i2s3_sdo_pa4: i2s3_sdo_pa4 {
		pinmux = <STM32_PINMUX('A', 4, AF4)>;
	};

	/omit-if-no-ref/ i2s3_sdo_pb15: i2s3_sdo_pb15 {
		pinmux = <STM32_PINMUX('B', 15, AF7)>;
	};

	/omit-if-no-ref/ i2s3_sdo_pb2: i2s3_sdo_pb2 {
		pinmux = <STM32_PINMUX('B', 2, AF7)>;
	};

	/omit-if-no-ref/ i2s3_sdo_pb5: i2s3_sdo_pb5 {
		pinmux = <STM32_PINMUX('B', 5, AF7)>;
	};

	/omit-if-no-ref/ i2s3_sdo_pc12: i2s3_sdo_pc12 {
		pinmux = <STM32_PINMUX('C', 12, AF6)>;
	};

	/omit-if-no-ref/ i2s3_sdo_pd6: i2s3_sdo_pd6 {
		pinmux = <STM32_PINMUX('D', 6, AF5)>;
	};

	/omit-if-no-ref/ i2s3_sdo_pe6: i2s3_sdo_pe6 {
		pinmux = <STM32_PINMUX('E', 6, AF5)>;
	};

	/omit-if-no-ref/ i2s3_sdo_pg8: i2s3_sdo_pg8 {
		pinmux = <STM32_PINMUX('G', 8, AF5)>;
	};

	/* I3C_SCL */
	/omit-if-no-ref/ i3c1_scl_pa9: i3c1_scl_pa9 {
		pinmux = <STM32_PINMUX('A', 9, AF2)>;
		slew-rate = "very-high-speed";
	};

	/omit-if-no-ref/ i3c1_scl_pb4: i3c1_scl_pb4 {
		pinmux = <STM32_PINMUX('B', 4, AF3)>;
		slew-rate = "very-high-speed";
	};

	/omit-if-no-ref/ i3c1_scl_pb6: i3c1_scl_pb6 {
		pinmux = <STM32_PINMUX('B', 6, AF3)>;
		slew-rate = "very-high-speed";
	};

	/omit-if-no-ref/ i3c1_scl_pb8: i3c1_scl_pb8 {
		pinmux = <STM32_PINMUX('B', 8, AF3)>;
		slew-rate = "very-high-speed";
	};

	/omit-if-no-ref/ i3c1_scl_pc10: i3c1_scl_pc10 {
		pinmux = <STM32_PINMUX('C', 10, AF4)>;
		slew-rate = "very-high-speed";
	};

	/omit-if-no-ref/ i3c1_scl_pd12: i3c1_scl_pd12 {
		pinmux = <STM32_PINMUX('D', 12, AF5)>;
		slew-rate = "very-high-speed";
	};

	/omit-if-no-ref/ i3c1_scl_pf5: i3c1_scl_pf5 {
		pinmux = <STM32_PINMUX('F', 5, AF5)>;
		slew-rate = "very-high-speed";
	};

	/omit-if-no-ref/ i3c1_scl_pg7: i3c1_scl_pg7 {
		pinmux = <STM32_PINMUX('G', 7, AF3)>;
		slew-rate = "very-high-speed";
	};

	/* I3C_SDA */
	/omit-if-no-ref/ i3c1_sda_pa8: i3c1_sda_pa8 {
		pinmux = <STM32_PINMUX('A', 8, AF2)>;
		slew-rate = "very-high-speed";
	};

	/omit-if-no-ref/ i3c1_sda_pb5: i3c1_sda_pb5 {
		pinmux = <STM32_PINMUX('B', 5, AF3)>;
		slew-rate = "very-high-speed";
	};

	/omit-if-no-ref/ i3c1_sda_pb7: i3c1_sda_pb7 {
		pinmux = <STM32_PINMUX('B', 7, AF3)>;
		slew-rate = "very-high-speed";
	};

	/omit-if-no-ref/ i3c1_sda_pb9: i3c1_sda_pb9 {
		pinmux = <STM32_PINMUX('B', 9, AF3)>;
		slew-rate = "very-high-speed";
	};

	/omit-if-no-ref/ i3c1_sda_pc11: i3c1_sda_pc11 {
		pinmux = <STM32_PINMUX('C', 11, AF4)>;
		slew-rate = "very-high-speed";
	};

	/omit-if-no-ref/ i3c1_sda_pd13: i3c1_sda_pd13 {
		pinmux = <STM32_PINMUX('D', 13, AF5)>;
		slew-rate = "very-high-speed";
	};

	/omit-if-no-ref/ i3c1_sda_pf15: i3c1_sda_pf15 {
		pinmux = <STM32_PINMUX('F', 15, AF5)>;
		slew-rate = "very-high-speed";
	};

	/omit-if-no-ref/ i3c1_sda_pg6: i3c1_sda_pg6 {
		pinmux = <STM32_PINMUX('G', 6, AF3)>;
		slew-rate = "very-high-speed";
	};

	/* JTAG PORT */
	/omit-if-no-ref/ debug_jtdi_pa15: debug_jtdi_pa15 {
		pinmux = <STM32_PINMUX('A', 15, AF0)>;
	};

	/omit-if-no-ref/ debug_jtdo_pb3: debug_jtdo_pb3 {
		pinmux = <STM32_PINMUX('B', 3, AF0)>;
	};

	/omit-if-no-ref/ debug_njtrst_pb4: debug_njtrst_pb4 {
		pinmux = <STM32_PINMUX('B', 4, AF0)>;
	};

	/omit-if-no-ref/ debug_swclk_pa14: debug_swclk_pa14 {
		pinmux = <STM32_PINMUX('A', 14, AF0)>;
	};

	/omit-if-no-ref/ debug_swdio_pa13: debug_swdio_pa13 {
		pinmux = <STM32_PINMUX('A', 13, AF0)>;
	};

	/omit-if-no-ref/ debug_traceclk_pe2: debug_traceclk_pe2 {
		pinmux = <STM32_PINMUX('E', 2, AF0)>;
	};

	/omit-if-no-ref/ debug_traceswo_pb3: debug_traceswo_pb3 {
		pinmux = <STM32_PINMUX('B', 3, AF0)>;
	};

	/* RCC_MCO */
	/omit-if-no-ref/ rcc_mco1_pa8: rcc_mco1_pa8 {
		pinmux = <STM32_PINMUX('A', 8, AF0)>;
		slew-rate = "very-high-speed";
	};

	/omit-if-no-ref/ rcc_mco1_ph2: rcc_mco1_ph2 {
		pinmux = <STM32_PINMUX('H', 2, AF0)>;
		slew-rate = "very-high-speed";
	};

	/omit-if-no-ref/ rcc_mco2_pa9: rcc_mco2_pa9 {
		pinmux = <STM32_PINMUX('A', 9, AF0)>;
		slew-rate = "very-high-speed";
	};

	/omit-if-no-ref/ rcc_mco2_pc9: rcc_mco2_pc9 {
		pinmux = <STM32_PINMUX('C', 9, AF0)>;
		slew-rate = "very-high-speed";
	};

	/omit-if-no-ref/ rcc_mco2_pd10: rcc_mco2_pd10 {
		pinmux = <STM32_PINMUX('D', 10, AF0)>;
		slew-rate = "very-high-speed";
	};

	/* XSPI */
	/omit-if-no-ref/ xspi1_clk_pa10: xspi1_clk_pa10 {
		pinmux = <STM32_PINMUX('A', 10, AF11)>;
		slew-rate = "very-high-speed";
	};

	/omit-if-no-ref/ xspi1_clk_pa3: xspi1_clk_pa3 {
		pinmux = <STM32_PINMUX('A', 3, AF11)>;
		slew-rate = "very-high-speed";
	};

	/omit-if-no-ref/ xspi1_clk_pb15: xspi1_clk_pb15 {
		pinmux = <STM32_PINMUX('B', 15, AF11)>;
		slew-rate = "very-high-speed";
	};

	/omit-if-no-ref/ xspi1_clk_pb2: xspi1_clk_pb2 {
		pinmux = <STM32_PINMUX('B', 2, AF9)>;
		slew-rate = "very-high-speed";
	};

	/omit-if-no-ref/ xspi1_clk_pf10: xspi1_clk_pf10 {
		pinmux = <STM32_PINMUX('F', 10, AF9)>;
		slew-rate = "very-high-speed";
	};

	/omit-if-no-ref/ xspi1_dqs_pa1: xspi1_dqs_pa1 {
		pinmux = <STM32_PINMUX('A', 1, AF11)>;
		slew-rate = "very-high-speed";
	};

	/omit-if-no-ref/ xspi1_dqs_pb13: xspi1_dqs_pb13 {
		pinmux = <STM32_PINMUX('B', 13, AF11)>;
		slew-rate = "very-high-speed";
	};

	/omit-if-no-ref/ xspi1_dqs_pb2: xspi1_dqs_pb2 {
		pinmux = <STM32_PINMUX('B', 2, AF11)>;
		slew-rate = "very-high-speed";
	};

	/omit-if-no-ref/ xspi1_dqs_pc5: xspi1_dqs_pc5 {
		pinmux = <STM32_PINMUX('C', 5, AF11)>;
		slew-rate = "very-high-speed";
	};

	/omit-if-no-ref/ xspi1_io0_pb1: xspi1_io0_pb1 {
		pinmux = <STM32_PINMUX('B', 1, AF11)>;
		slew-rate = "very-high-speed";
	};

	/omit-if-no-ref/ xspi1_io0_pb15: xspi1_io0_pb15 {
		pinmux = <STM32_PINMUX('B', 15, AF9)>;
		slew-rate = "very-high-speed";
	};

	/omit-if-no-ref/ xspi1_io0_pc3: xspi1_io0_pc3 {
		pinmux = <STM32_PINMUX('C', 3, AF9)>;
		slew-rate = "very-high-speed";
	};

	/omit-if-no-ref/ xspi1_io0_pc9: xspi1_io0_pc9 {
		pinmux = <STM32_PINMUX('C', 9, AF7)>;
		slew-rate = "very-high-speed";
	};

	/omit-if-no-ref/ xspi1_io0_pd11: xspi1_io0_pd11 {
		pinmux = <STM32_PINMUX('D', 11, AF9)>;
		slew-rate = "very-high-speed";
	};

	/omit-if-no-ref/ xspi1_io0_pf9: xspi1_io0_pf9 {
		pinmux = <STM32_PINMUX('F', 9, AF11)>;
		slew-rate = "very-high-speed";
	};

	/omit-if-no-ref/ xspi1_io1_pa5: xspi1_io1_pa5 {
		pinmux = <STM32_PINMUX('A', 5, AF9)>;
		slew-rate = "very-high-speed";
	};

	/omit-if-no-ref/ xspi1_io1_pb0: xspi1_io1_pb0 {
		pinmux = <STM32_PINMUX('B', 0, AF11)>;
		slew-rate = "very-high-speed";
	};

	/omit-if-no-ref/ xspi1_io1_pc10: xspi1_io1_pc10 {
		pinmux = <STM32_PINMUX('C', 10, AF9)>;
		slew-rate = "very-high-speed";
	};

	/omit-if-no-ref/ xspi1_io1_pd12: xspi1_io1_pd12 {
		pinmux = <STM32_PINMUX('D', 12, AF9)>;
		slew-rate = "very-high-speed";
	};

	/omit-if-no-ref/ xspi1_io1_pf8: xspi1_io1_pf8 {
		pinmux = <STM32_PINMUX('F', 8, AF11)>;
		slew-rate = "very-high-speed";
	};

	/omit-if-no-ref/ xspi1_io2_pa7: xspi1_io2_pa7 {
		pinmux = <STM32_PINMUX('A', 7, AF11)>;
		slew-rate = "very-high-speed";
	};

	/omit-if-no-ref/ xspi1_io2_pc2: xspi1_io2_pc2 {
		pinmux = <STM32_PINMUX('C', 2, AF9)>;
		slew-rate = "very-high-speed";
	};

	/omit-if-no-ref/ xspi1_io2_pd13: xspi1_io2_pd13 {
		pinmux = <STM32_PINMUX('D', 13, AF11)>;
		slew-rate = "very-high-speed";
	};

	/omit-if-no-ref/ xspi1_io2_pe2: xspi1_io2_pe2 {
		pinmux = <STM32_PINMUX('E', 2, AF9)>;
		slew-rate = "very-high-speed";
	};

	/omit-if-no-ref/ xspi1_io2_pf7: xspi1_io2_pf7 {
		pinmux = <STM32_PINMUX('F', 7, AF11)>;
		slew-rate = "very-high-speed";
	};

	/omit-if-no-ref/ xspi1_io3_pa0: xspi1_io3_pa0 {
		pinmux = <STM32_PINMUX('A', 0, AF11)>;
		slew-rate = "very-high-speed";
	};

	/omit-if-no-ref/ xspi1_io3_pa1: xspi1_io3_pa1 {
		pinmux = <STM32_PINMUX('A', 1, AF9)>;
		slew-rate = "very-high-speed";
	};

	/omit-if-no-ref/ xspi1_io3_pa6: xspi1_io3_pa6 {
		pinmux = <STM32_PINMUX('A', 6, AF9)>;
		slew-rate = "very-high-speed";
	};

	/omit-if-no-ref/ xspi1_io3_pc6: xspi1_io3_pc6 {
		pinmux = <STM32_PINMUX('C', 6, AF11)>;
		slew-rate = "very-high-speed";
	};

	/omit-if-no-ref/ xspi1_io3_pd13: xspi1_io3_pd13 {
		pinmux = <STM32_PINMUX('D', 13, AF9)>;
		slew-rate = "very-high-speed";
	};

	/omit-if-no-ref/ xspi1_io3_pf6: xspi1_io3_pf6 {
		pinmux = <STM32_PINMUX('F', 6, AF11)>;
		slew-rate = "very-high-speed";
	};

	/omit-if-no-ref/ xspi1_io4_pc1: xspi1_io4_pc1 {
		pinmux = <STM32_PINMUX('C', 1, AF9)>;
		slew-rate = "very-high-speed";
	};

	/omit-if-no-ref/ xspi1_io4_pc3: xspi1_io4_pc3 {
		pinmux = <STM32_PINMUX('C', 3, AF11)>;
		slew-rate = "very-high-speed";
	};

	/omit-if-no-ref/ xspi1_io4_pc7: xspi1_io4_pc7 {
		pinmux = <STM32_PINMUX('C', 7, AF11)>;
		slew-rate = "very-high-speed";
	};

	/omit-if-no-ref/ xspi1_io4_pd4: xspi1_io4_pd4 {
		pinmux = <STM32_PINMUX('D', 4, AF11)>;
		slew-rate = "very-high-speed";
	};

	/omit-if-no-ref/ xspi1_io4_pe7: xspi1_io4_pe7 {
		pinmux = <STM32_PINMUX('E', 7, AF11)>;
		slew-rate = "very-high-speed";
	};

	/omit-if-no-ref/ xspi1_io5_pc2: xspi1_io5_pc2 {
		pinmux = <STM32_PINMUX('C', 2, AF11)>;
		slew-rate = "very-high-speed";
	};

	/omit-if-no-ref/ xspi1_io5_pc6: xspi1_io5_pc6 {
		pinmux = <STM32_PINMUX('C', 6, AF9)>;
		slew-rate = "very-high-speed";
	};

	/omit-if-no-ref/ xspi1_io5_pc9: xspi1_io5_pc9 {
		pinmux = <STM32_PINMUX('C', 9, AF11)>;
		slew-rate = "very-high-speed";
	};

	/omit-if-no-ref/ xspi1_io5_pd5: xspi1_io5_pd5 {
		pinmux = <STM32_PINMUX('D', 5, AF11)>;
		slew-rate = "very-high-speed";
	};

	/omit-if-no-ref/ xspi1_io5_pe8: xspi1_io5_pe8 {
		pinmux = <STM32_PINMUX('E', 8, AF11)>;
		slew-rate = "very-high-speed";
	};

	/omit-if-no-ref/ xspi1_io6_pa8: xspi1_io6_pa8 {
		pinmux = <STM32_PINMUX('A', 8, AF11)>;
		slew-rate = "very-high-speed";
	};

	/omit-if-no-ref/ xspi1_io6_pc1: xspi1_io6_pc1 {
		pinmux = <STM32_PINMUX('C', 1, AF11)>;
		slew-rate = "very-high-speed";
	};

	/omit-if-no-ref/ xspi1_io6_pc3: xspi1_io6_pc3 {
		pinmux = <STM32_PINMUX('C', 3, AF7)>;
		slew-rate = "very-high-speed";
	};

	/omit-if-no-ref/ xspi1_io6_pc7: xspi1_io6_pc7 {
		pinmux = <STM32_PINMUX('C', 7, AF9)>;
		slew-rate = "very-high-speed";
	};

	/omit-if-no-ref/ xspi1_io6_pd6: xspi1_io6_pd6 {
		pinmux = <STM32_PINMUX('D', 6, AF11)>;
		slew-rate = "very-high-speed";
	};

	/omit-if-no-ref/ xspi1_io6_pe9: xspi1_io6_pe9 {
		pinmux = <STM32_PINMUX('E', 9, AF11)>;
		slew-rate = "very-high-speed";
	};

	/omit-if-no-ref/ xspi1_io6_pg9: xspi1_io6_pg9 {
		pinmux = <STM32_PINMUX('G', 9, AF9)>;
		slew-rate = "very-high-speed";
	};

	/omit-if-no-ref/ xspi1_io7_pa9: xspi1_io7_pa9 {
		pinmux = <STM32_PINMUX('A', 9, AF11)>;
		slew-rate = "very-high-speed";
	};

	/omit-if-no-ref/ xspi1_io7_pc0: xspi1_io7_pc0 {
		pinmux = <STM32_PINMUX('C', 0, AF11)>;
		slew-rate = "very-high-speed";
	};

	/omit-if-no-ref/ xspi1_io7_pd7: xspi1_io7_pd7 {
		pinmux = <STM32_PINMUX('D', 7, AF11)>;
		slew-rate = "very-high-speed";
	};

	/omit-if-no-ref/ xspi1_io7_pe10: xspi1_io7_pe10 {
		pinmux = <STM32_PINMUX('E', 10, AF11)>;
		slew-rate = "very-high-speed";
	};

	/omit-if-no-ref/ xspi1_io7_pg14: xspi1_io7_pg14 {
		pinmux = <STM32_PINMUX('G', 14, AF9)>;
		slew-rate = "very-high-speed";
	};

	/omit-if-no-ref/ xspi1_nclk_pa2: xspi1_nclk_pa2 {
		pinmux = <STM32_PINMUX('A', 2, AF11)>;
		slew-rate = "very-high-speed";
	};

	/omit-if-no-ref/ xspi1_nclk_pb12: xspi1_nclk_pb12 {
		pinmux = <STM32_PINMUX('B', 12, AF11)>;
		slew-rate = "very-high-speed";
	};

	/omit-if-no-ref/ xspi1_nclk_pf11: xspi1_nclk_pf11 {
		pinmux = <STM32_PINMUX('F', 11, AF9)>;
		slew-rate = "very-high-speed";
	};

	/omit-if-no-ref/ xspi1_ncs1_pa5: xspi1_ncs1_pa5 {
		pinmux = <STM32_PINMUX('A', 5, AF11)>;
		slew-rate = "very-high-speed";
	};

	/omit-if-no-ref/ xspi1_ncs1_pb10: xspi1_ncs1_pb10 {
		pinmux = <STM32_PINMUX('B', 10, AF9)>;
		slew-rate = "very-high-speed";
	};

	/omit-if-no-ref/ xspi1_ncs1_pb8: xspi1_ncs1_pb8 {
		pinmux = <STM32_PINMUX('B', 8, AF11)>;
		slew-rate = "very-high-speed";
	};

	/omit-if-no-ref/ xspi1_ncs1_pc11: xspi1_ncs1_pc11 {
		pinmux = <STM32_PINMUX('C', 11, AF9)>;
		slew-rate = "very-high-speed";
	};

	/omit-if-no-ref/ xspi1_ncs1_pe11: xspi1_ncs1_pe11 {
		pinmux = <STM32_PINMUX('E', 11, AF11)>;
		slew-rate = "very-high-speed";
	};

	/omit-if-no-ref/ xspi1_ncs1_pg6: xspi1_ncs1_pg6 {
		pinmux = <STM32_PINMUX('G', 6, AF11)>;
		slew-rate = "very-high-speed";
	};

	/omit-if-no-ref/ xspi1_ncs2_pa11: xspi1_ncs2_pa11 {
		pinmux = <STM32_PINMUX('A', 11, AF11)>;
		slew-rate = "very-high-speed";
	};

	/omit-if-no-ref/ xspi1_ncs2_pd0: xspi1_ncs2_pd0 {
		pinmux = <STM32_PINMUX('D', 0, AF11)>;
		slew-rate = "very-high-speed";
	};

	/omit-if-no-ref/ xspi1_ncs2_pd2: xspi1_ncs2_pd2 {
		pinmux = <STM32_PINMUX('D', 2, AF9)>;
		slew-rate = "very-high-speed";
	};

	/omit-if-no-ref/ xspi1_ncs2_pe0: xspi1_ncs2_pe0 {
		pinmux = <STM32_PINMUX('E', 0, AF11)>;
		slew-rate = "very-high-speed";
	};

	/* SPI_MISO */
	/omit-if-no-ref/ spi1_miso_pa6: spi1_miso_pa6 {
		pinmux = <STM32_PINMUX('A', 6, AF5)>;
		bias-pull-down;
	};

	/omit-if-no-ref/ spi1_miso_pb4: spi1_miso_pb4 {
		pinmux = <STM32_PINMUX('B', 4, AF5)>;
		bias-pull-down;
	};

	/omit-if-no-ref/ spi1_miso_pg9: spi1_miso_pg9 {
		pinmux = <STM32_PINMUX('G', 9, AF5)>;
		bias-pull-down;
	};

	/omit-if-no-ref/ spi2_miso_pa7: spi2_miso_pa7 {
		pinmux = <STM32_PINMUX('A', 7, AF6)>;
		bias-pull-down;
	};

	/omit-if-no-ref/ spi2_miso_pb14: spi2_miso_pb14 {
		pinmux = <STM32_PINMUX('B', 14, AF5)>;
		bias-pull-down;
	};

	/omit-if-no-ref/ spi2_miso_pc2: spi2_miso_pc2 {
		pinmux = <STM32_PINMUX('C', 2, AF5)>;
		bias-pull-down;
	};

	/omit-if-no-ref/ spi3_miso_pb0: spi3_miso_pb0 {
		pinmux = <STM32_PINMUX('B', 0, AF5)>;
		bias-pull-down;
	};

	/omit-if-no-ref/ spi3_miso_pb4: spi3_miso_pb4 {
		pinmux = <STM32_PINMUX('B', 4, AF6)>;
		bias-pull-down;
	};

	/omit-if-no-ref/ spi3_miso_pb6: spi3_miso_pb6 {
		pinmux = <STM32_PINMUX('B', 6, AF6)>;
		bias-pull-down;
	};

	/omit-if-no-ref/ spi3_miso_pc11: spi3_miso_pc11 {
		pinmux = <STM32_PINMUX('C', 11, AF6)>;
		bias-pull-down;
	};

	/omit-if-no-ref/ spi3_miso_pd7: spi3_miso_pd7 {
		pinmux = <STM32_PINMUX('D', 7, AF6)>;
		bias-pull-down;
	};

	/omit-if-no-ref/ spi3_miso_pe5: spi3_miso_pe5 {
		pinmux = <STM32_PINMUX('E', 5, AF5)>;
		bias-pull-down;
	};

	/* SPI_MOSI */
	/omit-if-no-ref/ spi1_mosi_pa7: spi1_mosi_pa7 {
		pinmux = <STM32_PINMUX('A', 7, AF5)>;
		bias-pull-down;
	};

	/omit-if-no-ref/ spi1_mosi_pb15: spi1_mosi_pb15 {
		pinmux = <STM32_PINMUX('B', 15, AF6)>;
		bias-pull-down;
	};

	/omit-if-no-ref/ spi1_mosi_pb5: spi1_mosi_pb5 {
		pinmux = <STM32_PINMUX('B', 5, AF5)>;
		bias-pull-down;
	};

	/omit-if-no-ref/ spi1_mosi_pd7: spi1_mosi_pd7 {
		pinmux = <STM32_PINMUX('D', 7, AF5)>;
		bias-pull-down;
	};

	/omit-if-no-ref/ spi2_mosi_pa8: spi2_mosi_pa8 {
		pinmux = <STM32_PINMUX('A', 8, AF6)>;
		bias-pull-down;
	};

	/omit-if-no-ref/ spi2_mosi_pb15: spi2_mosi_pb15 {
		pinmux = <STM32_PINMUX('B', 15, AF5)>;
		bias-pull-down;
	};

	/omit-if-no-ref/ spi2_mosi_pc1: spi2_mosi_pc1 {
		pinmux = <STM32_PINMUX('C', 1, AF5)>;
		bias-pull-down;
	};

	/omit-if-no-ref/ spi2_mosi_pc3: spi2_mosi_pc3 {
		pinmux = <STM32_PINMUX('C', 3, AF5)>;
		bias-pull-down;
	};

	/omit-if-no-ref/ spi2_mosi_pg1: spi2_mosi_pg1 {
		pinmux = <STM32_PINMUX('G', 1, AF7)>;
		bias-pull-down;
	};

	/omit-if-no-ref/ spi3_mosi_pa3: spi3_mosi_pa3 {
		pinmux = <STM32_PINMUX('A', 3, AF6)>;
		bias-pull-down;
	};

	/omit-if-no-ref/ spi3_mosi_pa4: spi3_mosi_pa4 {
		pinmux = <STM32_PINMUX('A', 4, AF4)>;
		bias-pull-down;
	};

	/omit-if-no-ref/ spi3_mosi_pb15: spi3_mosi_pb15 {
		pinmux = <STM32_PINMUX('B', 15, AF7)>;
		bias-pull-down;
	};

	/omit-if-no-ref/ spi3_mosi_pb2: spi3_mosi_pb2 {
		pinmux = <STM32_PINMUX('B', 2, AF7)>;
		bias-pull-down;
	};

	/omit-if-no-ref/ spi3_mosi_pb5: spi3_mosi_pb5 {
		pinmux = <STM32_PINMUX('B', 5, AF7)>;
		bias-pull-down;
	};

	/omit-if-no-ref/ spi3_mosi_pc12: spi3_mosi_pc12 {
		pinmux = <STM32_PINMUX('C', 12, AF6)>;
		bias-pull-down;
	};

	/omit-if-no-ref/ spi3_mosi_pd6: spi3_mosi_pd6 {
		pinmux = <STM32_PINMUX('D', 6, AF5)>;
		bias-pull-down;
	};

	/omit-if-no-ref/ spi3_mosi_pe6: spi3_mosi_pe6 {
		pinmux = <STM32_PINMUX('E', 6, AF5)>;
		bias-pull-down;
	};

	/omit-if-no-ref/ spi3_mosi_pg8: spi3_mosi_pg8 {
		pinmux = <STM32_PINMUX('G', 8, AF5)>;
		bias-pull-down;
	};

	/* SPI_SCK */
	/omit-if-no-ref/ spi1_sck_pa5: spi1_sck_pa5 {
		pinmux = <STM32_PINMUX('A', 5, AF5)>;
		bias-pull-down;
		slew-rate = "very-high-speed";
	};

	/omit-if-no-ref/ spi1_sck_pb3: spi1_sck_pb3 {
		pinmux = <STM32_PINMUX('B', 3, AF5)>;
		bias-pull-down;
		slew-rate = "very-high-speed";
	};

	/omit-if-no-ref/ spi1_sck_pg11: spi1_sck_pg11 {
		pinmux = <STM32_PINMUX('G', 11, AF5)>;
		bias-pull-down;
		slew-rate = "very-high-speed";
	};

	/omit-if-no-ref/ spi2_sck_pa12: spi2_sck_pa12 {
		pinmux = <STM32_PINMUX('A', 12, AF5)>;
		bias-pull-down;
		slew-rate = "very-high-speed";
	};

	/omit-if-no-ref/ spi2_sck_pa5: spi2_sck_pa5 {
		pinmux = <STM32_PINMUX('A', 5, AF6)>;
		bias-pull-down;
		slew-rate = "very-high-speed";
	};

	/omit-if-no-ref/ spi2_sck_pa9: spi2_sck_pa9 {
		pinmux = <STM32_PINMUX('A', 9, AF5)>;
		bias-pull-down;
		slew-rate = "very-high-speed";
	};

	/omit-if-no-ref/ spi2_sck_pb10: spi2_sck_pb10 {
		pinmux = <STM32_PINMUX('B', 10, AF5)>;
		bias-pull-down;
		slew-rate = "very-high-speed";
	};

	/omit-if-no-ref/ spi2_sck_pb13: spi2_sck_pb13 {
		pinmux = <STM32_PINMUX('B', 13, AF5)>;
		bias-pull-down;
		slew-rate = "very-high-speed";
	};

	/omit-if-no-ref/ spi2_sck_pb2: spi2_sck_pb2 {
		pinmux = <STM32_PINMUX('B', 2, AF6)>;
		bias-pull-down;
		slew-rate = "very-high-speed";
	};

	/omit-if-no-ref/ spi2_sck_pd3: spi2_sck_pd3 {
		pinmux = <STM32_PINMUX('D', 3, AF5)>;
		bias-pull-down;
		slew-rate = "very-high-speed";
	};

	/omit-if-no-ref/ spi3_sck_pb1: spi3_sck_pb1 {
		pinmux = <STM32_PINMUX('B', 1, AF4)>;
		bias-pull-down;
		slew-rate = "very-high-speed";
	};

	/omit-if-no-ref/ spi3_sck_pb3: spi3_sck_pb3 {
		pinmux = <STM32_PINMUX('B', 3, AF6)>;
		bias-pull-down;
		slew-rate = "very-high-speed";
	};

	/omit-if-no-ref/ spi3_sck_pb7: spi3_sck_pb7 {
		pinmux = <STM32_PINMUX('B', 7, AF6)>;
		bias-pull-down;
		slew-rate = "very-high-speed";
	};

	/omit-if-no-ref/ spi3_sck_pb9: spi3_sck_pb9 {
		pinmux = <STM32_PINMUX('B', 9, AF6)>;
		bias-pull-down;
		slew-rate = "very-high-speed";
	};

	/omit-if-no-ref/ spi3_sck_pc10: spi3_sck_pc10 {
		pinmux = <STM32_PINMUX('C', 10, AF6)>;
		bias-pull-down;
		slew-rate = "very-high-speed";
	};

	/omit-if-no-ref/ spi3_sck_pe2: spi3_sck_pe2 {
		pinmux = <STM32_PINMUX('E', 2, AF5)>;
		bias-pull-down;
		slew-rate = "very-high-speed";
	};

	/* SPI_NSS */
	/omit-if-no-ref/ spi1_nss_pa15: spi1_nss_pa15 {
		pinmux = <STM32_PINMUX('A', 15, AF5)>;
		bias-pull-up;
	};

	/omit-if-no-ref/ spi1_nss_pa4: spi1_nss_pa4 {
		pinmux = <STM32_PINMUX('A', 4, AF5)>;
		bias-pull-up;
	};

	/omit-if-no-ref/ spi1_nss_pg10: spi1_nss_pg10 {
		pinmux = <STM32_PINMUX('G', 10, AF5)>;
		bias-pull-up;
	};

	/omit-if-no-ref/ spi2_nss_pa0: spi2_nss_pa0 {
		pinmux = <STM32_PINMUX('A', 0, AF9)>;
		bias-pull-up;
	};

	/omit-if-no-ref/ spi2_nss_pa11: spi2_nss_pa11 {
		pinmux = <STM32_PINMUX('A', 11, AF5)>;
		bias-pull-up;
	};

	/omit-if-no-ref/ spi2_nss_pa3: spi2_nss_pa3 {
		pinmux = <STM32_PINMUX('A', 3, AF5)>;
		bias-pull-up;
	};

	/omit-if-no-ref/ spi2_nss_pb1: spi2_nss_pb1 {
		pinmux = <STM32_PINMUX('B', 1, AF5)>;
		bias-pull-up;
	};

	/omit-if-no-ref/ spi2_nss_pb12: spi2_nss_pb12 {
		pinmux = <STM32_PINMUX('B', 12, AF5)>;
		bias-pull-up;
	};

	/omit-if-no-ref/ spi2_nss_pb4: spi2_nss_pb4 {
		pinmux = <STM32_PINMUX('B', 4, AF7)>;
		bias-pull-up;
	};

	/omit-if-no-ref/ spi2_nss_pb9: spi2_nss_pb9 {
		pinmux = <STM32_PINMUX('B', 9, AF5)>;
		bias-pull-up;
	};

	/omit-if-no-ref/ spi3_nss_pa15: spi3_nss_pa15 {
		pinmux = <STM32_PINMUX('A', 15, AF6)>;
		bias-pull-up;
	};

	/omit-if-no-ref/ spi3_nss_pa4: spi3_nss_pa4 {
		pinmux = <STM32_PINMUX('A', 4, AF6)>;
		bias-pull-up;
	};

	/omit-if-no-ref/ spi3_nss_pb8: spi3_nss_pb8 {
		pinmux = <STM32_PINMUX('B', 8, AF6)>;
		bias-pull-up;
	};

	/omit-if-no-ref/ spi3_nss_pe4: spi3_nss_pe4 {
		pinmux = <STM32_PINMUX('E', 4, AF5)>;
		bias-pull-up;
	};

	/* TIM_BKIN */
	/omit-if-no-ref/ tim15_bkin_pa0: tim15_bkin_pa0 {
		pinmux = <STM32_PINMUX('A', 0, AF4)>;
	};

	/omit-if-no-ref/ tim15_bkin_pd2: tim15_bkin_pd2 {
		pinmux = <STM32_PINMUX('D', 2, AF4)>;
	};

	/omit-if-no-ref/ tim15_bkin_pe3: tim15_bkin_pe3 {
		pinmux = <STM32_PINMUX('E', 3, AF4)>;
	};

	/omit-if-no-ref/ tim16_bkin_pb4: tim16_bkin_pb4 {
		pinmux = <STM32_PINMUX('B', 4, AF10)>;
	};

	/omit-if-no-ref/ tim16_bkin_pc0: tim16_bkin_pc0 {
		pinmux = <STM32_PINMUX('C', 0, AF10)>;
	};

	/omit-if-no-ref/ tim16_bkin_pf10: tim16_bkin_pf10 {
		pinmux = <STM32_PINMUX('F', 10, AF10)>;
	};

	/omit-if-no-ref/ tim17_bkin_pb5: tim17_bkin_pb5 {
		pinmux = <STM32_PINMUX('B', 5, AF1)>;
	};

	/omit-if-no-ref/ tim17_bkin_pg6: tim17_bkin_pg6 {
		pinmux = <STM32_PINMUX('G', 6, AF1)>;
	};

	/omit-if-no-ref/ tim1_bkin_pa6: tim1_bkin_pa6 {
		pinmux = <STM32_PINMUX('A', 6, AF1)>;
	};

	/omit-if-no-ref/ tim1_bkin_pb12: tim1_bkin_pb12 {
		pinmux = <STM32_PINMUX('B', 12, AF1)>;
	};

	/omit-if-no-ref/ tim1_bkin_pe15: tim1_bkin_pe15 {
		pinmux = <STM32_PINMUX('E', 15, AF1)>;
	};

	/omit-if-no-ref/ tim1_bkin2_pe6: tim1_bkin2_pe6 {
		pinmux = <STM32_PINMUX('E', 6, AF1)>;
	};

	/omit-if-no-ref/ tim1_bkin2_pg4: tim1_bkin2_pg4 {
		pinmux = <STM32_PINMUX('G', 4, AF1)>;
	};

	/omit-if-no-ref/ tim8_bkin_pa1: tim8_bkin_pa1 {
		pinmux = <STM32_PINMUX('A', 1, AF3)>;
	};

	/omit-if-no-ref/ tim8_bkin_pa6: tim8_bkin_pa6 {
		pinmux = <STM32_PINMUX('A', 6, AF3)>;
	};

	/omit-if-no-ref/ tim8_bkin_pc4: tim8_bkin_pc4 {
		pinmux = <STM32_PINMUX('C', 4, AF3)>;
	};

	/omit-if-no-ref/ tim8_bkin_pg2: tim8_bkin_pg2 {
		pinmux = <STM32_PINMUX('G', 2, AF3)>;
	};

	/omit-if-no-ref/ tim8_bkin2_pa8: tim8_bkin2_pa8 {
		pinmux = <STM32_PINMUX('A', 8, AF3)>;
	};

	/omit-if-no-ref/ tim8_bkin2_pc5: tim8_bkin2_pc5 {
		pinmux = <STM32_PINMUX('C', 5, AF3)>;
	};

	/omit-if-no-ref/ tim8_bkin2_pg3: tim8_bkin2_pg3 {
		pinmux = <STM32_PINMUX('G', 3, AF3)>;
	};

	/* TIM_CH / TIM_CHN */
	/omit-if-no-ref/ tim12_ch1_pb14: tim12_ch1_pb14 {
		pinmux = <STM32_PINMUX('B', 14, AF2)>;
	};

	/omit-if-no-ref/ tim12_ch1_pc14: tim12_ch1_pc14 {
		pinmux = <STM32_PINMUX('C', 14, AF2)>;
	};

	/omit-if-no-ref/ tim12_ch2_pb15: tim12_ch2_pb15 {
		pinmux = <STM32_PINMUX('B', 15, AF2)>;
	};

	/omit-if-no-ref/ tim12_ch2_pc15: tim12_ch2_pc15 {
		pinmux = <STM32_PINMUX('C', 15, AF2)>;
	};

	/omit-if-no-ref/ tim15_ch1_pa2: tim15_ch1_pa2 {
		pinmux = <STM32_PINMUX('A', 2, AF4)>;
	};

	/omit-if-no-ref/ tim15_ch1_pa7: tim15_ch1_pa7 {
		pinmux = <STM32_PINMUX('A', 7, AF4)>;
	};

	/omit-if-no-ref/ tim15_ch1_pc12: tim15_ch1_pc12 {
		pinmux = <STM32_PINMUX('C', 12, AF2)>;
	};

	/omit-if-no-ref/ tim15_ch1_pe5: tim15_ch1_pe5 {
		pinmux = <STM32_PINMUX('E', 5, AF4)>;
	};

	/omit-if-no-ref/ tim15_ch1n_pa1: tim15_ch1n_pa1 {
		pinmux = <STM32_PINMUX('A', 1, AF4)>;
	};

	/omit-if-no-ref/ tim15_ch1n_pa9: tim15_ch1n_pa9 {
		pinmux = <STM32_PINMUX('A', 9, AF4)>;
	};

	/omit-if-no-ref/ tim15_ch1n_pe4: tim15_ch1n_pe4 {
		pinmux = <STM32_PINMUX('E', 4, AF4)>;
	};

	/omit-if-no-ref/ tim15_ch2_pa3: tim15_ch2_pa3 {
		pinmux = <STM32_PINMUX('A', 3, AF4)>;
	};

	/omit-if-no-ref/ tim15_ch2_pa8: tim15_ch2_pa8 {
		pinmux = <STM32_PINMUX('A', 8, AF4)>;
	};

	/omit-if-no-ref/ tim15_ch2_pe6: tim15_ch2_pe6 {
		pinmux = <STM32_PINMUX('E', 6, AF4)>;
	};

	/omit-if-no-ref/ tim16_ch1_pb7: tim16_ch1_pb7 {
		pinmux = <STM32_PINMUX('B', 7, AF10)>;
	};

	/omit-if-no-ref/ tim16_ch1_pc4: tim16_ch1_pc4 {
		pinmux = <STM32_PINMUX('C', 4, AF10)>;
	};

	/omit-if-no-ref/ tim16_ch1_pf6: tim16_ch1_pf6 {
		pinmux = <STM32_PINMUX('F', 6, AF10)>;
	};

	/omit-if-no-ref/ tim16_ch1n_pb6: tim16_ch1n_pb6 {
		pinmux = <STM32_PINMUX('B', 6, AF10)>;
	};

	/omit-if-no-ref/ tim16_ch1n_pc5: tim16_ch1n_pc5 {
		pinmux = <STM32_PINMUX('C', 5, AF10)>;
	};

	/omit-if-no-ref/ tim16_ch1n_pf8: tim16_ch1n_pf8 {
		pinmux = <STM32_PINMUX('F', 8, AF10)>;
	};

	/omit-if-no-ref/ tim17_ch1_pb8: tim17_ch1_pb8 {
		pinmux = <STM32_PINMUX('B', 8, AF1)>;
	};

	/omit-if-no-ref/ tim17_ch1_pc2: tim17_ch1_pc2 {
		pinmux = <STM32_PINMUX('C', 2, AF1)>;
	};

	/omit-if-no-ref/ tim17_ch1_pf7: tim17_ch1_pf7 {
		pinmux = <STM32_PINMUX('F', 7, AF1)>;
	};

	/omit-if-no-ref/ tim17_ch1n_pb7: tim17_ch1n_pb7 {
		pinmux = <STM32_PINMUX('B', 7, AF1)>;
	};

	/omit-if-no-ref/ tim17_ch1n_pf9: tim17_ch1n_pf9 {
		pinmux = <STM32_PINMUX('F', 9, AF1)>;
	};

	/omit-if-no-ref/ tim17_ch1n_ph2: tim17_ch1n_ph2 {
		pinmux = <STM32_PINMUX('H', 2, AF1)>;
	};

	/omit-if-no-ref/ tim1_ch1_pa8: tim1_ch1_pa8 {
		pinmux = <STM32_PINMUX('A', 8, AF1)>;
	};

	/omit-if-no-ref/ tim1_ch1_pe9: tim1_ch1_pe9 {
		pinmux = <STM32_PINMUX('E', 9, AF1)>;
	};

	/omit-if-no-ref/ tim1_ch1n_pa7: tim1_ch1n_pa7 {
		pinmux = <STM32_PINMUX('A', 7, AF1)>;
	};

	/omit-if-no-ref/ tim1_ch1n_pb13: tim1_ch1n_pb13 {
		pinmux = <STM32_PINMUX('B', 13, AF1)>;
	};

	/omit-if-no-ref/ tim1_ch1n_pe8: tim1_ch1n_pe8 {
		pinmux = <STM32_PINMUX('E', 8, AF1)>;
	};

	/omit-if-no-ref/ tim1_ch2_pa9: tim1_ch2_pa9 {
		pinmux = <STM32_PINMUX('A', 9, AF1)>;
	};

	/omit-if-no-ref/ tim1_ch2_pe11: tim1_ch2_pe11 {
		pinmux = <STM32_PINMUX('E', 11, AF1)>;
	};

	/omit-if-no-ref/ tim1_ch2n_pa15: tim1_ch2n_pa15 {
		pinmux = <STM32_PINMUX('A', 15, AF2)>;
	};

	/omit-if-no-ref/ tim1_ch2n_pb0: tim1_ch2n_pb0 {
		pinmux = <STM32_PINMUX('B', 0, AF1)>;
	};

	/omit-if-no-ref/ tim1_ch2n_pb14: tim1_ch2n_pb14 {
		pinmux = <STM32_PINMUX('B', 14, AF1)>;
	};

	/omit-if-no-ref/ tim1_ch2n_pe10: tim1_ch2n_pe10 {
		pinmux = <STM32_PINMUX('E', 10, AF1)>;
	};

	/omit-if-no-ref/ tim1_ch3_pa10: tim1_ch3_pa10 {
		pinmux = <STM32_PINMUX('A', 10, AF1)>;
	};

	/omit-if-no-ref/ tim1_ch3_pa5: tim1_ch3_pa5 {
		pinmux = <STM32_PINMUX('A', 5, AF2)>;
	};

	/omit-if-no-ref/ tim1_ch3_pe13: tim1_ch3_pe13 {
		pinmux = <STM32_PINMUX('E', 13, AF1)>;
	};

	/omit-if-no-ref/ tim1_ch3n_pb1: tim1_ch3n_pb1 {
		pinmux = <STM32_PINMUX('B', 1, AF1)>;
	};

	/omit-if-no-ref/ tim1_ch3n_pb15: tim1_ch3n_pb15 {
		pinmux = <STM32_PINMUX('B', 15, AF1)>;
	};

	/omit-if-no-ref/ tim1_ch3n_pe12: tim1_ch3n_pe12 {
		pinmux = <STM32_PINMUX('E', 12, AF1)>;
	};

	/omit-if-no-ref/ tim1_ch4_pa11: tim1_ch4_pa11 {
		pinmux = <STM32_PINMUX('A', 11, AF1)>;
	};

	/omit-if-no-ref/ tim1_ch4_pe14: tim1_ch4_pe14 {
		pinmux = <STM32_PINMUX('E', 14, AF1)>;
	};

	/omit-if-no-ref/ tim1_ch4n_pc5: tim1_ch4n_pc5 {
		pinmux = <STM32_PINMUX('C', 5, AF1)>;
	};

	/omit-if-no-ref/ tim1_ch4n_pd5: tim1_ch4n_pd5 {
		pinmux = <STM32_PINMUX('D', 5, AF1)>;
	};

	/omit-if-no-ref/ tim1_ch4n_pe15: tim1_ch4n_pe15 {
		pinmux = <STM32_PINMUX('E', 15, AF3)>;
	};

	/omit-if-no-ref/ tim2_ch1_pa0: tim2_ch1_pa0 {
		pinmux = <STM32_PINMUX('A', 0, AF1)>;
	};

	/omit-if-no-ref/ tim2_ch1_pa15: tim2_ch1_pa15 {
		pinmux = <STM32_PINMUX('A', 15, AF1)>;
	};

	/omit-if-no-ref/ tim2_ch1_pa5: tim2_ch1_pa5 {
		pinmux = <STM32_PINMUX('A', 5, AF1)>;
	};

	/omit-if-no-ref/ tim2_ch2_pa1: tim2_ch2_pa1 {
		pinmux = <STM32_PINMUX('A', 1, AF1)>;
	};

	/omit-if-no-ref/ tim2_ch2_pb3: tim2_ch2_pb3 {
		pinmux = <STM32_PINMUX('B', 3, AF1)>;
	};

	/omit-if-no-ref/ tim2_ch3_pa2: tim2_ch3_pa2 {
		pinmux = <STM32_PINMUX('A', 2, AF1)>;
	};

	/omit-if-no-ref/ tim2_ch3_pb10: tim2_ch3_pb10 {
		pinmux = <STM32_PINMUX('B', 10, AF1)>;
	};

	/omit-if-no-ref/ tim2_ch4_pa3: tim2_ch4_pa3 {
		pinmux = <STM32_PINMUX('A', 3, AF1)>;
	};

	/omit-if-no-ref/ tim2_ch4_pa8: tim2_ch4_pa8 {
		pinmux = <STM32_PINMUX('A', 8, AF14)>;
	};

	/omit-if-no-ref/ tim2_ch4_pc4: tim2_ch4_pc4 {
		pinmux = <STM32_PINMUX('C', 4, AF1)>;
	};

	/omit-if-no-ref/ tim3_ch1_pa6: tim3_ch1_pa6 {
		pinmux = <STM32_PINMUX('A', 6, AF2)>;
	};

	/omit-if-no-ref/ tim3_ch1_pb4: tim3_ch1_pb4 {
		pinmux = <STM32_PINMUX('B', 4, AF2)>;
	};

	/omit-if-no-ref/ tim3_ch1_pc6: tim3_ch1_pc6 {
		pinmux = <STM32_PINMUX('C', 6, AF2)>;
	};

	/omit-if-no-ref/ tim3_ch2_pa7: tim3_ch2_pa7 {
		pinmux = <STM32_PINMUX('A', 7, AF2)>;
	};

	/omit-if-no-ref/ tim3_ch2_pb5: tim3_ch2_pb5 {
		pinmux = <STM32_PINMUX('B', 5, AF2)>;
	};

	/omit-if-no-ref/ tim3_ch2_pc7: tim3_ch2_pc7 {
		pinmux = <STM32_PINMUX('C', 7, AF2)>;
	};

	/omit-if-no-ref/ tim3_ch3_pa3: tim3_ch3_pa3 {
		pinmux = <STM32_PINMUX('A', 3, AF2)>;
	};

	/omit-if-no-ref/ tim3_ch3_pb0: tim3_ch3_pb0 {
		pinmux = <STM32_PINMUX('B', 0, AF2)>;
	};

	/omit-if-no-ref/ tim3_ch3_pc8: tim3_ch3_pc8 {
		pinmux = <STM32_PINMUX('C', 8, AF2)>;
	};

	/omit-if-no-ref/ tim3_ch4_pa4: tim3_ch4_pa4 {
		pinmux = <STM32_PINMUX('A', 4, AF2)>;
	};

	/omit-if-no-ref/ tim3_ch4_pb1: tim3_ch4_pb1 {
		pinmux = <STM32_PINMUX('B', 1, AF2)>;
	};

	/omit-if-no-ref/ tim3_ch4_pc9: tim3_ch4_pc9 {
		pinmux = <STM32_PINMUX('C', 9, AF2)>;
	};

	/omit-if-no-ref/ tim4_ch1_pb6: tim4_ch1_pb6 {
		pinmux = <STM32_PINMUX('B', 6, AF2)>;
	};

	/omit-if-no-ref/ tim4_ch1_pd12: tim4_ch1_pd12 {
		pinmux = <STM32_PINMUX('D', 12, AF2)>;
	};

	/omit-if-no-ref/ tim4_ch1_pg0: tim4_ch1_pg0 {
		pinmux = <STM32_PINMUX('G', 0, AF2)>;
	};

	/omit-if-no-ref/ tim4_ch2_pb7: tim4_ch2_pb7 {
		pinmux = <STM32_PINMUX('B', 7, AF2)>;
	};

	/omit-if-no-ref/ tim4_ch2_pd13: tim4_ch2_pd13 {
		pinmux = <STM32_PINMUX('D', 13, AF2)>;
	};

	/omit-if-no-ref/ tim4_ch2_pg1: tim4_ch2_pg1 {
		pinmux = <STM32_PINMUX('G', 1, AF2)>;
	};

	/omit-if-no-ref/ tim4_ch3_pb8: tim4_ch3_pb8 {
		pinmux = <STM32_PINMUX('B', 8, AF2)>;
	};

	/omit-if-no-ref/ tim4_ch3_pd14: tim4_ch3_pd14 {
		pinmux = <STM32_PINMUX('D', 14, AF2)>;
	};

	/omit-if-no-ref/ tim4_ch3_pg2: tim4_ch3_pg2 {
		pinmux = <STM32_PINMUX('G', 2, AF2)>;
	};

	/omit-if-no-ref/ tim4_ch4_pb9: tim4_ch4_pb9 {
		pinmux = <STM32_PINMUX('B', 9, AF2)>;
	};

	/omit-if-no-ref/ tim4_ch4_pc2: tim4_ch4_pc2 {
		pinmux = <STM32_PINMUX('C', 2, AF2)>;
	};

	/omit-if-no-ref/ tim4_ch4_pd15: tim4_ch4_pd15 {
		pinmux = <STM32_PINMUX('D', 15, AF2)>;
	};

	/omit-if-no-ref/ tim4_ch4_pg3: tim4_ch4_pg3 {
		pinmux = <STM32_PINMUX('G', 3, AF2)>;
	};

	/omit-if-no-ref/ tim5_ch1_pa0: tim5_ch1_pa0 {
		pinmux = <STM32_PINMUX('A', 0, AF2)>;
	};

	/omit-if-no-ref/ tim5_ch1_pg4: tim5_ch1_pg4 {
		pinmux = <STM32_PINMUX('G', 4, AF2)>;
	};

	/omit-if-no-ref/ tim5_ch2_pa1: tim5_ch2_pa1 {
		pinmux = <STM32_PINMUX('A', 1, AF2)>;
	};

	/omit-if-no-ref/ tim5_ch2_pg5: tim5_ch2_pg5 {
		pinmux = <STM32_PINMUX('G', 5, AF2)>;
	};

	/omit-if-no-ref/ tim5_ch3_pa2: tim5_ch3_pa2 {
		pinmux = <STM32_PINMUX('A', 2, AF2)>;
	};

	/omit-if-no-ref/ tim5_ch3_pb3: tim5_ch3_pb3 {
		pinmux = <STM32_PINMUX('B', 3, AF3)>;
	};

	/omit-if-no-ref/ tim5_ch3_pg6: tim5_ch3_pg6 {
		pinmux = <STM32_PINMUX('G', 6, AF2)>;
	};

	/omit-if-no-ref/ tim5_ch4_pa3: tim5_ch4_pa3 {
		pinmux = <STM32_PINMUX('A', 3, AF8)>;
	};

	/omit-if-no-ref/ tim5_ch4_pa8: tim5_ch4_pa8 {
		pinmux = <STM32_PINMUX('A', 8, AF8)>;
	};

	/omit-if-no-ref/ tim5_ch4_pg7: tim5_ch4_pg7 {
		pinmux = <STM32_PINMUX('G', 7, AF2)>;
	};

	/omit-if-no-ref/ tim8_ch1_pb10: tim8_ch1_pb10 {
		pinmux = <STM32_PINMUX('B', 10, AF2)>;
	};

	/omit-if-no-ref/ tim8_ch1_pb3: tim8_ch1_pb3 {
		pinmux = <STM32_PINMUX('B', 3, AF13)>;
	};

	/omit-if-no-ref/ tim8_ch1_pc6: tim8_ch1_pc6 {
		pinmux = <STM32_PINMUX('C', 6, AF3)>;
	};

	/omit-if-no-ref/ tim8_ch1n_pa5: tim8_ch1n_pa5 {
		pinmux = <STM32_PINMUX('A', 5, AF3)>;
	};

	/omit-if-no-ref/ tim8_ch1n_pa7: tim8_ch1n_pa7 {
		pinmux = <STM32_PINMUX('A', 7, AF3)>;
	};

	/omit-if-no-ref/ tim8_ch1n_pc10: tim8_ch1n_pc10 {
		pinmux = <STM32_PINMUX('C', 10, AF3)>;
	};

	/omit-if-no-ref/ tim8_ch1n_pd12: tim8_ch1n_pd12 {
		pinmux = <STM32_PINMUX('D', 12, AF3)>;
	};

	/omit-if-no-ref/ tim8_ch2_pb13: tim8_ch2_pb13 {
		pinmux = <STM32_PINMUX('B', 13, AF2)>;
	};

	/omit-if-no-ref/ tim8_ch2_pb4: tim8_ch2_pb4 {
		pinmux = <STM32_PINMUX('B', 4, AF13)>;
	};

	/omit-if-no-ref/ tim8_ch2_pc7: tim8_ch2_pc7 {
		pinmux = <STM32_PINMUX('C', 7, AF3)>;
	};

	/omit-if-no-ref/ tim8_ch2n_pa9: tim8_ch2n_pa9 {
		pinmux = <STM32_PINMUX('A', 9, AF13)>;
	};

	/omit-if-no-ref/ tim8_ch2n_pb0: tim8_ch2n_pb0 {
		pinmux = <STM32_PINMUX('B', 0, AF3)>;
	};

	/omit-if-no-ref/ tim8_ch2n_pb14: tim8_ch2n_pb14 {
		pinmux = <STM32_PINMUX('B', 14, AF3)>;
	};

	/omit-if-no-ref/ tim8_ch2n_pc11: tim8_ch2n_pc11 {
		pinmux = <STM32_PINMUX('C', 11, AF3)>;
	};

	/omit-if-no-ref/ tim8_ch2n_pd13: tim8_ch2n_pd13 {
		pinmux = <STM32_PINMUX('D', 13, AF3)>;
	};

	/omit-if-no-ref/ tim8_ch3_pb12: tim8_ch3_pb12 {
		pinmux = <STM32_PINMUX('B', 12, AF2)>;
	};

	/omit-if-no-ref/ tim8_ch3_pb5: tim8_ch3_pb5 {
		pinmux = <STM32_PINMUX('B', 5, AF13)>;
	};

	/omit-if-no-ref/ tim8_ch3_pc8: tim8_ch3_pc8 {
		pinmux = <STM32_PINMUX('C', 8, AF3)>;
	};

	/omit-if-no-ref/ tim8_ch3n_pb1: tim8_ch3n_pb1 {
		pinmux = <STM32_PINMUX('B', 1, AF3)>;
	};

	/omit-if-no-ref/ tim8_ch3n_pb15: tim8_ch3n_pb15 {
		pinmux = <STM32_PINMUX('B', 15, AF3)>;
	};

	/omit-if-no-ref/ tim8_ch3n_pc12: tim8_ch3n_pc12 {
		pinmux = <STM32_PINMUX('C', 12, AF3)>;
	};

	/omit-if-no-ref/ tim8_ch3n_pd14: tim8_ch3n_pd14 {
		pinmux = <STM32_PINMUX('D', 14, AF3)>;
	};

	/omit-if-no-ref/ tim8_ch4_pb6: tim8_ch4_pb6 {
		pinmux = <STM32_PINMUX('B', 6, AF13)>;
	};

	/omit-if-no-ref/ tim8_ch4_pc9: tim8_ch4_pc9 {
		pinmux = <STM32_PINMUX('C', 9, AF3)>;
	};

	/omit-if-no-ref/ tim8_ch4n_pa15: tim8_ch4n_pa15 {
		pinmux = <STM32_PINMUX('A', 15, AF13)>;
	};

	/omit-if-no-ref/ tim8_ch4n_pb2: tim8_ch4n_pb2 {
		pinmux = <STM32_PINMUX('B', 2, AF3)>;
	};

	/omit-if-no-ref/ tim8_ch4n_pd0: tim8_ch4n_pd0 {
		pinmux = <STM32_PINMUX('D', 0, AF3)>;
	};

	/omit-if-no-ref/ tim8_ch4n_pd15: tim8_ch4n_pd15 {
		pinmux = <STM32_PINMUX('D', 15, AF3)>;
	};

	/* UART_CTS / USART_CTS / LPUART_CTS */
	/omit-if-no-ref/ lpuart1_cts_pa11: lpuart1_cts_pa11 {
		pinmux = <STM32_PINMUX('A', 11, AF3)>;
		bias-pull-up;
	};

	/omit-if-no-ref/ lpuart1_cts_pa7: lpuart1_cts_pa7 {
		pinmux = <STM32_PINMUX('A', 7, AF8)>;
		bias-pull-up;
	};

	/omit-if-no-ref/ lpuart1_cts_pb4: lpuart1_cts_pb4 {
		pinmux = <STM32_PINMUX('B', 4, AF8)>;
		bias-pull-up;
	};

	/omit-if-no-ref/ uart4_cts_pb0: uart4_cts_pb0 {
		pinmux = <STM32_PINMUX('B', 0, AF8)>;
		bias-pull-up;
	};

	/omit-if-no-ref/ uart4_cts_pb15: uart4_cts_pb15 {
		pinmux = <STM32_PINMUX('B', 15, AF8)>;
		bias-pull-up;
	};

	/omit-if-no-ref/ uart5_cts_pb4: uart5_cts_pb4 {
		pinmux = <STM32_PINMUX('B', 4, AF14)>;
		bias-pull-up;
	};

	/omit-if-no-ref/ uart5_cts_pc9: uart5_cts_pc9 {
		pinmux = <STM32_PINMUX('C', 9, AF8)>;
		bias-pull-up;
	};

	/omit-if-no-ref/ uart7_cts_pe10: uart7_cts_pe10 {
		pinmux = <STM32_PINMUX('E', 10, AF7)>;
		bias-pull-up;
	};

	/omit-if-no-ref/ uart7_cts_pf9: uart7_cts_pf9 {
		pinmux = <STM32_PINMUX('F', 9, AF7)>;
		bias-pull-up;
	};

	/omit-if-no-ref/ usart1_cts_pa11: usart1_cts_pa11 {
		pinmux = <STM32_PINMUX('A', 11, AF7)>;
		bias-pull-up;
	};

	/omit-if-no-ref/ usart1_cts_pa5: usart1_cts_pa5 {
		pinmux = <STM32_PINMUX('A', 5, AF7)>;
		bias-pull-up;
	};

	/omit-if-no-ref/ usart1_cts_pe6: usart1_cts_pe6 {
		pinmux = <STM32_PINMUX('E', 6, AF7)>;
		bias-pull-up;
	};

	/omit-if-no-ref/ usart2_cts_pa0: usart2_cts_pa0 {
		pinmux = <STM32_PINMUX('A', 0, AF7)>;
		bias-pull-up;
	};

	/omit-if-no-ref/ usart2_cts_pd3: usart2_cts_pd3 {
		pinmux = <STM32_PINMUX('D', 3, AF7)>;
		bias-pull-up;
	};

	/omit-if-no-ref/ usart3_cts_pb13: usart3_cts_pb13 {
		pinmux = <STM32_PINMUX('B', 13, AF7)>;
		bias-pull-up;
	};

	/omit-if-no-ref/ usart3_cts_pb6: usart3_cts_pb6 {
		pinmux = <STM32_PINMUX('B', 6, AF11)>;
		bias-pull-up;
	};

	/omit-if-no-ref/ usart3_cts_pd11: usart3_cts_pd11 {
		pinmux = <STM32_PINMUX('D', 11, AF7)>;
		bias-pull-up;
	};

	/omit-if-no-ref/ usart6_cts_pg13: usart6_cts_pg13 {
		pinmux = <STM32_PINMUX('G', 13, AF7)>;
		bias-pull-up;
	};

	/omit-if-no-ref/ usart6_cts_pg15: usart6_cts_pg15 {
		pinmux = <STM32_PINMUX('G', 15, AF7)>;
		bias-pull-up;
	};

	/* UART_RTS / USART_RTS / LPUART_RTS */
	/omit-if-no-ref/ lpuart1_rts_pa12: lpuart1_rts_pa12 {
		pinmux = <STM32_PINMUX('A', 12, AF3)>;
		drive-push-pull;
	};

	/omit-if-no-ref/ lpuart1_rts_pa6: lpuart1_rts_pa6 {
		pinmux = <STM32_PINMUX('A', 6, AF8)>;
		drive-push-pull;
	};

	/omit-if-no-ref/ lpuart1_rts_pb5: lpuart1_rts_pb5 {
		pinmux = <STM32_PINMUX('B', 5, AF8)>;
		drive-push-pull;
	};

	/omit-if-no-ref/ uart4_rts_pa15: uart4_rts_pa15 {
		pinmux = <STM32_PINMUX('A', 15, AF8)>;
		drive-push-pull;
	};

	/omit-if-no-ref/ uart4_rts_pb14: uart4_rts_pb14 {
		pinmux = <STM32_PINMUX('B', 14, AF8)>;
		drive-push-pull;
	};

	/omit-if-no-ref/ uart5_rts_pb3: uart5_rts_pb3 {
		pinmux = <STM32_PINMUX('B', 3, AF14)>;
		drive-push-pull;
	};

	/omit-if-no-ref/ uart5_rts_pc8: uart5_rts_pc8 {
		pinmux = <STM32_PINMUX('C', 8, AF8)>;
		drive-push-pull;
	};

	/omit-if-no-ref/ uart7_rts_pe9: uart7_rts_pe9 {
		pinmux = <STM32_PINMUX('E', 9, AF7)>;
		drive-push-pull;
	};

	/omit-if-no-ref/ uart7_rts_pf8: uart7_rts_pf8 {
		pinmux = <STM32_PINMUX('F', 8, AF7)>;
		drive-push-pull;
	};

	/omit-if-no-ref/ usart1_rts_pa12: usart1_rts_pa12 {
		pinmux = <STM32_PINMUX('A', 12, AF7)>;
		drive-push-pull;
	};

	/omit-if-no-ref/ usart1_rts_ph15: usart1_rts_ph15 {
		pinmux = <STM32_PINMUX('H', 15, AF7)>;
		drive-push-pull;
	};

	/omit-if-no-ref/ usart2_rts_pa1: usart2_rts_pa1 {
		pinmux = <STM32_PINMUX('A', 1, AF7)>;
		drive-push-pull;
	};

	/omit-if-no-ref/ usart2_rts_pd4: usart2_rts_pd4 {
		pinmux = <STM32_PINMUX('D', 4, AF7)>;
		drive-push-pull;
	};

	/omit-if-no-ref/ usart3_rts_pb14: usart3_rts_pb14 {
		pinmux = <STM32_PINMUX('B', 14, AF7)>;
		drive-push-pull;
	};

	/omit-if-no-ref/ usart3_rts_pb7: usart3_rts_pb7 {
		pinmux = <STM32_PINMUX('B', 7, AF11)>;
		drive-push-pull;
	};

	/omit-if-no-ref/ usart3_rts_pd12: usart3_rts_pd12 {
		pinmux = <STM32_PINMUX('D', 12, AF7)>;
		drive-push-pull;
	};

	/omit-if-no-ref/ usart6_rts_pg12: usart6_rts_pg12 {
		pinmux = <STM32_PINMUX('G', 12, AF7)>;
		drive-push-pull;
	};

	/omit-if-no-ref/ usart6_rts_pg8: usart6_rts_pg8 {
		pinmux = <STM32_PINMUX('G', 8, AF7)>;
		drive-push-pull;
	};

	/* UART_TX / USART_TX / LPUART_TX */
	/omit-if-no-ref/ lpuart1_tx_pa3: lpuart1_tx_pa3 {
		pinmux = <STM32_PINMUX('A', 3, AF3)>;
		bias-pull-up;
	};

	/omit-if-no-ref/ lpuart1_tx_pa9: lpuart1_tx_pa9 {
		pinmux = <STM32_PINMUX('A', 9, AF3)>;
		bias-pull-up;
	};

	/omit-if-no-ref/ lpuart1_tx_pb3: lpuart1_tx_pb3 {
		pinmux = <STM32_PINMUX('B', 3, AF8)>;
		bias-pull-up;
	};

	/omit-if-no-ref/ lpuart1_tx_pb6: lpuart1_tx_pb6 {
		pinmux = <STM32_PINMUX('B', 6, AF8)>;
		bias-pull-up;
	};

	/omit-if-no-ref/ lpuart1_tx_pc3: lpuart1_tx_pc3 {
		pinmux = <STM32_PINMUX('C', 3, AF3)>;
		bias-pull-up;
	};

	/omit-if-no-ref/ uart4_tx_pa0: uart4_tx_pa0 {
		pinmux = <STM32_PINMUX('A', 0, AF8)>;
		bias-pull-up;
	};

	/omit-if-no-ref/ uart4_tx_pa12: uart4_tx_pa12 {
		pinmux = <STM32_PINMUX('A', 12, AF6)>;
		bias-pull-up;
	};

	/omit-if-no-ref/ uart4_tx_pb9: uart4_tx_pb9 {
		pinmux = <STM32_PINMUX('B', 9, AF8)>;
		bias-pull-up;
	};

	/omit-if-no-ref/ uart4_tx_pc10: uart4_tx_pc10 {
		pinmux = <STM32_PINMUX('C', 10, AF8)>;
		bias-pull-up;
	};

	/omit-if-no-ref/ uart4_tx_pd1: uart4_tx_pd1 {
		pinmux = <STM32_PINMUX('D', 1, AF8)>;
		bias-pull-up;
	};

	/omit-if-no-ref/ uart4_tx_pd12: uart4_tx_pd12 {
		pinmux = <STM32_PINMUX('D', 12, AF8)>;
		bias-pull-up;
	};

	/omit-if-no-ref/ uart5_tx_pb13: uart5_tx_pb13 {
		pinmux = <STM32_PINMUX('B', 13, AF14)>;
		bias-pull-up;
	};

	/omit-if-no-ref/ uart5_tx_pb6: uart5_tx_pb6 {
		pinmux = <STM32_PINMUX('B', 6, AF14)>;
		bias-pull-up;
	};

	/omit-if-no-ref/ uart5_tx_pc12: uart5_tx_pc12 {
		pinmux = <STM32_PINMUX('C', 12, AF8)>;
		bias-pull-up;
	};

	/omit-if-no-ref/ uart7_tx_pa10: uart7_tx_pa10 {
		pinmux = <STM32_PINMUX('A', 10, AF10)>;
		bias-pull-up;
	};

	/omit-if-no-ref/ uart7_tx_pe8: uart7_tx_pe8 {
		pinmux = <STM32_PINMUX('E', 8, AF7)>;
		bias-pull-up;
	};

	/omit-if-no-ref/ uart7_tx_pf7: uart7_tx_pf7 {
		pinmux = <STM32_PINMUX('F', 7, AF7)>;
		bias-pull-up;
	};

	/omit-if-no-ref/ usart1_tx_pa15: usart1_tx_pa15 {
		pinmux = <STM32_PINMUX('A', 15, AF11)>;
		bias-pull-up;
	};

	/omit-if-no-ref/ usart1_tx_pa6: usart1_tx_pa6 {
		pinmux = <STM32_PINMUX('A', 6, AF7)>;
		bias-pull-up;
	};

	/omit-if-no-ref/ usart1_tx_pa9: usart1_tx_pa9 {
		pinmux = <STM32_PINMUX('A', 9, AF7)>;
		bias-pull-up;
	};

	/omit-if-no-ref/ usart1_tx_pb14: usart1_tx_pb14 {
		pinmux = <STM32_PINMUX('B', 14, AF4)>;
		bias-pull-up;
	};

	/omit-if-no-ref/ usart1_tx_pb6: usart1_tx_pb6 {
		pinmux = <STM32_PINMUX('B', 6, AF7)>;
		bias-pull-up;
	};

	/omit-if-no-ref/ usart1_tx_pe4: usart1_tx_pe4 {
		pinmux = <STM32_PINMUX('E', 4, AF7)>;
		bias-pull-up;
	};

	/omit-if-no-ref/ usart2_tx_pa11: usart2_tx_pa11 {
		pinmux = <STM32_PINMUX('A', 11, AF4)>;
		bias-pull-up;
	};

	/omit-if-no-ref/ usart2_tx_pa2: usart2_tx_pa2 {
		pinmux = <STM32_PINMUX('A', 2, AF7)>;
		bias-pull-up;
	};

	/omit-if-no-ref/ usart2_tx_pb0: usart2_tx_pb0 {
		pinmux = <STM32_PINMUX('B', 0, AF7)>;
		bias-pull-up;
	};

	/omit-if-no-ref/ usart2_tx_pd5: usart2_tx_pd5 {
		pinmux = <STM32_PINMUX('D', 5, AF7)>;
		bias-pull-up;
	};

	/omit-if-no-ref/ usart3_tx_pb10: usart3_tx_pb10 {
		pinmux = <STM32_PINMUX('B', 10, AF7)>;
		bias-pull-up;
	};

	/omit-if-no-ref/ usart3_tx_pb3: usart3_tx_pb3 {
		pinmux = <STM32_PINMUX('B', 3, AF11)>;
		bias-pull-up;
	};

	/omit-if-no-ref/ usart3_tx_pc10: usart3_tx_pc10 {
		pinmux = <STM32_PINMUX('C', 10, AF7)>;
		bias-pull-up;
	};

	/omit-if-no-ref/ usart3_tx_pd8: usart3_tx_pd8 {
		pinmux = <STM32_PINMUX('D', 8, AF7)>;
		bias-pull-up;
	};

	/omit-if-no-ref/ usart6_tx_pc6: usart6_tx_pc6 {
		pinmux = <STM32_PINMUX('C', 6, AF7)>;
		bias-pull-up;
	};

	/omit-if-no-ref/ usart6_tx_pg14: usart6_tx_pg14 {
		pinmux = <STM32_PINMUX('G', 14, AF7)>;
		bias-pull-up;
	};

	/* UART_RX / USART_RX / LPUART_RX */
	/omit-if-no-ref/ lpuart1_rx_pa10: lpuart1_rx_pa10 {
		pinmux = <STM32_PINMUX('A', 10, AF3)>;
	};

	/omit-if-no-ref/ lpuart1_rx_pa2: lpuart1_rx_pa2 {
		pinmux = <STM32_PINMUX('A', 2, AF3)>;
	};

	/omit-if-no-ref/ lpuart1_rx_pb13: lpuart1_rx_pb13 {
		pinmux = <STM32_PINMUX('B', 13, AF8)>;
	};

	/omit-if-no-ref/ lpuart1_rx_pb7: lpuart1_rx_pb7 {
		pinmux = <STM32_PINMUX('B', 7, AF8)>;
	};

	/omit-if-no-ref/ uart4_rx_pa1: uart4_rx_pa1 {
		pinmux = <STM32_PINMUX('A', 1, AF8)>;
	};

	/omit-if-no-ref/ uart4_rx_pa11: uart4_rx_pa11 {
		pinmux = <STM32_PINMUX('A', 11, AF6)>;
	};

	/omit-if-no-ref/ uart4_rx_pb8: uart4_rx_pb8 {
		pinmux = <STM32_PINMUX('B', 8, AF8)>;
	};

	/omit-if-no-ref/ uart4_rx_pc11: uart4_rx_pc11 {
		pinmux = <STM32_PINMUX('C', 11, AF8)>;
	};

	/omit-if-no-ref/ uart4_rx_pd0: uart4_rx_pd0 {
		pinmux = <STM32_PINMUX('D', 0, AF8)>;
	};

	/omit-if-no-ref/ uart4_rx_pd11: uart4_rx_pd11 {
		pinmux = <STM32_PINMUX('D', 11, AF8)>;
	};

	/omit-if-no-ref/ uart5_rx_pb12: uart5_rx_pb12 {
		pinmux = <STM32_PINMUX('B', 12, AF14)>;
	};

	/omit-if-no-ref/ uart5_rx_pb15: uart5_rx_pb15 {
		pinmux = <STM32_PINMUX('B', 15, AF14)>;
	};

	/omit-if-no-ref/ uart5_rx_pb5: uart5_rx_pb5 {
		pinmux = <STM32_PINMUX('B', 5, AF14)>;
	};

	/omit-if-no-ref/ uart5_rx_pd2: uart5_rx_pd2 {
		pinmux = <STM32_PINMUX('D', 2, AF8)>;
	};

	/omit-if-no-ref/ uart7_rx_pa8: uart7_rx_pa8 {
		pinmux = <STM32_PINMUX('A', 8, AF10)>;
	};

	/omit-if-no-ref/ uart7_rx_pe7: uart7_rx_pe7 {
		pinmux = <STM32_PINMUX('E', 7, AF7)>;
	};

	/omit-if-no-ref/ uart7_rx_pf6: uart7_rx_pf6 {
		pinmux = <STM32_PINMUX('F', 6, AF7)>;
	};

	/omit-if-no-ref/ uart7_rx_pg3: uart7_rx_pg3 {
		pinmux = <STM32_PINMUX('G', 3, AF10)>;
	};

	/omit-if-no-ref/ usart1_rx_pa10: usart1_rx_pa10 {
		pinmux = <STM32_PINMUX('A', 10, AF7)>;
	};

	/omit-if-no-ref/ usart1_rx_pa7: usart1_rx_pa7 {
		pinmux = <STM32_PINMUX('A', 7, AF7)>;
	};

	/omit-if-no-ref/ usart1_rx_pb15: usart1_rx_pb15 {
		pinmux = <STM32_PINMUX('B', 15, AF4)>;
	};

	/omit-if-no-ref/ usart1_rx_pb7: usart1_rx_pb7 {
		pinmux = <STM32_PINMUX('B', 7, AF7)>;
	};

	/omit-if-no-ref/ usart1_rx_pe3: usart1_rx_pe3 {
		pinmux = <STM32_PINMUX('E', 3, AF7)>;
	};

	/omit-if-no-ref/ usart2_rx_pa12: usart2_rx_pa12 {
		pinmux = <STM32_PINMUX('A', 12, AF4)>;
	};

	/omit-if-no-ref/ usart2_rx_pa3: usart2_rx_pa3 {
		pinmux = <STM32_PINMUX('A', 3, AF7)>;
	};

	/omit-if-no-ref/ usart2_rx_pd6: usart2_rx_pd6 {
		pinmux = <STM32_PINMUX('D', 6, AF7)>;
	};

	/omit-if-no-ref/ usart3_rx_pb1: usart3_rx_pb1 {
		pinmux = <STM32_PINMUX('B', 1, AF7)>;
	};

	/omit-if-no-ref/ usart3_rx_pb4: usart3_rx_pb4 {
		pinmux = <STM32_PINMUX('B', 4, AF11)>;
	};

	/omit-if-no-ref/ usart3_rx_pc11: usart3_rx_pc11 {
		pinmux = <STM32_PINMUX('C', 11, AF7)>;
	};

	/omit-if-no-ref/ usart3_rx_pc4: usart3_rx_pc4 {
		pinmux = <STM32_PINMUX('C', 4, AF7)>;
	};

	/omit-if-no-ref/ usart3_rx_pd9: usart3_rx_pd9 {
		pinmux = <STM32_PINMUX('D', 9, AF7)>;
	};

	/omit-if-no-ref/ usart6_rx_pc7: usart6_rx_pc7 {
		pinmux = <STM32_PINMUX('C', 7, AF7)>;
	};

	/omit-if-no-ref/ usart6_rx_pg9: usart6_rx_pg9 {
		pinmux = <STM32_PINMUX('G', 9, AF7)>;
	};

	/* USB */
	/omit-if-no-ref/ usb_dm_pa11: usb_dm_pa11 {
		pinmux = <STM32_PINMUX('A', 11, ANALOG)>;
	};

	/omit-if-no-ref/ usb_dp_pa12: usb_dp_pa12 {
		pinmux = <STM32_PINMUX('A', 12, ANALOG)>;
	};

	/omit-if-no-ref/ usb_sof_pa8: usb_sof_pa8 {
		pinmux = <STM32_PINMUX('A', 8, AF13)>;
	};

};