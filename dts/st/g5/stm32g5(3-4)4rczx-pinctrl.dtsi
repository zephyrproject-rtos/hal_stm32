/*
 * NOTE: Autogenerated file using genpinctrl_hal2.py
 *
 * SPDX-License-Identifier: Apache-2.0
 */


#include <zephyr/dt-bindings/pinctrl/stm32-pinctrl.h>

&pinctrl {

	/* Analog */
	/omit-if-no-ref/ analog_pa0: analog_pa0 {
		pinmux = <STM32_PINMUX('A', 0, ANALOG)>;
	};

	/omit-if-no-ref/ analog_pa1: analog_pa1 {
		pinmux = <STM32_PINMUX('A', 1, ANALOG)>;
	};

	/omit-if-no-ref/ analog_pa2: analog_pa2 {
		pinmux = <STM32_PINMUX('A', 2, ANALOG)>;
	};

	/omit-if-no-ref/ analog_pa3: analog_pa3 {
		pinmux = <STM32_PINMUX('A', 3, ANALOG)>;
	};

	/omit-if-no-ref/ analog_pa4: analog_pa4 {
		pinmux = <STM32_PINMUX('A', 4, ANALOG)>;
	};

	/omit-if-no-ref/ analog_pa5: analog_pa5 {
		pinmux = <STM32_PINMUX('A', 5, ANALOG)>;
	};

	/omit-if-no-ref/ analog_pa6: analog_pa6 {
		pinmux = <STM32_PINMUX('A', 6, ANALOG)>;
	};

	/omit-if-no-ref/ analog_pa7: analog_pa7 {
		pinmux = <STM32_PINMUX('A', 7, ANALOG)>;
	};

	/omit-if-no-ref/ analog_pa8: analog_pa8 {
		pinmux = <STM32_PINMUX('A', 8, ANALOG)>;
	};

	/omit-if-no-ref/ analog_pa9: analog_pa9 {
		pinmux = <STM32_PINMUX('A', 9, ANALOG)>;
	};

	/omit-if-no-ref/ analog_pa10: analog_pa10 {
		pinmux = <STM32_PINMUX('A', 10, ANALOG)>;
	};

	/omit-if-no-ref/ analog_pa11: analog_pa11 {
		pinmux = <STM32_PINMUX('A', 11, ANALOG)>;
	};

	/omit-if-no-ref/ analog_pa12: analog_pa12 {
		pinmux = <STM32_PINMUX('A', 12, ANALOG)>;
	};

	/omit-if-no-ref/ analog_pa13: analog_pa13 {
		pinmux = <STM32_PINMUX('A', 13, ANALOG)>;
	};

	/omit-if-no-ref/ analog_pa14: analog_pa14 {
		pinmux = <STM32_PINMUX('A', 14, ANALOG)>;
	};

	/omit-if-no-ref/ analog_pa15: analog_pa15 {
		pinmux = <STM32_PINMUX('A', 15, ANALOG)>;
	};

	/omit-if-no-ref/ analog_pb0: analog_pb0 {
		pinmux = <STM32_PINMUX('B', 0, ANALOG)>;
	};

	/omit-if-no-ref/ analog_pb1: analog_pb1 {
		pinmux = <STM32_PINMUX('B', 1, ANALOG)>;
	};

	/omit-if-no-ref/ analog_pb2: analog_pb2 {
		pinmux = <STM32_PINMUX('B', 2, ANALOG)>;
	};

	/omit-if-no-ref/ analog_pb3: analog_pb3 {
		pinmux = <STM32_PINMUX('B', 3, ANALOG)>;
	};

	/omit-if-no-ref/ analog_pb4: analog_pb4 {
		pinmux = <STM32_PINMUX('B', 4, ANALOG)>;
	};

	/omit-if-no-ref/ analog_pb5: analog_pb5 {
		pinmux = <STM32_PINMUX('B', 5, ANALOG)>;
	};

	/omit-if-no-ref/ analog_pb6: analog_pb6 {
		pinmux = <STM32_PINMUX('B', 6, ANALOG)>;
	};

	/omit-if-no-ref/ analog_pb7: analog_pb7 {
		pinmux = <STM32_PINMUX('B', 7, ANALOG)>;
	};

	/omit-if-no-ref/ analog_pb9: analog_pb9 {
		pinmux = <STM32_PINMUX('B', 9, ANALOG)>;
	};

	/omit-if-no-ref/ analog_pb10: analog_pb10 {
		pinmux = <STM32_PINMUX('B', 10, ANALOG)>;
	};

	/omit-if-no-ref/ analog_pb11: analog_pb11 {
		pinmux = <STM32_PINMUX('B', 11, ANALOG)>;
	};

	/omit-if-no-ref/ analog_pb12: analog_pb12 {
		pinmux = <STM32_PINMUX('B', 12, ANALOG)>;
	};

	/omit-if-no-ref/ analog_pb13: analog_pb13 {
		pinmux = <STM32_PINMUX('B', 13, ANALOG)>;
	};

	/omit-if-no-ref/ analog_pb14: analog_pb14 {
		pinmux = <STM32_PINMUX('B', 14, ANALOG)>;
	};

	/omit-if-no-ref/ analog_pb15: analog_pb15 {
		pinmux = <STM32_PINMUX('B', 15, ANALOG)>;
	};

	/omit-if-no-ref/ analog_pc0: analog_pc0 {
		pinmux = <STM32_PINMUX('C', 0, ANALOG)>;
	};

	/omit-if-no-ref/ analog_pc1: analog_pc1 {
		pinmux = <STM32_PINMUX('C', 1, ANALOG)>;
	};

	/omit-if-no-ref/ analog_pc2: analog_pc2 {
		pinmux = <STM32_PINMUX('C', 2, ANALOG)>;
	};

	/omit-if-no-ref/ analog_pc3: analog_pc3 {
		pinmux = <STM32_PINMUX('C', 3, ANALOG)>;
	};

	/omit-if-no-ref/ analog_pc6: analog_pc6 {
		pinmux = <STM32_PINMUX('C', 6, ANALOG)>;
	};

	/omit-if-no-ref/ analog_pc7: analog_pc7 {
		pinmux = <STM32_PINMUX('C', 7, ANALOG)>;
	};

	/omit-if-no-ref/ analog_pc8: analog_pc8 {
		pinmux = <STM32_PINMUX('C', 8, ANALOG)>;
	};

	/omit-if-no-ref/ analog_pc11: analog_pc11 {
		pinmux = <STM32_PINMUX('C', 11, ANALOG)>;
	};

	/omit-if-no-ref/ analog_pc12: analog_pc12 {
		pinmux = <STM32_PINMUX('C', 12, ANALOG)>;
	};

	/omit-if-no-ref/ analog_pc13: analog_pc13 {
		pinmux = <STM32_PINMUX('C', 13, ANALOG)>;
	};

	/omit-if-no-ref/ analog_pc14: analog_pc14 {
		pinmux = <STM32_PINMUX('C', 14, ANALOG)>;
	};

	/omit-if-no-ref/ analog_pc15: analog_pc15 {
		pinmux = <STM32_PINMUX('C', 15, ANALOG)>;
	};

	/omit-if-no-ref/ analog_pd10: analog_pd10 {
		pinmux = <STM32_PINMUX('D', 10, ANALOG)>;
	};

	/omit-if-no-ref/ analog_pd11: analog_pd11 {
		pinmux = <STM32_PINMUX('D', 11, ANALOG)>;
	};

	/omit-if-no-ref/ analog_pd12: analog_pd12 {
		pinmux = <STM32_PINMUX('D', 12, ANALOG)>;
	};

	/omit-if-no-ref/ analog_pe2: analog_pe2 {
		pinmux = <STM32_PINMUX('E', 2, ANALOG)>;
	};

	/omit-if-no-ref/ analog_pf10: analog_pf10 {
		pinmux = <STM32_PINMUX('F', 10, ANALOG)>;
	};

	/omit-if-no-ref/ analog_pg2: analog_pg2 {
		pinmux = <STM32_PINMUX('G', 2, ANALOG)>;
	};

	/omit-if-no-ref/ analog_pg3: analog_pg3 {
		pinmux = <STM32_PINMUX('G', 3, ANALOG)>;
	};

	/omit-if-no-ref/ analog_ph0: analog_ph0 {
		pinmux = <STM32_PINMUX('H', 0, ANALOG)>;
	};

	/omit-if-no-ref/ analog_ph1: analog_ph1 {
		pinmux = <STM32_PINMUX('H', 1, ANALOG)>;
	};

	/* ADC_IN / ADC_INN / ADC_INP */
	/omit-if-no-ref/ adc1_inn0_pa0: adc1_inn0_pa0 {
		pinmux = <STM32_PINMUX('A', 0, ANALOG)>;
	};

	/omit-if-no-ref/ adc1_inn1_pa1: adc1_inn1_pa1 {
		pinmux = <STM32_PINMUX('A', 1, ANALOG)>;
	};

	/omit-if-no-ref/ adc1_inn10_pb12: adc1_inn10_pb12 {
		pinmux = <STM32_PINMUX('B', 12, ANALOG)>;
	};

	/omit-if-no-ref/ adc1_inn11_pb1: adc1_inn11_pb1 {
		pinmux = <STM32_PINMUX('B', 1, ANALOG)>;
	};

	/omit-if-no-ref/ adc1_inn12_pb11: adc1_inn12_pb11 {
		pinmux = <STM32_PINMUX('B', 11, ANALOG)>;
	};

	/omit-if-no-ref/ adc1_inn14_pb0: adc1_inn14_pb0 {
		pinmux = <STM32_PINMUX('B', 0, ANALOG)>;
	};

	/omit-if-no-ref/ adc1_inn2_pa2: adc1_inn2_pa2 {
		pinmux = <STM32_PINMUX('A', 2, ANALOG)>;
	};

	/omit-if-no-ref/ adc1_inn3_pa3: adc1_inn3_pa3 {
		pinmux = <STM32_PINMUX('A', 3, ANALOG)>;
	};

	/omit-if-no-ref/ adc1_inn4_pb14: adc1_inn4_pb14 {
		pinmux = <STM32_PINMUX('B', 14, ANALOG)>;
	};

	/omit-if-no-ref/ adc1_inn5_pc0: adc1_inn5_pc0 {
		pinmux = <STM32_PINMUX('C', 0, ANALOG)>;
	};

	/omit-if-no-ref/ adc1_inn6_pc1: adc1_inn6_pc1 {
		pinmux = <STM32_PINMUX('C', 1, ANALOG)>;
	};

	/omit-if-no-ref/ adc1_inn7_pc2: adc1_inn7_pc2 {
		pinmux = <STM32_PINMUX('C', 2, ANALOG)>;
	};

	/omit-if-no-ref/ adc1_inn8_pc3: adc1_inn8_pc3 {
		pinmux = <STM32_PINMUX('C', 3, ANALOG)>;
	};

	/omit-if-no-ref/ adc1_inn9_ph0: adc1_inn9_ph0 {
		pinmux = <STM32_PINMUX('H', 0, ANALOG)>;
	};

	/omit-if-no-ref/ adc1_inp1_pa0: adc1_inp1_pa0 {
		pinmux = <STM32_PINMUX('A', 0, ANALOG)>;
	};

	/omit-if-no-ref/ adc1_inp10_ph0: adc1_inp10_ph0 {
		pinmux = <STM32_PINMUX('H', 0, ANALOG)>;
	};

	/omit-if-no-ref/ adc1_inp11_pb12: adc1_inp11_pb12 {
		pinmux = <STM32_PINMUX('B', 12, ANALOG)>;
	};

	/omit-if-no-ref/ adc1_inp12_pb1: adc1_inp12_pb1 {
		pinmux = <STM32_PINMUX('B', 1, ANALOG)>;
	};

	/omit-if-no-ref/ adc1_inp14_pb11: adc1_inp14_pb11 {
		pinmux = <STM32_PINMUX('B', 11, ANALOG)>;
	};

	/omit-if-no-ref/ adc1_inp15_pb0: adc1_inp15_pb0 {
		pinmux = <STM32_PINMUX('B', 0, ANALOG)>;
	};

	/omit-if-no-ref/ adc1_inp2_pa1: adc1_inp2_pa1 {
		pinmux = <STM32_PINMUX('A', 1, ANALOG)>;
	};

	/omit-if-no-ref/ adc1_inp3_pa2: adc1_inp3_pa2 {
		pinmux = <STM32_PINMUX('A', 2, ANALOG)>;
	};

	/omit-if-no-ref/ adc1_inp4_pa3: adc1_inp4_pa3 {
		pinmux = <STM32_PINMUX('A', 3, ANALOG)>;
	};

	/omit-if-no-ref/ adc1_inp5_pb14: adc1_inp5_pb14 {
		pinmux = <STM32_PINMUX('B', 14, ANALOG)>;
	};

	/omit-if-no-ref/ adc1_inp6_pc0: adc1_inp6_pc0 {
		pinmux = <STM32_PINMUX('C', 0, ANALOG)>;
	};

	/omit-if-no-ref/ adc1_inp7_pc1: adc1_inp7_pc1 {
		pinmux = <STM32_PINMUX('C', 1, ANALOG)>;
	};

	/omit-if-no-ref/ adc1_inp8_pc2: adc1_inp8_pc2 {
		pinmux = <STM32_PINMUX('C', 2, ANALOG)>;
	};

	/omit-if-no-ref/ adc1_inp9_pc3: adc1_inp9_pc3 {
		pinmux = <STM32_PINMUX('C', 3, ANALOG)>;
	};

	/omit-if-no-ref/ adc2_inn0_pa0: adc2_inn0_pa0 {
		pinmux = <STM32_PINMUX('A', 0, ANALOG)>;
	};

	/omit-if-no-ref/ adc2_inn1_pa1: adc2_inn1_pa1 {
		pinmux = <STM32_PINMUX('A', 1, ANALOG)>;
	};

	/omit-if-no-ref/ adc2_inn11_pb2: adc2_inn11_pb2 {
		pinmux = <STM32_PINMUX('B', 2, ANALOG)>;
	};

	/omit-if-no-ref/ adc2_inn12_pa5: adc2_inn12_pa5 {
		pinmux = <STM32_PINMUX('A', 5, ANALOG)>;
	};

	/omit-if-no-ref/ adc2_inn13_pb11: adc2_inn13_pb11 {
		pinmux = <STM32_PINMUX('B', 11, ANALOG)>;
	};

	/omit-if-no-ref/ adc2_inn14_pb15: adc2_inn14_pb15 {
		pinmux = <STM32_PINMUX('B', 15, ANALOG)>;
	};

	/omit-if-no-ref/ adc2_inn15_pa4: adc2_inn15_pa4 {
		pinmux = <STM32_PINMUX('A', 4, ANALOG)>;
	};

	/omit-if-no-ref/ adc2_inn2_pa6: adc2_inn2_pa6 {
		pinmux = <STM32_PINMUX('A', 6, ANALOG)>;
	};

	/omit-if-no-ref/ adc2_inn3_pa7: adc2_inn3_pa7 {
		pinmux = <STM32_PINMUX('A', 7, ANALOG)>;
	};

	/omit-if-no-ref/ adc2_inn5_pc0: adc2_inn5_pc0 {
		pinmux = <STM32_PINMUX('C', 0, ANALOG)>;
	};

	/omit-if-no-ref/ adc2_inn6_pc1: adc2_inn6_pc1 {
		pinmux = <STM32_PINMUX('C', 1, ANALOG)>;
	};

	/omit-if-no-ref/ adc2_inn7_pc2: adc2_inn7_pc2 {
		pinmux = <STM32_PINMUX('C', 2, ANALOG)>;
	};

	/omit-if-no-ref/ adc2_inn8_pc3: adc2_inn8_pc3 {
		pinmux = <STM32_PINMUX('C', 3, ANALOG)>;
	};

	/omit-if-no-ref/ adc2_inn9_ph1: adc2_inn9_ph1 {
		pinmux = <STM32_PINMUX('H', 1, ANALOG)>;
	};

	/omit-if-no-ref/ adc2_inp1_pa0: adc2_inp1_pa0 {
		pinmux = <STM32_PINMUX('A', 0, ANALOG)>;
	};

	/omit-if-no-ref/ adc2_inp10_ph1: adc2_inp10_ph1 {
		pinmux = <STM32_PINMUX('H', 1, ANALOG)>;
	};

	/omit-if-no-ref/ adc2_inp12_pb2: adc2_inp12_pb2 {
		pinmux = <STM32_PINMUX('B', 2, ANALOG)>;
	};

	/omit-if-no-ref/ adc2_inp13_pa5: adc2_inp13_pa5 {
		pinmux = <STM32_PINMUX('A', 5, ANALOG)>;
	};

	/omit-if-no-ref/ adc2_inp14_pb11: adc2_inp14_pb11 {
		pinmux = <STM32_PINMUX('B', 11, ANALOG)>;
	};

	/omit-if-no-ref/ adc2_inp15_pb15: adc2_inp15_pb15 {
		pinmux = <STM32_PINMUX('B', 15, ANALOG)>;
	};

	/omit-if-no-ref/ adc2_inp17_pa4: adc2_inp17_pa4 {
		pinmux = <STM32_PINMUX('A', 4, ANALOG)>;
	};

	/omit-if-no-ref/ adc2_inp2_pa1: adc2_inp2_pa1 {
		pinmux = <STM32_PINMUX('A', 1, ANALOG)>;
	};

	/omit-if-no-ref/ adc2_inp3_pa6: adc2_inp3_pa6 {
		pinmux = <STM32_PINMUX('A', 6, ANALOG)>;
	};

	/omit-if-no-ref/ adc2_inp4_pa7: adc2_inp4_pa7 {
		pinmux = <STM32_PINMUX('A', 7, ANALOG)>;
	};

	/omit-if-no-ref/ adc2_inp6_pc0: adc2_inp6_pc0 {
		pinmux = <STM32_PINMUX('C', 0, ANALOG)>;
	};

	/omit-if-no-ref/ adc2_inp7_pc1: adc2_inp7_pc1 {
		pinmux = <STM32_PINMUX('C', 1, ANALOG)>;
	};

	/omit-if-no-ref/ adc2_inp8_pc2: adc2_inp8_pc2 {
		pinmux = <STM32_PINMUX('C', 2, ANALOG)>;
	};

	/omit-if-no-ref/ adc2_inp9_pc3: adc2_inp9_pc3 {
		pinmux = <STM32_PINMUX('C', 3, ANALOG)>;
	};

	/* COMP_OUT */
	/omit-if-no-ref/ comp1_out_pa0: comp1_out_pa0 {
		pinmux = <STM32_PINMUX('A', 0, AF13)>;
	};

	/omit-if-no-ref/ comp1_out_pa6: comp1_out_pa6 {
		pinmux = <STM32_PINMUX('A', 6, AF13)>;
	};

	/omit-if-no-ref/ comp1_out_pb7: comp1_out_pb7 {
		pinmux = <STM32_PINMUX('B', 7, AF13)>;
	};

	/omit-if-no-ref/ comp2_out_pa12: comp2_out_pa12 {
		pinmux = <STM32_PINMUX('A', 12, AF14)>;
	};

	/omit-if-no-ref/ comp2_out_pa2: comp2_out_pa2 {
		pinmux = <STM32_PINMUX('A', 2, AF14)>;
	};

	/omit-if-no-ref/ comp2_out_pa7: comp2_out_pa7 {
		pinmux = <STM32_PINMUX('A', 7, AF14)>;
	};

	/omit-if-no-ref/ comp3_out_pb15: comp3_out_pb15 {
		pinmux = <STM32_PINMUX('B', 15, AF14)>;
	};

	/omit-if-no-ref/ comp3_out_pb9: comp3_out_pb9 {
		pinmux = <STM32_PINMUX('B', 9, AF14)>;
	};

	/omit-if-no-ref/ comp3_out_pc2: comp3_out_pc2 {
		pinmux = <STM32_PINMUX('C', 2, AF14)>;
	};

	/omit-if-no-ref/ comp4_out_pb1: comp4_out_pb1 {
		pinmux = <STM32_PINMUX('B', 1, AF13)>;
	};

	/omit-if-no-ref/ comp4_out_pb14: comp4_out_pb14 {
		pinmux = <STM32_PINMUX('B', 14, AF13)>;
	};

	/omit-if-no-ref/ comp4_out_pb5: comp4_out_pb5 {
		pinmux = <STM32_PINMUX('B', 5, AF13)>;
	};

	/omit-if-no-ref/ comp5_out_pb0: comp5_out_pb0 {
		pinmux = <STM32_PINMUX('B', 0, AF14)>;
	};

	/omit-if-no-ref/ comp5_out_pc7: comp5_out_pc7 {
		pinmux = <STM32_PINMUX('C', 7, AF14)>;
	};

	/omit-if-no-ref/ comp5_out_pg2: comp5_out_pg2 {
		pinmux = <STM32_PINMUX('G', 2, AF14)>;
	};

	/omit-if-no-ref/ comp6_out_pa10: comp6_out_pa10 {
		pinmux = <STM32_PINMUX('A', 10, AF14)>;
	};

	/omit-if-no-ref/ comp6_out_pc6: comp6_out_pc6 {
		pinmux = <STM32_PINMUX('C', 6, AF14)>;
	};

	/omit-if-no-ref/ comp7_out_pb6: comp7_out_pb6 {
		pinmux = <STM32_PINMUX('B', 6, AF13)>;
	};

	/omit-if-no-ref/ comp7_out_pc0: comp7_out_pc0 {
		pinmux = <STM32_PINMUX('C', 0, AF13)>;
	};

	/omit-if-no-ref/ comp7_out_pg3: comp7_out_pg3 {
		pinmux = <STM32_PINMUX('G', 3, AF13)>;
	};

	/omit-if-no-ref/ comp8_out_pb2: comp8_out_pb2 {
		pinmux = <STM32_PINMUX('B', 2, AF14)>;
	};

	/omit-if-no-ref/ comp8_out_pc3: comp8_out_pc3 {
		pinmux = <STM32_PINMUX('C', 3, AF14)>;
	};

	/* DAC_OUT */
	/omit-if-no-ref/ dac1_out1_pa4: dac1_out1_pa4 {
		pinmux = <STM32_PINMUX('A', 4, ANALOG)>;
	};

	/omit-if-no-ref/ dac2_out1_pa5: dac2_out1_pa5 {
		pinmux = <STM32_PINMUX('A', 5, ANALOG)>;
	};

	/* FDCAN_RX */
	/omit-if-no-ref/ fdcan1_rx_pa11: fdcan1_rx_pa11 {
		pinmux = <STM32_PINMUX('A', 11, AF9)>;
	};

	/omit-if-no-ref/ fdcan1_rx_pa6: fdcan1_rx_pa6 {
		pinmux = <STM32_PINMUX('A', 6, AF9)>;
	};

	/omit-if-no-ref/ fdcan1_rx_pb12: fdcan1_rx_pb12 {
		pinmux = <STM32_PINMUX('B', 12, AF13)>;
	};

	/omit-if-no-ref/ fdcan1_rx_pc13: fdcan1_rx_pc13 {
		pinmux = <STM32_PINMUX('C', 13, AF13)>;
	};

	/* FDCAN_TX */
	/omit-if-no-ref/ fdcan1_tx_pa12: fdcan1_tx_pa12 {
		pinmux = <STM32_PINMUX('A', 12, AF9)>;
	};

	/omit-if-no-ref/ fdcan1_tx_pa7: fdcan1_tx_pa7 {
		pinmux = <STM32_PINMUX('A', 7, AF9)>;
	};

	/omit-if-no-ref/ fdcan1_tx_pb13: fdcan1_tx_pb13 {
		pinmux = <STM32_PINMUX('B', 13, AF13)>;
	};

	/omit-if-no-ref/ fdcan1_tx_pb9: fdcan1_tx_pb9 {
		pinmux = <STM32_PINMUX('B', 9, AF13)>;
	};

	/* HRTIM_CH */
	/omit-if-no-ref/ hrtim1_cha1_pb5: hrtim1_cha1_pb5 {
		pinmux = <STM32_PINMUX('B', 5, AF12)>;
	};

	/omit-if-no-ref/ hrtim1_cha2_pb6: hrtim1_cha2_pb6 {
		pinmux = <STM32_PINMUX('B', 6, AF11)>;
	};

	/omit-if-no-ref/ hrtim1_chb1_pb7: hrtim1_chb1_pb7 {
		pinmux = <STM32_PINMUX('B', 7, AF1)>;
	};

	/omit-if-no-ref/ hrtim1_chb2_pa10: hrtim1_chb2_pa10 {
		pinmux = <STM32_PINMUX('A', 10, AF12)>;
	};

	/omit-if-no-ref/ hrtim1_chc1_pc11: hrtim1_chc1_pc11 {
		pinmux = <STM32_PINMUX('C', 11, AF1)>;
	};

	/omit-if-no-ref/ hrtim1_chc2_pc12: hrtim1_chc2_pc12 {
		pinmux = <STM32_PINMUX('C', 12, AF1)>;
	};

	/omit-if-no-ref/ hrtim1_chd1_pg2: hrtim1_chd1_pg2 {
		pinmux = <STM32_PINMUX('G', 2, AF11)>;
	};

	/omit-if-no-ref/ hrtim1_chd2_pg3: hrtim1_chd2_pg3 {
		pinmux = <STM32_PINMUX('G', 3, AF11)>;
	};

	/* HRTIM_EEV */
	/omit-if-no-ref/ hrtim1_eev1_pb14: hrtim1_eev1_pb14 {
		pinmux = <STM32_PINMUX('B', 14, AF11)>;
	};

	/omit-if-no-ref/ hrtim1_eev10_pa7: hrtim1_eev10_pa7 {
		pinmux = <STM32_PINMUX('A', 7, AF11)>;
	};

	/omit-if-no-ref/ hrtim1_eev10_pc6: hrtim1_eev10_pc6 {
		pinmux = <STM32_PINMUX('C', 6, AF1)>;
	};

	/omit-if-no-ref/ hrtim1_eev11_pb3: hrtim1_eev11_pb3 {
		pinmux = <STM32_PINMUX('B', 3, AF13)>;
	};

	/omit-if-no-ref/ hrtim1_eev11_ph1: hrtim1_eev11_ph1 {
		pinmux = <STM32_PINMUX('H', 1, AF1)>;
	};

	/omit-if-no-ref/ hrtim1_eev12_pe2: hrtim1_eev12_pe2 {
		pinmux = <STM32_PINMUX('E', 2, AF13)>;
	};

	/omit-if-no-ref/ hrtim1_eev14_pc13: hrtim1_eev14_pc13 {
		pinmux = <STM32_PINMUX('C', 13, AF11)>;
	};

	/omit-if-no-ref/ hrtim1_eev15_pb4: hrtim1_eev15_pb4 {
		pinmux = <STM32_PINMUX('B', 4, AF13)>;
	};

	/omit-if-no-ref/ hrtim1_eev15_pc8: hrtim1_eev15_pc8 {
		pinmux = <STM32_PINMUX('C', 8, AF13)>;
	};

	/omit-if-no-ref/ hrtim1_eev2_pb15: hrtim1_eev2_pb15 {
		pinmux = <STM32_PINMUX('B', 15, AF11)>;
	};

	/omit-if-no-ref/ hrtim1_eev3_pa2: hrtim1_eev3_pa2 {
		pinmux = <STM32_PINMUX('A', 2, AF12)>;
	};

	/omit-if-no-ref/ hrtim1_eev4_pa8: hrtim1_eev4_pa8 {
		pinmux = <STM32_PINMUX('A', 8, AF12)>;
	};

	/omit-if-no-ref/ hrtim1_eev5_pb9: hrtim1_eev5_pb9 {
		pinmux = <STM32_PINMUX('B', 9, AF12)>;
	};

	/omit-if-no-ref/ hrtim1_eev5_pc1: hrtim1_eev5_pc1 {
		pinmux = <STM32_PINMUX('C', 1, AF13)>;
	};

	/omit-if-no-ref/ hrtim1_eev6_pa15: hrtim1_eev6_pa15 {
		pinmux = <STM32_PINMUX('A', 15, AF12)>;
	};

	/omit-if-no-ref/ hrtim1_eev6_pb1: hrtim1_eev6_pb1 {
		pinmux = <STM32_PINMUX('B', 1, AF11)>;
	};

	/omit-if-no-ref/ hrtim1_eev7_pa12: hrtim1_eev7_pa12 {
		pinmux = <STM32_PINMUX('A', 12, AF12)>;
	};

	/omit-if-no-ref/ hrtim1_eev7_ph0: hrtim1_eev7_ph0 {
		pinmux = <STM32_PINMUX('H', 0, AF1)>;
	};

	/omit-if-no-ref/ hrtim1_eev8_pc0: hrtim1_eev8_pc0 {
		pinmux = <STM32_PINMUX('C', 0, AF1)>;
	};

	/omit-if-no-ref/ hrtim1_eev9_pa9: hrtim1_eev9_pa9 {
		pinmux = <STM32_PINMUX('A', 9, AF12)>;
	};

	/omit-if-no-ref/ hrtim1_eev9_pc3: hrtim1_eev9_pc3 {
		pinmux = <STM32_PINMUX('C', 3, AF1)>;
	};

	/omit-if-no-ref/ hrtim1_eev9_pd10: hrtim1_eev9_pd10 {
		pinmux = <STM32_PINMUX('D', 10, AF11)>;
	};

	/* HRTIM_SCIN / HRTIM_SCOUT */
	/omit-if-no-ref/ hrtim1_scin_pa15: hrtim1_scin_pa15 {
		pinmux = <STM32_PINMUX('A', 15, AF1)>;
	};

	/omit-if-no-ref/ hrtim1_scin_pb2: hrtim1_scin_pb2 {
		pinmux = <STM32_PINMUX('B', 2, AF11)>;
	};

	/omit-if-no-ref/ hrtim1_scout_pb1: hrtim1_scout_pb1 {
		pinmux = <STM32_PINMUX('B', 1, AF1)>;
	};

	/omit-if-no-ref/ hrtim1_scout_pd10: hrtim1_scout_pd10 {
		pinmux = <STM32_PINMUX('D', 10, AF1)>;
	};

	/omit-if-no-ref/ hrtim1_scout_pf10: hrtim1_scout_pf10 {
		pinmux = <STM32_PINMUX('F', 10, AF1)>;
	};

	/* I2C_SCL */
	/omit-if-no-ref/ i2c1_scl_pa15: i2c1_scl_pa15 {
		pinmux = <STM32_PINMUX('A', 15, AF4)>;
		bias-pull-up;
		drive-open-drain;
	};

	/omit-if-no-ref/ i2c1_scl_pb5: i2c1_scl_pb5 {
		pinmux = <STM32_PINMUX('B', 5, AF9)>;
		bias-pull-up;
		drive-open-drain;
	};

	/omit-if-no-ref/ i2c1_scl_pb7: i2c1_scl_pb7 {
		pinmux = <STM32_PINMUX('B', 7, AF4)>;
		bias-pull-up;
		drive-open-drain;
	};

	/omit-if-no-ref/ i2c2_scl_pa11: i2c2_scl_pa11 {
		pinmux = <STM32_PINMUX('A', 11, AF4)>;
		bias-pull-up;
		drive-open-drain;
	};

	/omit-if-no-ref/ i2c2_scl_pb4: i2c2_scl_pb4 {
		pinmux = <STM32_PINMUX('B', 4, AF4)>;
		bias-pull-up;
		drive-open-drain;
	};

	/omit-if-no-ref/ i2c2_scl_pg2: i2c2_scl_pg2 {
		pinmux = <STM32_PINMUX('G', 2, AF4)>;
		bias-pull-up;
		drive-open-drain;
	};

	/* I2C_SDA */
	/omit-if-no-ref/ i2c1_sda_pb6: i2c1_sda_pb6 {
		pinmux = <STM32_PINMUX('B', 6, AF4)>;
		bias-pull-up;
		drive-open-drain;
	};

	/omit-if-no-ref/ i2c1_sda_pb9: i2c1_sda_pb9 {
		pinmux = <STM32_PINMUX('B', 9, AF4)>;
		bias-pull-up;
		drive-open-drain;
	};

	/omit-if-no-ref/ i2c2_sda_pa12: i2c2_sda_pa12 {
		pinmux = <STM32_PINMUX('A', 12, AF4)>;
		bias-pull-up;
		drive-open-drain;
	};

	/omit-if-no-ref/ i2c2_sda_pb3: i2c2_sda_pb3 {
		pinmux = <STM32_PINMUX('B', 3, AF4)>;
		bias-pull-up;
		drive-open-drain;
	};

	/omit-if-no-ref/ i2c2_sda_pc12: i2c2_sda_pc12 {
		pinmux = <STM32_PINMUX('C', 12, AF4)>;
		bias-pull-up;
		drive-open-drain;
	};

	/omit-if-no-ref/ i2c2_sda_pg3: i2c2_sda_pg3 {
		pinmux = <STM32_PINMUX('G', 3, AF4)>;
		bias-pull-up;
		drive-open-drain;
	};

	/* I2C_SMBA */
	/omit-if-no-ref/ i2c1_smba_pb4: i2c1_smba_pb4 {
		pinmux = <STM32_PINMUX('B', 4, AF9)>;
		bias-pull-up;
	};

	/omit-if-no-ref/ i2c2_smba_pa10: i2c2_smba_pa10 {
		pinmux = <STM32_PINMUX('A', 10, AF4)>;
		bias-pull-up;
	};

	/* I2S_MCK */
	/omit-if-no-ref/ i2s2_mck_pb5: i2s2_mck_pb5 {
		pinmux = <STM32_PINMUX('B', 5, AF7)>;
		slew-rate = "very-high-speed";
	};

	/omit-if-no-ref/ i2s2_mck_pc6: i2s2_mck_pc6 {
		pinmux = <STM32_PINMUX('C', 6, AF7)>;
		slew-rate = "very-high-speed";
	};

	/* I2S_CK */
	/omit-if-no-ref/ i2s1_ck_pb0: i2s1_ck_pb0 {
		pinmux = <STM32_PINMUX('B', 0, AF5)>;
		slew-rate = "very-high-speed";
	};

	/omit-if-no-ref/ i2s1_ck_pg3: i2s1_ck_pg3 {
		pinmux = <STM32_PINMUX('G', 3, AF2)>;
		slew-rate = "very-high-speed";
	};

	/omit-if-no-ref/ i2s2_ck_pb13: i2s2_ck_pb13 {
		pinmux = <STM32_PINMUX('B', 13, AF5)>;
		slew-rate = "very-high-speed";
	};

	/omit-if-no-ref/ i2s2_ck_ph0: i2s2_ck_ph0 {
		pinmux = <STM32_PINMUX('H', 0, AF5)>;
		slew-rate = "very-high-speed";
	};

	/omit-if-no-ref/ i2s2_ck_ph1: i2s2_ck_ph1 {
		pinmux = <STM32_PINMUX('H', 1, AF5)>;
		slew-rate = "very-high-speed";
	};

	/* I2S_WS */
	/omit-if-no-ref/ i2s1_ws_pa14: i2s1_ws_pa14 {
		pinmux = <STM32_PINMUX('A', 14, AF5)>;
	};

	/omit-if-no-ref/ i2s1_ws_pa4: i2s1_ws_pa4 {
		pinmux = <STM32_PINMUX('A', 4, AF5)>;
	};

	/omit-if-no-ref/ i2s1_ws_pb7: i2s1_ws_pb7 {
		pinmux = <STM32_PINMUX('B', 7, AF5)>;
	};

	/omit-if-no-ref/ i2s2_ws_pb12: i2s2_ws_pb12 {
		pinmux = <STM32_PINMUX('B', 12, AF5)>;
	};

	/omit-if-no-ref/ i2s2_ws_pc13: i2s2_ws_pc13 {
		pinmux = <STM32_PINMUX('C', 13, AF5)>;
	};

	/omit-if-no-ref/ i2s2_ws_pf10: i2s2_ws_pf10 {
		pinmux = <STM32_PINMUX('F', 10, AF5)>;
	};

	/* I2S_SDI */
	/omit-if-no-ref/ i2s1_sdi_pb1: i2s1_sdi_pb1 {
		pinmux = <STM32_PINMUX('B', 1, AF5)>;
	};

	/omit-if-no-ref/ i2s1_sdi_pc11: i2s1_sdi_pc11 {
		pinmux = <STM32_PINMUX('C', 11, AF5)>;
	};

	/omit-if-no-ref/ i2s2_sdi_pa11: i2s2_sdi_pa11 {
		pinmux = <STM32_PINMUX('A', 11, AF5)>;
	};

	/omit-if-no-ref/ i2s2_sdi_pb14: i2s2_sdi_pb14 {
		pinmux = <STM32_PINMUX('B', 14, AF5)>;
	};

	/omit-if-no-ref/ i2s2_sdi_pc3: i2s2_sdi_pc3 {
		pinmux = <STM32_PINMUX('C', 3, AF5)>;
	};

	/* I2S_SDO */
	/omit-if-no-ref/ i2s1_sdo_pb2: i2s1_sdo_pb2 {
		pinmux = <STM32_PINMUX('B', 2, AF5)>;
	};

	/omit-if-no-ref/ i2s1_sdo_pg2: i2s1_sdo_pg2 {
		pinmux = <STM32_PINMUX('G', 2, AF2)>;
	};

	/omit-if-no-ref/ i2s2_sdo_pa12: i2s2_sdo_pa12 {
		pinmux = <STM32_PINMUX('A', 12, AF5)>;
	};

	/omit-if-no-ref/ i2s2_sdo_pb15: i2s2_sdo_pb15 {
		pinmux = <STM32_PINMUX('B', 15, AF5)>;
	};

	/omit-if-no-ref/ i2s2_sdo_pc1: i2s2_sdo_pc1 {
		pinmux = <STM32_PINMUX('C', 1, AF5)>;
	};

	/omit-if-no-ref/ i2s2_sdo_pc2: i2s2_sdo_pc2 {
		pinmux = <STM32_PINMUX('C', 2, AF5)>;
	};

	/* I3C_SCL */
	/omit-if-no-ref/ i3c1_scl_pa11: i3c1_scl_pa11 {
		pinmux = <STM32_PINMUX('A', 11, AF3)>;
		slew-rate = "very-high-speed";
	};

	/omit-if-no-ref/ i3c1_scl_pa13: i3c1_scl_pa13 {
		pinmux = <STM32_PINMUX('A', 13, AF3)>;
		slew-rate = "very-high-speed";
	};

	/omit-if-no-ref/ i3c1_scl_pa15: i3c1_scl_pa15 {
		pinmux = <STM32_PINMUX('A', 15, AF3)>;
		slew-rate = "very-high-speed";
	};

	/omit-if-no-ref/ i3c1_scl_pc6: i3c1_scl_pc6 {
		pinmux = <STM32_PINMUX('C', 6, AF3)>;
		slew-rate = "very-high-speed";
	};

	/omit-if-no-ref/ i3c1_scl_pc8: i3c1_scl_pc8 {
		pinmux = <STM32_PINMUX('C', 8, AF3)>;
		slew-rate = "very-high-speed";
	};

	/* I3C_SDA */
	/omit-if-no-ref/ i3c1_sda_pa12: i3c1_sda_pa12 {
		pinmux = <STM32_PINMUX('A', 12, AF3)>;
		slew-rate = "very-high-speed";
	};

	/omit-if-no-ref/ i3c1_sda_pb4: i3c1_sda_pb4 {
		pinmux = <STM32_PINMUX('B', 4, AF3)>;
		slew-rate = "very-high-speed";
	};

	/omit-if-no-ref/ i3c1_sda_pb9: i3c1_sda_pb9 {
		pinmux = <STM32_PINMUX('B', 9, AF3)>;
		slew-rate = "very-high-speed";
	};

	/omit-if-no-ref/ i3c1_sda_pc7: i3c1_sda_pc7 {
		pinmux = <STM32_PINMUX('C', 7, AF3)>;
		slew-rate = "very-high-speed";
	};

	/* JTAG PORT */
	/omit-if-no-ref/ debug_jtdi_pa15: debug_jtdi_pa15 {
		pinmux = <STM32_PINMUX('A', 15, AF0)>;
	};

	/omit-if-no-ref/ debug_jtdo_pb3: debug_jtdo_pb3 {
		pinmux = <STM32_PINMUX('B', 3, AF0)>;
	};

	/omit-if-no-ref/ debug_njtrst_pb4: debug_njtrst_pb4 {
		pinmux = <STM32_PINMUX('B', 4, AF0)>;
	};

	/omit-if-no-ref/ debug_swclk_pa14: debug_swclk_pa14 {
		pinmux = <STM32_PINMUX('A', 14, AF0)>;
	};

	/omit-if-no-ref/ debug_swdio_pa13: debug_swdio_pa13 {
		pinmux = <STM32_PINMUX('A', 13, AF0)>;
	};

	/omit-if-no-ref/ debug_traceclk_pa0: debug_traceclk_pa0 {
		pinmux = <STM32_PINMUX('A', 0, AF0)>;
	};

	/omit-if-no-ref/ debug_traceclk_pe2: debug_traceclk_pe2 {
		pinmux = <STM32_PINMUX('E', 2, AF0)>;
	};

	/omit-if-no-ref/ debug_traced0_pc1: debug_traced0_pc1 {
		pinmux = <STM32_PINMUX('C', 1, AF0)>;
	};

	/omit-if-no-ref/ debug_traced1_pc11: debug_traced1_pc11 {
		pinmux = <STM32_PINMUX('C', 11, AF0)>;
	};

	/omit-if-no-ref/ debug_traced2_pc7: debug_traced2_pc7 {
		pinmux = <STM32_PINMUX('C', 7, AF0)>;
	};

	/omit-if-no-ref/ debug_traced3_pc12: debug_traced3_pc12 {
		pinmux = <STM32_PINMUX('C', 12, AF0)>;
	};

	/omit-if-no-ref/ debug_traceswo_pb3: debug_traceswo_pb3 {
		pinmux = <STM32_PINMUX('B', 3, AF0)>;
	};

	/* LPTIM */
	/omit-if-no-ref/ lptim1_ch1_pb2: lptim1_ch1_pb2 {
		pinmux = <STM32_PINMUX('B', 2, AF9)>;
	};

	/omit-if-no-ref/ lptim1_ch1_pc0: lptim1_ch1_pc0 {
		pinmux = <STM32_PINMUX('C', 0, AF5)>;
	};

	/omit-if-no-ref/ lptim1_ch2_pa5: lptim1_ch2_pa5 {
		pinmux = <STM32_PINMUX('A', 5, AF9)>;
	};

	/omit-if-no-ref/ lptim1_ch2_pb14: lptim1_ch2_pb14 {
		pinmux = <STM32_PINMUX('B', 14, AF9)>;
	};

	/omit-if-no-ref/ lptim1_etr_pb13: lptim1_etr_pb13 {
		pinmux = <STM32_PINMUX('B', 13, AF9)>;
	};

	/omit-if-no-ref/ lptim1_in1_pa1: lptim1_in1_pa1 {
		pinmux = <STM32_PINMUX('A', 1, AF5)>;
	};

	/omit-if-no-ref/ lptim1_in1_pc14: lptim1_in1_pc14 {
		pinmux = <STM32_PINMUX('C', 14, AF5)>;
	};

	/omit-if-no-ref/ lptim1_in1_pd12: lptim1_in1_pd12 {
		pinmux = <STM32_PINMUX('D', 12, AF9)>;
	};

	/omit-if-no-ref/ lptim1_in2_pa2: lptim1_in2_pa2 {
		pinmux = <STM32_PINMUX('A', 2, AF5)>;
	};

	/omit-if-no-ref/ lptim1_in2_pc15: lptim1_in2_pc15 {
		pinmux = <STM32_PINMUX('C', 15, AF5)>;
	};

	/omit-if-no-ref/ lptim1_in2_pe2: lptim1_in2_pe2 {
		pinmux = <STM32_PINMUX('E', 2, AF1)>;
	};

	/* RCC_MCO */
	/omit-if-no-ref/ rcc_mco1_pa12: rcc_mco1_pa12 {
		pinmux = <STM32_PINMUX('A', 12, AF0)>;
		slew-rate = "very-high-speed";
	};

	/omit-if-no-ref/ rcc_mco1_pb9: rcc_mco1_pb9 {
		pinmux = <STM32_PINMUX('B', 9, AF0)>;
		slew-rate = "very-high-speed";
	};

	/omit-if-no-ref/ rcc_mco2_pb14: rcc_mco2_pb14 {
		pinmux = <STM32_PINMUX('B', 14, AF0)>;
		slew-rate = "very-high-speed";
	};

	/omit-if-no-ref/ rcc_mco2_pb15: rcc_mco2_pb15 {
		pinmux = <STM32_PINMUX('B', 15, AF0)>;
		slew-rate = "very-high-speed";
	};

	/* SPI_MISO */
	/omit-if-no-ref/ spi1_miso_pb1: spi1_miso_pb1 {
		pinmux = <STM32_PINMUX('B', 1, AF5)>;
		bias-pull-down;
		slew-rate = "very-high-speed";
	};

	/omit-if-no-ref/ spi1_miso_pc11: spi1_miso_pc11 {
		pinmux = <STM32_PINMUX('C', 11, AF5)>;
		bias-pull-down;
		slew-rate = "very-high-speed";
	};

	/omit-if-no-ref/ spi2_miso_pa11: spi2_miso_pa11 {
		pinmux = <STM32_PINMUX('A', 11, AF5)>;
		bias-pull-down;
		slew-rate = "very-high-speed";
	};

	/omit-if-no-ref/ spi2_miso_pb14: spi2_miso_pb14 {
		pinmux = <STM32_PINMUX('B', 14, AF5)>;
		bias-pull-down;
		slew-rate = "very-high-speed";
	};

	/omit-if-no-ref/ spi2_miso_pc3: spi2_miso_pc3 {
		pinmux = <STM32_PINMUX('C', 3, AF5)>;
		bias-pull-down;
		slew-rate = "very-high-speed";
	};

	/* SPI_MOSI */
	/omit-if-no-ref/ spi1_mosi_pb2: spi1_mosi_pb2 {
		pinmux = <STM32_PINMUX('B', 2, AF5)>;
		bias-pull-down;
		slew-rate = "very-high-speed";
	};

	/omit-if-no-ref/ spi1_mosi_pg2: spi1_mosi_pg2 {
		pinmux = <STM32_PINMUX('G', 2, AF2)>;
		bias-pull-down;
		slew-rate = "very-high-speed";
	};

	/omit-if-no-ref/ spi2_mosi_pa12: spi2_mosi_pa12 {
		pinmux = <STM32_PINMUX('A', 12, AF5)>;
		bias-pull-down;
		slew-rate = "very-high-speed";
	};

	/omit-if-no-ref/ spi2_mosi_pb15: spi2_mosi_pb15 {
		pinmux = <STM32_PINMUX('B', 15, AF5)>;
		bias-pull-down;
		slew-rate = "very-high-speed";
	};

	/omit-if-no-ref/ spi2_mosi_pc1: spi2_mosi_pc1 {
		pinmux = <STM32_PINMUX('C', 1, AF5)>;
		bias-pull-down;
		slew-rate = "very-high-speed";
	};

	/omit-if-no-ref/ spi2_mosi_pc2: spi2_mosi_pc2 {
		pinmux = <STM32_PINMUX('C', 2, AF5)>;
		bias-pull-down;
		slew-rate = "very-high-speed";
	};

	/* SPI_SCK */
	/omit-if-no-ref/ spi1_sck_pb0: spi1_sck_pb0 {
		pinmux = <STM32_PINMUX('B', 0, AF5)>;
		bias-pull-down;
		slew-rate = "very-high-speed";
	};

	/omit-if-no-ref/ spi1_sck_pg3: spi1_sck_pg3 {
		pinmux = <STM32_PINMUX('G', 3, AF2)>;
		bias-pull-down;
		slew-rate = "very-high-speed";
	};

	/omit-if-no-ref/ spi2_sck_pb13: spi2_sck_pb13 {
		pinmux = <STM32_PINMUX('B', 13, AF5)>;
		bias-pull-down;
		slew-rate = "very-high-speed";
	};

	/omit-if-no-ref/ spi2_sck_ph0: spi2_sck_ph0 {
		pinmux = <STM32_PINMUX('H', 0, AF5)>;
		bias-pull-down;
		slew-rate = "very-high-speed";
	};

	/omit-if-no-ref/ spi2_sck_ph1: spi2_sck_ph1 {
		pinmux = <STM32_PINMUX('H', 1, AF5)>;
		bias-pull-down;
		slew-rate = "very-high-speed";
	};

	/* SPI_NSS */
	/omit-if-no-ref/ spi1_nss_pa14: spi1_nss_pa14 {
		pinmux = <STM32_PINMUX('A', 14, AF5)>;
		bias-pull-up;
		slew-rate = "very-high-speed";
	};

	/omit-if-no-ref/ spi1_nss_pa4: spi1_nss_pa4 {
		pinmux = <STM32_PINMUX('A', 4, AF5)>;
		bias-pull-up;
		slew-rate = "very-high-speed";
	};

	/omit-if-no-ref/ spi1_nss_pb7: spi1_nss_pb7 {
		pinmux = <STM32_PINMUX('B', 7, AF5)>;
		bias-pull-up;
		slew-rate = "very-high-speed";
	};

	/omit-if-no-ref/ spi2_nss_pb12: spi2_nss_pb12 {
		pinmux = <STM32_PINMUX('B', 12, AF5)>;
		bias-pull-up;
		slew-rate = "very-high-speed";
	};

	/omit-if-no-ref/ spi2_nss_pc13: spi2_nss_pc13 {
		pinmux = <STM32_PINMUX('C', 13, AF5)>;
		bias-pull-up;
		slew-rate = "very-high-speed";
	};

	/omit-if-no-ref/ spi2_nss_pf10: spi2_nss_pf10 {
		pinmux = <STM32_PINMUX('F', 10, AF5)>;
		bias-pull-up;
		slew-rate = "very-high-speed";
	};

	/* TIM_BKIN */
	/omit-if-no-ref/ tim15_bkin_pa13: tim15_bkin_pa13 {
		pinmux = <STM32_PINMUX('A', 13, AF9)>;
	};

	/omit-if-no-ref/ tim15_bkin_pa15: tim15_bkin_pa15 {
		pinmux = <STM32_PINMUX('A', 15, AF14)>;
	};

	/omit-if-no-ref/ tim15_bkin_pa8: tim15_bkin_pa8 {
		pinmux = <STM32_PINMUX('A', 8, AF14)>;
	};

	/omit-if-no-ref/ tim15_bkin_pc15: tim15_bkin_pc15 {
		pinmux = <STM32_PINMUX('C', 15, AF2)>;
	};

	/omit-if-no-ref/ tim15_bkin_pg2: tim15_bkin_pg2 {
		pinmux = <STM32_PINMUX('G', 2, AF1)>;
	};

	/omit-if-no-ref/ tim16_bkin_pa9: tim16_bkin_pa9 {
		pinmux = <STM32_PINMUX('A', 9, AF5)>;
	};

	/omit-if-no-ref/ tim16_bkin_pb0: tim16_bkin_pb0 {
		pinmux = <STM32_PINMUX('B', 0, AF1)>;
	};

	/omit-if-no-ref/ tim16_bkin_pc14: tim16_bkin_pc14 {
		pinmux = <STM32_PINMUX('C', 14, AF1)>;
	};

	/omit-if-no-ref/ tim17_bkin_pa10: tim17_bkin_pa10 {
		pinmux = <STM32_PINMUX('A', 10, AF1)>;
	};

	/omit-if-no-ref/ tim17_bkin_pb4: tim17_bkin_pb4 {
		pinmux = <STM32_PINMUX('B', 4, AF7)>;
	};

	/omit-if-no-ref/ tim17_bkin_pc13: tim17_bkin_pc13 {
		pinmux = <STM32_PINMUX('C', 13, AF7)>;
	};

	/omit-if-no-ref/ tim1_bkin_pa6: tim1_bkin_pa6 {
		pinmux = <STM32_PINMUX('A', 6, AF6)>;
	};

	/omit-if-no-ref/ tim1_bkin_pb10: tim1_bkin_pb10 {
		pinmux = <STM32_PINMUX('B', 10, AF9)>;
	};

	/omit-if-no-ref/ tim1_bkin_pb12: tim1_bkin_pb12 {
		pinmux = <STM32_PINMUX('B', 12, AF9)>;
	};

	/omit-if-no-ref/ tim1_bkin_pb7: tim1_bkin_pb7 {
		pinmux = <STM32_PINMUX('B', 7, AF9)>;
	};

	/omit-if-no-ref/ tim1_bkin_pc13: tim1_bkin_pc13 {
		pinmux = <STM32_PINMUX('C', 13, AF2)>;
	};

	/omit-if-no-ref/ tim1_bkin_pc14: tim1_bkin_pc14 {
		pinmux = <STM32_PINMUX('C', 14, AF2)>;
	};

	/omit-if-no-ref/ tim1_bkin2_pa11: tim1_bkin2_pa11 {
		pinmux = <STM32_PINMUX('A', 11, AF2)>;
	};

	/omit-if-no-ref/ tim1_bkin2_pb6: tim1_bkin2_pb6 {
		pinmux = <STM32_PINMUX('B', 6, AF1)>;
	};

	/omit-if-no-ref/ tim8_bkin_pa0: tim8_bkin_pa0 {
		pinmux = <STM32_PINMUX('A', 0, AF14)>;
	};

	/omit-if-no-ref/ tim8_bkin_pa10: tim8_bkin_pa10 {
		pinmux = <STM32_PINMUX('A', 10, AF10)>;
	};

	/omit-if-no-ref/ tim8_bkin_pa15: tim8_bkin_pa15 {
		pinmux = <STM32_PINMUX('A', 15, AF5)>;
	};

	/omit-if-no-ref/ tim8_bkin_pa6: tim8_bkin_pa6 {
		pinmux = <STM32_PINMUX('A', 6, AF4)>;
	};

	/omit-if-no-ref/ tim8_bkin_pc13: tim8_bkin_pc13 {
		pinmux = <STM32_PINMUX('C', 13, AF4)>;
	};

	/omit-if-no-ref/ tim8_bkin_pc15: tim8_bkin_pc15 {
		pinmux = <STM32_PINMUX('C', 15, AF4)>;
	};

	/omit-if-no-ref/ tim8_bkin2_pb12: tim8_bkin2_pb12 {
		pinmux = <STM32_PINMUX('B', 12, AF3)>;
	};

	/omit-if-no-ref/ tim8_bkin2_pg2: tim8_bkin2_pg2 {
		pinmux = <STM32_PINMUX('G', 2, AF10)>;
	};

	/* TIM_CH / TIM_CHN */
	/omit-if-no-ref/ tim10_ch1_pa1: tim10_ch1_pa1 {
		pinmux = <STM32_PINMUX('A', 1, AF14)>;
	};

	/omit-if-no-ref/ tim10_ch1_pc8: tim10_ch1_pc8 {
		pinmux = <STM32_PINMUX('C', 8, AF14)>;
	};

	/omit-if-no-ref/ tim10_ch1_ph1: tim10_ch1_ph1 {
		pinmux = <STM32_PINMUX('H', 1, AF14)>;
	};

	/omit-if-no-ref/ tim11_ch1_pa0: tim11_ch1_pa0 {
		pinmux = <STM32_PINMUX('A', 0, AF4)>;
	};

	/omit-if-no-ref/ tim11_ch1_pc0: tim11_ch1_pc0 {
		pinmux = <STM32_PINMUX('C', 0, AF4)>;
	};

	/omit-if-no-ref/ tim11_ch1_pe2: tim11_ch1_pe2 {
		pinmux = <STM32_PINMUX('E', 2, AF4)>;
	};

	/omit-if-no-ref/ tim12_ch1_pb6: tim12_ch1_pb6 {
		pinmux = <STM32_PINMUX('B', 6, AF14)>;
	};

	/omit-if-no-ref/ tim12_ch1_pc11: tim12_ch1_pc11 {
		pinmux = <STM32_PINMUX('C', 11, AF14)>;
	};

	/omit-if-no-ref/ tim12_ch2_pb7: tim12_ch2_pb7 {
		pinmux = <STM32_PINMUX('B', 7, AF14)>;
	};

	/omit-if-no-ref/ tim13_ch1_pa11: tim13_ch1_pa11 {
		pinmux = <STM32_PINMUX('A', 11, AF14)>;
	};

	/omit-if-no-ref/ tim13_ch1_pc12: tim13_ch1_pc12 {
		pinmux = <STM32_PINMUX('C', 12, AF14)>;
	};

	/omit-if-no-ref/ tim13_ch1_ph0: tim13_ch1_ph0 {
		pinmux = <STM32_PINMUX('H', 0, AF14)>;
	};

	/omit-if-no-ref/ tim14_ch1_pb12: tim14_ch1_pb12 {
		pinmux = <STM32_PINMUX('B', 12, AF4)>;
	};

	/omit-if-no-ref/ tim14_ch1_pb13: tim14_ch1_pb13 {
		pinmux = <STM32_PINMUX('B', 13, AF4)>;
	};

	/omit-if-no-ref/ tim14_ch1_pc1: tim14_ch1_pc1 {
		pinmux = <STM32_PINMUX('C', 1, AF4)>;
	};

	/omit-if-no-ref/ tim14_ch1_pf10: tim14_ch1_pf10 {
		pinmux = <STM32_PINMUX('F', 10, AF4)>;
	};

	/omit-if-no-ref/ tim15_ch1_pa14: tim15_ch1_pa14 {
		pinmux = <STM32_PINMUX('A', 14, AF9)>;
	};

	/omit-if-no-ref/ tim15_ch1_pa2: tim15_ch1_pa2 {
		pinmux = <STM32_PINMUX('A', 2, AF9)>;
	};

	/omit-if-no-ref/ tim15_ch1_pb14: tim15_ch1_pb14 {
		pinmux = <STM32_PINMUX('B', 14, AF1)>;
	};

	/omit-if-no-ref/ tim15_ch1n_pa1: tim15_ch1n_pa1 {
		pinmux = <STM32_PINMUX('A', 1, AF9)>;
	};

	/omit-if-no-ref/ tim15_ch1n_pb15: tim15_ch1n_pb15 {
		pinmux = <STM32_PINMUX('B', 15, AF2)>;
	};

	/omit-if-no-ref/ tim15_ch2_pa3: tim15_ch2_pa3 {
		pinmux = <STM32_PINMUX('A', 3, AF9)>;
	};

	/omit-if-no-ref/ tim15_ch2_pb15: tim15_ch2_pb15 {
		pinmux = <STM32_PINMUX('B', 15, AF1)>;
	};

	/omit-if-no-ref/ tim15_ch2_pf10: tim15_ch2_pf10 {
		pinmux = <STM32_PINMUX('F', 10, AF3)>;
	};

	/omit-if-no-ref/ tim16_ch1_pa6: tim16_ch1_pa6 {
		pinmux = <STM32_PINMUX('A', 6, AF1)>;
	};

	/omit-if-no-ref/ tim16_ch1_pb4: tim16_ch1_pb4 {
		pinmux = <STM32_PINMUX('B', 4, AF1)>;
	};

	/omit-if-no-ref/ tim16_ch1_pb5: tim16_ch1_pb5 {
		pinmux = <STM32_PINMUX('B', 5, AF1)>;
	};

	/omit-if-no-ref/ tim16_ch1n_pa12: tim16_ch1n_pa12 {
		pinmux = <STM32_PINMUX('A', 12, AF1)>;
	};

	/omit-if-no-ref/ tim16_ch1n_pa14: tim16_ch1n_pa14 {
		pinmux = <STM32_PINMUX('A', 14, AF1)>;
	};

	/omit-if-no-ref/ tim17_ch1_pa7: tim17_ch1_pa7 {
		pinmux = <STM32_PINMUX('A', 7, AF1)>;
	};

	/omit-if-no-ref/ tim17_ch1_pb9: tim17_ch1_pb9 {
		pinmux = <STM32_PINMUX('B', 9, AF7)>;
	};

	/omit-if-no-ref/ tim17_ch1n_pa15: tim17_ch1n_pa15 {
		pinmux = <STM32_PINMUX('A', 15, AF7)>;
	};

	/omit-if-no-ref/ tim17_ch1n_pb0: tim17_ch1n_pb0 {
		pinmux = <STM32_PINMUX('B', 0, AF7)>;
	};

	/omit-if-no-ref/ tim1_ch1_pb13: tim1_ch1_pb13 {
		pinmux = <STM32_PINMUX('B', 13, AF2)>;
	};

	/omit-if-no-ref/ tim1_ch1_pc0: tim1_ch1_pc0 {
		pinmux = <STM32_PINMUX('C', 0, AF6)>;
	};

	/omit-if-no-ref/ tim1_ch1n_pa11: tim1_ch1n_pa11 {
		pinmux = <STM32_PINMUX('A', 11, AF6)>;
	};

	/omit-if-no-ref/ tim1_ch1n_pa7: tim1_ch1n_pa7 {
		pinmux = <STM32_PINMUX('A', 7, AF6)>;
	};

	/omit-if-no-ref/ tim1_ch2_pb14: tim1_ch2_pb14 {
		pinmux = <STM32_PINMUX('B', 14, AF2)>;
	};

	/omit-if-no-ref/ tim1_ch2_pb9: tim1_ch2_pb9 {
		pinmux = <STM32_PINMUX('B', 9, AF1)>;
	};

	/omit-if-no-ref/ tim1_ch2_pc1: tim1_ch2_pc1 {
		pinmux = <STM32_PINMUX('C', 1, AF1)>;
	};

	/omit-if-no-ref/ tim1_ch2n_pa12: tim1_ch2n_pa12 {
		pinmux = <STM32_PINMUX('A', 12, AF6)>;
	};

	/omit-if-no-ref/ tim1_ch2n_pb0: tim1_ch2n_pb0 {
		pinmux = <STM32_PINMUX('B', 0, AF6)>;
	};

	/omit-if-no-ref/ tim1_ch3_pa10: tim1_ch3_pa10 {
		pinmux = <STM32_PINMUX('A', 10, AF6)>;
	};

	/omit-if-no-ref/ tim1_ch3_pb15: tim1_ch3_pb15 {
		pinmux = <STM32_PINMUX('B', 15, AF6)>;
	};

	/omit-if-no-ref/ tim1_ch3_pc2: tim1_ch3_pc2 {
		pinmux = <STM32_PINMUX('C', 2, AF1)>;
	};

	/omit-if-no-ref/ tim1_ch3n_pa8: tim1_ch3n_pa8 {
		pinmux = <STM32_PINMUX('A', 8, AF9)>;
	};

	/omit-if-no-ref/ tim1_ch3n_pb1: tim1_ch3n_pb1 {
		pinmux = <STM32_PINMUX('B', 1, AF6)>;
	};

	/omit-if-no-ref/ tim1_ch3n_pb11: tim1_ch3n_pb11 {
		pinmux = <STM32_PINMUX('B', 11, AF2)>;
	};

	/omit-if-no-ref/ tim1_ch3n_ph0: tim1_ch3n_ph0 {
		pinmux = <STM32_PINMUX('H', 0, AF2)>;
	};

	/omit-if-no-ref/ tim1_ch4_pb0: tim1_ch4_pb0 {
		pinmux = <STM32_PINMUX('B', 0, AF2)>;
	};

	/omit-if-no-ref/ tim1_ch4_pc3: tim1_ch4_pc3 {
		pinmux = <STM32_PINMUX('C', 3, AF2)>;
	};

	/omit-if-no-ref/ tim1_ch4n_pa11: tim1_ch4n_pa11 {
		pinmux = <STM32_PINMUX('A', 11, AF1)>;
	};

	/omit-if-no-ref/ tim2_ch1_pa0: tim2_ch1_pa0 {
		pinmux = <STM32_PINMUX('A', 0, AF1)>;
	};

	/omit-if-no-ref/ tim2_ch1_pa10: tim2_ch1_pa10 {
		pinmux = <STM32_PINMUX('A', 10, AF2)>;
	};

	/omit-if-no-ref/ tim2_ch1_pa5: tim2_ch1_pa5 {
		pinmux = <STM32_PINMUX('A', 5, AF2)>;
	};

	/omit-if-no-ref/ tim2_ch1_pb4: tim2_ch1_pb4 {
		pinmux = <STM32_PINMUX('B', 4, AF10)>;
	};

	/omit-if-no-ref/ tim2_ch1_pb7: tim2_ch1_pb7 {
		pinmux = <STM32_PINMUX('B', 7, AF2)>;
	};

	/omit-if-no-ref/ tim2_ch2_pa1: tim2_ch2_pa1 {
		pinmux = <STM32_PINMUX('A', 1, AF1)>;
	};

	/omit-if-no-ref/ tim2_ch2_pb3: tim2_ch2_pb3 {
		pinmux = <STM32_PINMUX('B', 3, AF1)>;
	};

	/omit-if-no-ref/ tim2_ch3_pa2: tim2_ch3_pa2 {
		pinmux = <STM32_PINMUX('A', 2, AF1)>;
	};

	/omit-if-no-ref/ tim2_ch3_pa9: tim2_ch3_pa9 {
		pinmux = <STM32_PINMUX('A', 9, AF1)>;
	};

	/omit-if-no-ref/ tim2_ch3_pb10: tim2_ch3_pb10 {
		pinmux = <STM32_PINMUX('B', 10, AF2)>;
	};

	/omit-if-no-ref/ tim2_ch4_pa3: tim2_ch4_pa3 {
		pinmux = <STM32_PINMUX('A', 3, AF1)>;
	};

	/omit-if-no-ref/ tim2_ch4_pb11: tim2_ch4_pb11 {
		pinmux = <STM32_PINMUX('B', 11, AF10)>;
	};

	/omit-if-no-ref/ tim8_ch1_pa14: tim8_ch1_pa14 {
		pinmux = <STM32_PINMUX('A', 14, AF14)>;
	};

	/omit-if-no-ref/ tim8_ch1_pb7: tim8_ch1_pb7 {
		pinmux = <STM32_PINMUX('B', 7, AF3)>;
	};

	/omit-if-no-ref/ tim8_ch1_pc6: tim8_ch1_pc6 {
		pinmux = <STM32_PINMUX('C', 6, AF4)>;
	};

	/omit-if-no-ref/ tim8_ch1n_pa10: tim8_ch1n_pa10 {
		pinmux = <STM32_PINMUX('A', 10, AF5)>;
	};

	/omit-if-no-ref/ tim8_ch1n_pa7: tim8_ch1n_pa7 {
		pinmux = <STM32_PINMUX('A', 7, AF4)>;
	};

	/omit-if-no-ref/ tim8_ch1n_pb3: tim8_ch1n_pb3 {
		pinmux = <STM32_PINMUX('B', 3, AF5)>;
	};

	/omit-if-no-ref/ tim8_ch2_pa6: tim8_ch2_pa6 {
		pinmux = <STM32_PINMUX('A', 6, AF10)>;
	};

	/omit-if-no-ref/ tim8_ch2_pb6: tim8_ch2_pb6 {
		pinmux = <STM32_PINMUX('B', 6, AF5)>;
	};

	/omit-if-no-ref/ tim8_ch2n_pb0: tim8_ch2n_pb0 {
		pinmux = <STM32_PINMUX('B', 0, AF4)>;
	};

	/omit-if-no-ref/ tim8_ch2n_pb4: tim8_ch2n_pb4 {
		pinmux = <STM32_PINMUX('B', 4, AF5)>;
	};

	/omit-if-no-ref/ tim8_ch2n_pb5: tim8_ch2n_pb5 {
		pinmux = <STM32_PINMUX('B', 5, AF5)>;
	};

	/omit-if-no-ref/ tim8_ch2n_pc11: tim8_ch2n_pc11 {
		pinmux = <STM32_PINMUX('C', 11, AF4)>;
	};

	/omit-if-no-ref/ tim8_ch3_pb9: tim8_ch3_pb9 {
		pinmux = <STM32_PINMUX('B', 9, AF10)>;
	};

	/omit-if-no-ref/ tim8_ch3_pc7: tim8_ch3_pc7 {
		pinmux = <STM32_PINMUX('C', 7, AF4)>;
	};

	/omit-if-no-ref/ tim8_ch3_pc8: tim8_ch3_pc8 {
		pinmux = <STM32_PINMUX('C', 8, AF4)>;
	};

	/omit-if-no-ref/ tim8_ch3_ph0: tim8_ch3_ph0 {
		pinmux = <STM32_PINMUX('H', 0, AF3)>;
	};

	/omit-if-no-ref/ tim8_ch3n_pa13: tim8_ch3n_pa13 {
		pinmux = <STM32_PINMUX('A', 13, AF14)>;
	};

	/omit-if-no-ref/ tim8_ch3n_pb1: tim8_ch3n_pb1 {
		pinmux = <STM32_PINMUX('B', 1, AF4)>;
	};

	/omit-if-no-ref/ tim8_ch3n_pc12: tim8_ch3n_pc12 {
		pinmux = <STM32_PINMUX('C', 12, AF10)>;
	};

	/omit-if-no-ref/ tim8_ch4_pa5: tim8_ch4_pa5 {
		pinmux = <STM32_PINMUX('A', 5, AF4)>;
	};

	/omit-if-no-ref/ tim8_ch4_pb13: tim8_ch4_pb13 {
		pinmux = <STM32_PINMUX('B', 13, AF10)>;
	};

	/omit-if-no-ref/ tim8_ch4_ph1: tim8_ch4_ph1 {
		pinmux = <STM32_PINMUX('H', 1, AF4)>;
	};

	/omit-if-no-ref/ tim8_ch4n_pb14: tim8_ch4n_pb14 {
		pinmux = <STM32_PINMUX('B', 14, AF10)>;
	};

	/omit-if-no-ref/ tim8_ch4n_pe2: tim8_ch4n_pe2 {
		pinmux = <STM32_PINMUX('E', 2, AF6)>;
	};

	/omit-if-no-ref/ tim9_ch1_pa5: tim9_ch1_pa5 {
		pinmux = <STM32_PINMUX('A', 5, AF11)>;
	};

	/omit-if-no-ref/ tim9_ch1_pb11: tim9_ch1_pb11 {
		pinmux = <STM32_PINMUX('B', 11, AF11)>;
	};

	/omit-if-no-ref/ tim9_ch2_pb12: tim9_ch2_pb12 {
		pinmux = <STM32_PINMUX('B', 12, AF11)>;
	};

	/* UART_CTS / USART_CTS / LPUART_CTS */
	/omit-if-no-ref/ lpuart1_cts_pa14: lpuart1_cts_pa14 {
		pinmux = <STM32_PINMUX('A', 14, AF3)>;
		bias-pull-up;
	};

	/omit-if-no-ref/ lpuart1_cts_pb13: lpuart1_cts_pb13 {
		pinmux = <STM32_PINMUX('B', 13, AF8)>;
		bias-pull-up;
	};

	/omit-if-no-ref/ uart4_cts_pa2: uart4_cts_pa2 {
		pinmux = <STM32_PINMUX('A', 2, AF8)>;
		bias-pull-up;
	};

	/omit-if-no-ref/ uart4_cts_pb15: uart4_cts_pb15 {
		pinmux = <STM32_PINMUX('B', 15, AF8)>;
		bias-pull-up;
	};

	/omit-if-no-ref/ uart4_cts_pb6: uart4_cts_pb6 {
		pinmux = <STM32_PINMUX('B', 6, AF8)>;
		bias-pull-up;
	};

	/omit-if-no-ref/ uart5_cts_pb4: uart5_cts_pb4 {
		pinmux = <STM32_PINMUX('B', 4, AF14)>;
		bias-pull-up;
	};

	/omit-if-no-ref/ uart6_cts_pc2: uart6_cts_pc2 {
		pinmux = <STM32_PINMUX('C', 2, AF7)>;
		bias-pull-up;
	};

	/omit-if-no-ref/ usart1_cts_pa11: usart1_cts_pa11 {
		pinmux = <STM32_PINMUX('A', 11, AF7)>;
		bias-pull-up;
	};

	/omit-if-no-ref/ usart2_cts_pa0: usart2_cts_pa0 {
		pinmux = <STM32_PINMUX('A', 0, AF7)>;
		bias-pull-up;
	};

	/* UART_RTS / USART_RTS / LPUART_RTS */
	/omit-if-no-ref/ lpuart1_rts_pb12: lpuart1_rts_pb12 {
		pinmux = <STM32_PINMUX('B', 12, AF8)>;
		drive-push-pull;
	};

	/omit-if-no-ref/ lpuart1_rts_pc12: lpuart1_rts_pc12 {
		pinmux = <STM32_PINMUX('C', 12, AF3)>;
		drive-push-pull;
	};

	/omit-if-no-ref/ uart4_rts_pa9: uart4_rts_pa9 {
		pinmux = <STM32_PINMUX('A', 9, AF8)>;
		drive-push-pull;
	};

	/omit-if-no-ref/ uart4_rts_pb14: uart4_rts_pb14 {
		pinmux = <STM32_PINMUX('B', 14, AF8)>;
		drive-push-pull;
	};

	/omit-if-no-ref/ uart5_rts_pb3: uart5_rts_pb3 {
		pinmux = <STM32_PINMUX('B', 3, AF14)>;
		drive-push-pull;
	};

	/omit-if-no-ref/ uart6_rts_pc3: uart6_rts_pc3 {
		pinmux = <STM32_PINMUX('C', 3, AF7)>;
		drive-push-pull;
	};

	/omit-if-no-ref/ usart1_rts_pa12: usart1_rts_pa12 {
		pinmux = <STM32_PINMUX('A', 12, AF7)>;
		drive-push-pull;
	};

	/omit-if-no-ref/ usart1_rts_pc1: usart1_rts_pc1 {
		pinmux = <STM32_PINMUX('C', 1, AF7)>;
		drive-push-pull;
	};

	/omit-if-no-ref/ usart2_rts_pa1: usart2_rts_pa1 {
		pinmux = <STM32_PINMUX('A', 1, AF7)>;
		drive-push-pull;
	};

	/* UART_TX / USART_TX / LPUART_TX */
	/omit-if-no-ref/ lpuart1_tx_pa10: lpuart1_tx_pa10 {
		pinmux = <STM32_PINMUX('A', 10, AF3)>;
		bias-pull-up;
	};

	/omit-if-no-ref/ lpuart1_tx_pa2: lpuart1_tx_pa2 {
		pinmux = <STM32_PINMUX('A', 2, AF3)>;
		bias-pull-up;
	};

	/omit-if-no-ref/ lpuart1_tx_pa9: lpuart1_tx_pa9 {
		pinmux = <STM32_PINMUX('A', 9, AF3)>;
		bias-pull-up;
	};

	/omit-if-no-ref/ lpuart1_tx_pb11: lpuart1_tx_pb11 {
		pinmux = <STM32_PINMUX('B', 11, AF8)>;
		bias-pull-up;
	};

	/omit-if-no-ref/ lpuart1_tx_pc1: lpuart1_tx_pc1 {
		pinmux = <STM32_PINMUX('C', 1, AF8)>;
		bias-pull-up;
	};

	/omit-if-no-ref/ lpuart1_tx_pc13: lpuart1_tx_pc13 {
		pinmux = <STM32_PINMUX('C', 13, AF3)>;
		bias-pull-up;
	};

	/omit-if-no-ref/ lpuart1_tx_pc15: lpuart1_tx_pc15 {
		pinmux = <STM32_PINMUX('C', 15, AF3)>;
		bias-pull-up;
	};

	/omit-if-no-ref/ uart4_tx_pa0: uart4_tx_pa0 {
		pinmux = <STM32_PINMUX('A', 0, AF8)>;
		bias-pull-up;
	};

	/omit-if-no-ref/ uart4_tx_pa12: uart4_tx_pa12 {
		pinmux = <STM32_PINMUX('A', 12, AF8)>;
		bias-pull-up;
	};

	/omit-if-no-ref/ uart4_tx_pc13: uart4_tx_pc13 {
		pinmux = <STM32_PINMUX('C', 13, AF8)>;
		bias-pull-up;
	};

	/omit-if-no-ref/ uart4_tx_pc15: uart4_tx_pc15 {
		pinmux = <STM32_PINMUX('C', 15, AF8)>;
		bias-pull-up;
	};

	/omit-if-no-ref/ uart4_tx_pd12: uart4_tx_pd12 {
		pinmux = <STM32_PINMUX('D', 12, AF8)>;
		bias-pull-up;
	};

	/omit-if-no-ref/ uart5_tx_pa6: uart5_tx_pa6 {
		pinmux = <STM32_PINMUX('A', 6, AF14)>;
		bias-pull-up;
	};

	/omit-if-no-ref/ uart5_tx_pb13: uart5_tx_pb13 {
		pinmux = <STM32_PINMUX('B', 13, AF14)>;
		bias-pull-up;
	};

	/omit-if-no-ref/ uart5_tx_pc15: uart5_tx_pc15 {
		pinmux = <STM32_PINMUX('C', 15, AF9)>;
		bias-pull-up;
	};

	/omit-if-no-ref/ uart6_tx_pb15: uart6_tx_pb15 {
		pinmux = <STM32_PINMUX('B', 15, AF7)>;
		bias-pull-up;
	};

	/omit-if-no-ref/ uart6_tx_pc6: uart6_tx_pc6 {
		pinmux = <STM32_PINMUX('C', 6, AF8)>;
		bias-pull-up;
	};

	/omit-if-no-ref/ uart6_tx_pe2: uart6_tx_pe2 {
		pinmux = <STM32_PINMUX('E', 2, AF7)>;
		bias-pull-up;
	};

	/omit-if-no-ref/ usart1_tx_pa9: usart1_tx_pa9 {
		pinmux = <STM32_PINMUX('A', 9, AF7)>;
		bias-pull-up;
	};

	/omit-if-no-ref/ usart1_tx_pb14: usart1_tx_pb14 {
		pinmux = <STM32_PINMUX('B', 14, AF4)>;
		bias-pull-up;
	};

	/omit-if-no-ref/ usart1_tx_ph0: usart1_tx_ph0 {
		pinmux = <STM32_PINMUX('H', 0, AF7)>;
		bias-pull-up;
	};

	/omit-if-no-ref/ usart2_tx_pa2: usart2_tx_pa2 {
		pinmux = <STM32_PINMUX('A', 2, AF7)>;
		bias-pull-up;
	};

	/omit-if-no-ref/ usart2_tx_pb6: usart2_tx_pb6 {
		pinmux = <STM32_PINMUX('B', 6, AF7)>;
		bias-pull-up;
	};

	/omit-if-no-ref/ usart2_tx_pc15: usart2_tx_pc15 {
		pinmux = <STM32_PINMUX('C', 15, AF7)>;
		bias-pull-up;
	};

	/omit-if-no-ref/ usart2_tx_pg2: usart2_tx_pg2 {
		pinmux = <STM32_PINMUX('G', 2, AF7)>;
		bias-pull-up;
	};

	/* UART_RX / USART_RX / LPUART_RX */
	/omit-if-no-ref/ lpuart1_rx_pa3: lpuart1_rx_pa3 {
		pinmux = <STM32_PINMUX('A', 3, AF3)>;
	};

	/omit-if-no-ref/ lpuart1_rx_pa8: lpuart1_rx_pa8 {
		pinmux = <STM32_PINMUX('A', 8, AF3)>;
	};

	/omit-if-no-ref/ lpuart1_rx_pb10: lpuart1_rx_pb10 {
		pinmux = <STM32_PINMUX('B', 10, AF8)>;
	};

	/omit-if-no-ref/ lpuart1_rx_pc0: lpuart1_rx_pc0 {
		pinmux = <STM32_PINMUX('C', 0, AF8)>;
	};

	/omit-if-no-ref/ lpuart1_rx_pc14: lpuart1_rx_pc14 {
		pinmux = <STM32_PINMUX('C', 14, AF3)>;
	};

	/omit-if-no-ref/ uart4_rx_pa1: uart4_rx_pa1 {
		pinmux = <STM32_PINMUX('A', 1, AF8)>;
	};

	/omit-if-no-ref/ uart4_rx_pa10: uart4_rx_pa10 {
		pinmux = <STM32_PINMUX('A', 10, AF8)>;
	};

	/omit-if-no-ref/ uart4_rx_pa11: uart4_rx_pa11 {
		pinmux = <STM32_PINMUX('A', 11, AF8)>;
	};

	/omit-if-no-ref/ uart4_rx_pc11: uart4_rx_pc11 {
		pinmux = <STM32_PINMUX('C', 11, AF8)>;
	};

	/omit-if-no-ref/ uart4_rx_pc14: uart4_rx_pc14 {
		pinmux = <STM32_PINMUX('C', 14, AF8)>;
	};

	/omit-if-no-ref/ uart4_rx_pd11: uart4_rx_pd11 {
		pinmux = <STM32_PINMUX('D', 11, AF8)>;
	};

	/omit-if-no-ref/ uart5_rx_pa5: uart5_rx_pa5 {
		pinmux = <STM32_PINMUX('A', 5, AF14)>;
	};

	/omit-if-no-ref/ uart5_rx_pb12: uart5_rx_pb12 {
		pinmux = <STM32_PINMUX('B', 12, AF14)>;
	};

	/omit-if-no-ref/ uart5_rx_pb15: uart5_rx_pb15 {
		pinmux = <STM32_PINMUX('B', 15, AF9)>;
	};

	/omit-if-no-ref/ uart5_rx_pc14: uart5_rx_pc14 {
		pinmux = <STM32_PINMUX('C', 14, AF9)>;
	};

	/omit-if-no-ref/ uart6_rx_pa8: uart6_rx_pa8 {
		pinmux = <STM32_PINMUX('A', 8, AF8)>;
	};

	/omit-if-no-ref/ uart6_rx_pc7: uart6_rx_pc7 {
		pinmux = <STM32_PINMUX('C', 7, AF8)>;
	};

	/omit-if-no-ref/ usart1_rx_pa10: usart1_rx_pa10 {
		pinmux = <STM32_PINMUX('A', 10, AF7)>;
	};

	/omit-if-no-ref/ usart1_rx_pb15: usart1_rx_pb15 {
		pinmux = <STM32_PINMUX('B', 15, AF4)>;
	};

	/omit-if-no-ref/ usart1_rx_ph1: usart1_rx_ph1 {
		pinmux = <STM32_PINMUX('H', 1, AF7)>;
	};

	/omit-if-no-ref/ usart2_rx_pa3: usart2_rx_pa3 {
		pinmux = <STM32_PINMUX('A', 3, AF7)>;
	};

	/omit-if-no-ref/ usart2_rx_pa8: usart2_rx_pa8 {
		pinmux = <STM32_PINMUX('A', 8, AF7)>;
	};

	/omit-if-no-ref/ usart2_rx_pb1: usart2_rx_pb1 {
		pinmux = <STM32_PINMUX('B', 1, AF7)>;
	};

	/omit-if-no-ref/ usart2_rx_pc14: usart2_rx_pc14 {
		pinmux = <STM32_PINMUX('C', 14, AF7)>;
	};

};